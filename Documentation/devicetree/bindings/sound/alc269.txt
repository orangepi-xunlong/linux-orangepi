## Documentation/devicetree/bindings/sound/alc269.txt
```
Alc256 ADC/DAC

Required properties:

  - compatible : "realtek,alc269"

  - "#sound-dai-cells" :
    const: 0

Example:

alc269_codec {
        compatible = "realtek,alc269";
};
```

## Documentation/devicetree/bindings/sound/alc3287.txt
```
Alc256 ADC/DAC

Required properties:

  - compatible : "realtek,alc3287"

  - "#sound-dai-cells" :
    const: 0

Example:

alc3287_codec {
        compatible = "realtek,alc3287";
};
```

## Documentation/devicetree/bindings/sound/cdns,i2s-mc.yaml
```yaml
# SPDX-License-Identifier: (GPL-2.0-only OR BSD-2-Clause)
%YAML 1.2
---
$id: http://devicetree.org/schemas/sound/cdns,i2s-mc.yaml#
$schema: http://devicetree.org/meta-schemas/core.yaml#

title:
  Cadence I2S-MC (MultiChannel) Controller Driver

maintainers:
  - Joakim Zhang <joakim.zhang@cixtech.com>

properties:
  compatible:
    enum:
      - cdns,sky1-i2s-mc

  reg:
    maxItems: 1

  interrupts:
    maxItems: 1

  clocks:
    minItems: 2
    maxItems: 3
    items:
      - description: APB clock is used to provide synchronization of the design’s APB slave
                     interface with external APB master (at the SoC level).
                     The following modules are clocked by hst clock:
                             - U_CDNSI2SSC_APB_SLAVE
                             - U_CDNSI2SSC_SFR
                             - U_CDNSI2SSC_FIFO_RX_APB
                             - U_CDNSI2SSC_FIFO_TX_APB
      - description: The main clock for synchronous logic in I2S transceiver.
                     The following modules are clocked by i2s clock:
                             - U_CDNSI2SMC_TRX_CHNx
                             - U_CDNSI2SMC_RX_CTRL
                             - U_CDNSI2SMC_TX_CTRL
                             - U_CDNSI2SMC_RX_FIFO_I2S
                             - U_CDNSI2SMC_TX_FIFO_I2S
      - description: master clock feeding external codec

  clock-names:
    minItems: 2
    maxItems: 3
    items:
      - const: hst
      - const: i2s
      - const: mclk

  dmas:
    items:
      - description: audio playback dma
      - description: audio capture dma

  dma-names:
    items:
      - const: tx
      - const: rx

  cdns,pin-out-num:
    description: The number of pins brought out by the SoC.
      $ref: /schemas/types.yaml#/definitions/uint8
      minimum: 1
      maximum: 8

  cdns,pin-tx-mask:
    description: |
      Transmit direction pin mask, if a bit is set the corresponding pin masked
      as transmitter.
    $ref: /schemas/types.yaml#/definitions/uint8

  cdns,pin-rx-mask:
    description: |
      Receive direction pin mask, if a bit is set the corresponding pin masked
      as receiver.
    $ref: /schemas/types.yaml#/definitions/uint8

  cdns,cru-ctrl:
    description: Phandle to syscon block which provide access to Clock Reset Unit.

  cdns,mclk-idx:
    description: The index of mclk if mclk is present.

  "#sound-dai-cells":
    const: 1

required:
  - compatible
  - reg
  - interrupts
  - clocks
  - clock-names
  - dmas
  - dma-names
  - cdns,pin-out-num
  - cdns,pin-tx-mask
  - cdns,pin-rx-mask
  - cdns,mclk-idx
  - "#sound-dai-cells"

additionalProperties: false

examples:
  - |
    #include <dt-bindings/interrupt-controller/irq.h>
    i2s_mc0: i2s@03040000 {
      compatible = "cdns,sky1-i2s-mc";
      reg = <0x0 0x03040000 0x0 0x10000>;
      interrupts = <GIC_SPI 88 IRQ_TYPE_LEVEL_HIGH>;
      clocks = <&clks 1>, <&clks 2>, <&clks 3>;
      clock-names = "hst", "i2s", "mclk";
      dmas = <&dma>, <&dma>;
      dma-names = "tx", "rx";
      cdns,pin-out-num = /bits/ 8 <8>;
      cdns,pin-tx-mask = /bits/ 8 <15>; /* 0x0f, pin0-pin3 works as transmitter */
      cdns,pin-rx-mask = /bits/ 8 <240>; /* 0xf0, pin4-pin7 works as receiver */
      #sound-dai-cells = <1>;
    }
```

## Documentation/devicetree/bindings/sound/cdns,i2s-sc.yaml
```yaml
# SPDX-License-Identifier: (GPL-2.0-only OR BSD-2-Clause)
%YAML 1.2
---
$id: http://devicetree.org/schemas/sound/cdns,i2s-sc.yaml#
$schema: http://devicetree.org/meta-schemas/core.yaml#

title:
  Cadence I2S-SC (SingleChannel) Controller Driver

maintainers:
  - Joakim Zhang <joakim.zhang@cixtech.com>

properties:
  compatible:
    enum:
      - cdns,sky1-i2s-sc

  reg:
    maxItems: 1

  interrupts:
    maxItems: 1

  clocks:
    minItems: 2
    maxItems: 3
    items:
      - description: APB clock is used to provide synchronization of the design’s APB slave
                     interface with external APB master (at the SoC level).
                     The following modules are clocked by hst clock:
                             - U_CDNSI2SSC_APB_SLAVE
                             - U_CDNSI2SSC_SFR
                             - U_CDNSI2SSC_FIFO_RX_APB
                             - U_CDNSI2SSC_FIFO_TX_APB
      - description: The main clock for synchronous logic in I2S transceiver.
                     The following modules are clocked by i2s clock:
                             - U_CDNSI2SSC_TRX_CTRL
                             - U_CDNSI2SSC_RX_DATA
                             - U_CDNSI2SSC_TX_DATA
                             - U_CDNSI2SSC_FIFO_RX_I2S
                             - U_CDNSI2SSC_FIFO_TX_I2S
      - description: master clock feeding external codec

  clock-names:
    minItems: 2
    maxItems: 3
    items:
      - const: hst
      - const: i2s
      - const: mclk

  dmas:
    items:
      - description: audio playback dma
      - description: audio capture dma

  dma-names:
    items:
      - const: tx
      - const: rx

  cdns,cru-ctrl:
    description: Phandle to syscon block which provide access to Clock Reset Unit.

  cdns,mclk-idx:
    description: The index of mclk if mclk is present.

  "#sound-dai-cells":
    const: 0

required:
  - compatible
  - reg
  - interrupts
  - clocks
  - clock-names
  - dmas
  - dma-names
  - cdns,mclk-idx
  - "#sound-dai-cells"

additionalProperties: false

examples:
  - |
    #include <dt-bindings/interrupt-controller/irq.h>
    i2s_sc0: i2s@03010000 {
      compatible = "cdns,sky1-i2s-sc";
      reg = <0x0 0x03010000 0x0 0x10000>;
      interrupts = <GIC_SPI 88 IRQ_TYPE_LEVEL_HIGH>;
      clocks = <&clks 1>, <&clks 2>, <&clks 3>;
      clock-names = "hst", "i2s", "mclk";
      dmas = <&dma>, <&dma>;
      dma-names = "tx", "rx";
      #sound-dai-cells = <0>;
    }
```

## Documentation/devicetree/bindings/sound/cix,sky1-card.yaml
```yaml
# SPDX-License-Identifier: GPL-2.0
%YAML 1.2
---
$id: http://devicetree.org/schemas/sound/cux,sky1-card.yaml#
$schema: http://devicetree.org/meta-schemas/core.yaml#

title: CIX, sky1 sound card

maintainers:
  - Xing Wang <xing.wang@cixtech.com>

properties:
  compatible:
    items:
      - const: cix,sky1-sound-card

  model:
    $ref: /schemas/types.yaml#/definitions/string
    description: User specified audio sound card name

patternProperties:
  "dai link name":
    type: object
    description: |-
      dai-link child nodes, for i2s sc0~3, i2s mc , hda
        Container for dai-link properties, cpu and codec sub-nodes.
        There should be at least one (and probably more) subnode of this type

    patternProperties:
      "cpu":
        type: object
        description: |-
          cpus:
          cpu dai node

        properties:
          sound-dai:
            $ref: /schemas/types.yaml#/definitions/phandle-array
            description: phandle of the CPU DAI

        required:
          - sound-dai

    patternProperties:
      "codec":
        type: object
        description: |-
          codec:
          codec dai node

        properties:
          sound-dai:
            $ref: /schemas/types.yaml#/definitions/phandle-array
            description: phandle of the Codec DAI

        required:
          - sound-dai

required:
  - model
  - dai link name

examples:
  - |
    sound {
            compatible = "cix,sky1-sound-card";
            model = "cix,sky1";
            status = "okay";

            i2s-sc0 {
                    cpu {
                            sound-dai = <&i2s_sc0>;
                    };
                    codec {
                            sound-dai = <&codec>;
                    };
            };
    }
```

## Documentation/devicetree/bindings/sound/ipbloq,hda.yaml
```yaml
# SPDX-License-Identifier: (GPL-2.0-only OR BSD-2-Clause)
%YAML 1.2
---
$id: http://devicetree.org/schemas/sound/ipbloq,hda.yaml#
$schema: http://devicetree.org/meta-schemas/core.yaml#

title:
  IPBloq HDA Controller Driver

maintainers:
  - Xing Wang <xing.wang@cixtech.com>

properties:
  compatible:
    enum:
      - ipbloq,hda

  reg:
    maxItems: 1

  interrupts:
    maxItems: 1

  clocks:
    minItems: 3
    maxItems: 3
    items:
      - description: sysclk for APB clock
      - description: The 48m clock for synchronous logic.
      - description: reset clock

  clock-names:
    minItems: 3
    maxItems: 3
    items:
      - const: sysclk
      - const: clk48m
      - const: clkrst

  "#sound-dai-cells":
    const: 0

required:
  - compatible
  - reg
  - interrupts
  - clocks
  - clock-names
  - "#sound-dai-cells"

additionalProperties: false

examples:
  - |
    ipb_hda: ipb-hda@70b0000 {
      compatible = "ipbloq, hda";
      reg = <0x0 0x700b0000 0x0 0x10000>;
      #sound-dai-cells = <0>;
      status = "disabled";
    };
```

## Documentation/devicetree/bindings/timer/timer-sky1-gpt.yaml
```yaml
# SPDX-License-Identifier: (GPL-2.0-only OR BSD-2-Clause)
%YAML 1.2
---
$id: http://devicetree.org/schemas/timer/ksy1-timer.yaml#
$schema: http://devicetree.org/meta-schemas/core.yaml#

title: Cixtech General Purpose Timer (GPT)

maintainers:
  - Jerry.Zhu <Jerry.Zhu@cixtech.com>

description:
    This is a simple driver for the sky1 general purpose timer.
    The general purpose timer is configured(freerunning mode)
    as a 64-bit incrementing counter with an auto-incrementing feature.
    It continues incrementing after sending interrupts. The gpt timer
    is used after system start.

properties:
  compatible:
      - const: cix,sky1-gpt

  reg:
    maxItems: 1

  interrupts:
    maxItems: 1

  clocks:
    maxItems: 1

  clock-names:
    maxItems: 1

required:
  - compatible
  - reg
  - interrupts
  - clocks
  - clock-names

additionalProperties: false

examples:
  - |
    #include <dt-bindings/clock/sky1-clock.h> /* TBD */
    
    timer: timer@16001000 {
          compatible = "cix,sky1-gpt";
          reg = <0x0 0x16001000 0x0 0x10000>;
          interrupts = <GIC_SPI 176 IRQ_TYPE_LEVEL_HIGH>;
          clocks = <dumy>;
          clock-names = "soc_apb";
          status = "disabled"
    };
```

## Documentation/devicetree/bindings/usb/allwinner,dwc3.txt
```
Allwinner SuperSpeed DWC3 USB SoC controller

Required properties:
- compatible:	should contain "allwinner,sun50i-h6-dwc3" for H6 SoC
- clocks:	A list of phandle + clock-specifier pairs for the
		clocks listed in clock-names
- clock-names:	Should contain the following:
  "bus"		The bus clock of the DWC3 part
- resets:	A list of phandle + reset-specifier pairs for the
		resets listed in reset-names
- reset-names:	Should contain the following:
  "bus"		The bus reset of the DWC3 part

Required child node:
A child node must exist to represent the core DWC3 IP block. The name of
the node is not important. The content of the node is defined in dwc3.txt.

Phy documentation is provided in the following places:
Documentation/devicetree/bindings/phy/sun50i-usb3-phy.txt

Example device nodes:
	usb3: usb@5200000 {
		compatible = "allwinner,sun50i-h6-dwc3";
		#address-cells = <1>;
		#size-cells = <1>;
		ranges;
		clocks = <&ccu CLK_BUS_XHCI>;
		clock-names = "bus";
		resets = <&ccu RST_BUS_XHCI>;
		reset-names = "bus";

		dwc3: dwc3 {
			compatible = "snps,dwc3";
			reg = <0x5200000 0x10000>;
			interrupts = <GIC_SPI 26 IRQ_TYPE_LEVEL_HIGH>;
			phys = <&usb3phy>;
			phy-names = "usb3-phy";
		};
	};
```

## Documentation/devicetree/bindings/watchdog/sky1-watchdog.yaml
```yaml
# SPDX-License-Identifier: (GPL-2.0 OR BSD-2-Clause)
%YAML 1.2
---
$id: http://devicetree.org/schemas/watchdog/sky1-watchdog.yaml#
$schema: http://devicetree.org/meta-schemas/core.yaml#

title: Cixtech Sky1 Watchdog Timer (WDT) Controller

maintainers:
  - Jerry Zhu <Jerry.Zhu@cixtech.com>

description:
    The cix watchdog meets arm systemready requirement, and
    is used in sky1 board for global reset. The watchdog
    has two output signals ws0 and ws1. If ws0 is asserted and
    timeout refresh occurs, ws1 is asserted.

properties:
  compatible:
    const: cix,sky1-wdt

  reg:
    maxItems: 1

  interrupts:
    maxItems: 1

  clocks:
    maxItems: 1

required:
  - compatible
  - reg
  - interrupts
  - clocks

unevaluatedProperties: false

examples:
  - |
    #include <dt-bindings/interrupt-controller/arm-gic.h>

    watchdog: watchdog@16003000 {
        compatible = "cix,sky1-wdt";
        reg = <0x0 0x16003000 0x0 0x10000>;
	interrupts = <GIC_SPI 175 IRQ_TYPE_LEVEL_HIGH>;
	//clocks = < >; /* TBD */
	status = "okay";
    };
```
