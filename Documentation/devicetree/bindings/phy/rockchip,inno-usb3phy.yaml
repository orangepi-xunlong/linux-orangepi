## bsp/drivers/sound/codecs/Kconfig
```kconfig
# SPDX-License-Identifier: GPL-2.0-or-later
#
# Allwinner audio codecs driver Kconfig
#
# Copyright(c) 2022-2027 Allwinnertech Co., Ltd.

menu "CODEC drivers"

config SND_SOC_AC101
	tristate "Allwinner AC101 CODEC"
	depends on I2C
	default n
	help
	  Enable support for the Allwinner AC101 CODEC.
	  The device provides a I2S/TDM/PDM interface for audio data
	  and a standard I2C interface for control data communication.
	  Select this if your sound card has AC101.

config SND_SOC_AC101B
	tristate "Allwinner AC101B CODEC"
	depends on I2C
	default n
	help
	  Enable support for the Allwinner AC101B CODEC.
	  The device provides a I2S/TDM/PDM interface for audio data
	  and a standard I2C interface for control data communication.
	  Select this if your sound card has AC101B.

config SND_SOC_AC107
	tristate "Allwinner AC107 CODEC"
	depends on I2C
	default n
	help
	  Enable support for the Allwinner AC107 CODEC.
	  The device provides a I2S/TDM/PDM interface for audio data
	  and a standard I2C interface for control data communication.
	  Select this if your sound card has AC107.

config SND_SOC_AC108
	tristate "Allwinner AC108 CODEC"
	depends on I2C
	default n
	help
	  Enable support for the Allwinner AC108 CODEC.
	  The device provides a I2S/TDM/PDM interface for audio data
	  and a standard I2C interface for control data communication.
	  Select this if your sound card has AC108.

config SND_SOC_FS16XX
	tristate "SoC Audio for FourSemi FS1894SU PA"
	depends on I2C
	default n
	help
	  This option enables support for FourSemi PA.
	  The device supports a I2S interface for audio data
	  and a standard I2C interface for control data communication.
	  Select this if your sound card has FourSemi FS1894SU PA.

config SND_SOC_ES8323
        tristate "Everest Semi ES8323 CODEC"
        depends on I2C

endmenu
```

## drivers/clk/ky/Kconfig
```kconfig
# SPDX-License-Identifier: GPL-2.0
# common clock support for KY SoC family.

config KY_X1PRO_CCU
	tristate "Clock support for Ky x1pro SoCs"
	depends on SOC_KY_X1PRO
	help
	  Build the driver for X1pro Clock Driver.

config KY_X1_CCU
        tristate "Clock support for Ky x1 SoCs"
        depends on SOC_KY_X1
        help
          Build the driver for Ky X1x Clock Driver.
```

## drivers/crypto/ky/Kconfig
```kconfig
# SPDX-License-Identifier: GPL-2.0

config KY_REE_ENGINE
	tristate "KY REE Crypto Engine"
	depends on SOC_KY_X1
	default n
	help
	  Support KY REE Crypto Engine.

config KY_REE_AES
        tristate "Enable AES in KY REE Crytpo Engine"
        depends on KY_REE_ENGINE
        default n
        help
          Support AES using KY REE Crypto Engine.

config KY_CRYPTO_DEBUG
	tristate "Enable KY REE Crytpo Engine Debug Interface"
        depends on KY_REE_ENGINE
        default n
        help
	  Enable ky crypto engine debug interface in userspace

config KY_CRYPTO_SELF_TEST
	tristate "Enable KY REE Crytpo Engine Selftest"
	depends on KY_REE_ENGINE
	default n
	help
	  KY REE Crypto Engine support selftest when probe
```

## drivers/gpu/drm/ky/Kconfig
```kconfig
# SPDX-License-Identifier: GPL-2.0

config DRM_KY
	tristate "DRM Support for Ky"
	select DRM
	select DRM_KMS_HELPER
	select DRM_GEM_CMA_HELPER
	select DRM_KMS_CMA_HELPER
	select DRM_MIPI_DSI
	select DRM_PANEL
	select VIDEOMODE_HELPERS
	select BACKLIGHT_CLASS_DEVICE
	select GKI_FIX_WORKAROUND if DRM_KY=m
	default n
	help
	  Choose this option if you have a Ky soc chipsets.
	  This driver provides Ky kernel mode
	  setting and buffer management. If M is selected the module will be called ky-drm.

config KY_MIPI_PANEL
	tristate "MIPI Panel Support For Ky"
	depends on DRM_KY

config KY_HDMI
	tristate "HDMI Support For Ky"
	depends on DRM_KY

config DRM_LT8911EXB
	tristate "Lontium LT8911EXB DSI to eDP"
	default y
	depends on DRM_KY
	select DRM_KMS_HELPER
	select REGMAP_I2C
	select DRM_PANEL
	select DRM_MIPI_DSI
	select AUXILIARY_BUS
	select DRM_DP_AUX_BUS

	help
	  Support for Lontium LT8911EXB DSI to eDP driver.

config DRM_LT9711
	tristate "Lontium LT9711 DSI to DP"
	default y
	depends on DRM_KY
	select DRM_KMS_HELPER
	select REGMAP_I2C
	select DRM_PANEL
	select DRM_MIPI_DSI
	select AUXILIARY_BUS
	select DRM_DP_AUX_BUS

	help
	  Support for Lontium LT9711 DSI to eDP driver.
```

## drivers/media/platform/ky/Kconfig
```kconfig
# SPDX-License-Identifier: GPL-2.0-only

comment "Ky media platform drivers"

source "drivers/media/platform/ky/vpu_x1/Kconfig"
source "drivers/media/platform/ky/camera/Kconfig"
source "drivers/media/platform/ky/virtual_camera/Kconfig"
```

## drivers/media/platform/ky/camera/Kconfig
```kconfig
# SPDX-License-Identifier: GPL-2.0
#
# KY X1 camera configuration
#

comment "KY X1 Camera And Video V2"

menuconfig KY_X1_CAMERA_V2
    tristate "KY X1 camera and video capture V2 support"
	select MEDIA_CONTROLLER
	select VIDEO_V4L2_SUBDEV_API
    help
	  Say Y here to enable selecting the video adapters for
	  KY X1 camera and video v2

config KY_X1_CCIC_V2
    tristate "KY X1 CCIC V2 support"
    depends on KY_X1_CAMERA_V2
    help
      Enable support for ccic v2

config KY_X1_VI_V2
    tristate "KY X1 VI V2 support"
    select VIDEOBUF2_CORE
    select VIDEOBUF2_V4L2
    select VIDEOBUF2_DMA_CONTIG
    select VIDEOBUF2_DMA_SG
    select KY_X1_CCIC_V2
    depends on KY_X1_CAMERA_V2
    help
      Enable support for vi

config KY_X1_VI_IOMMU
	bool "KY X1 VI IOMMU support"
	depends on KY_X1_VI_V2
    help
      Enable support for vi iommu


config KY_X1_ISP_V2
    tristate "KY X1 ISP V2 support"
    depends on KY_X1_CAMERA_V2
    help
      Enable support for isp v2

config KY_X1_CPP_V2
    tristate "KY X1 CPP V2 support"
    depends on KY_X1_CAMERA_V2
    help
      Enable support for cpp v2

config KY_X1_SENSOR_V2
    tristate "KY X1 SENSOR V2 support"
    depends on KY_X1_CAMERA_V2 && I2C
    help
      Enable support for sensor v2
```

## drivers/media/platform/ky/virtual_camera/Kconfig
```kconfig
# SPDX-License-Identifier: GPL-2.0
#
# KY X1 camera configuration
#

comment "KY X1 Virtual Camera Driver"

menuconfig KY_X1_VIR_CAMERA
    tristate "KY X1 virtual camera support"
	select MEDIA_CONTROLLER
	select VIDEO_V4L2_SUBDEV_API
    help
	  Say Y here to enable selecting the video adapters for
	  KY X1 virtual camera and video v2

config KY_X1_VIR_CAMERA
    tristate "KY X1 VIRTUAL CAMERA support"
    select VIDEOBUF2_CORE
    select VIDEOBUF2_V4L2
    select VIDEOBUF2_DMA_CONTIG
    select VIDEOBUF2_DMA_SG
    select KY_X1_CCIC_V2
    depends on KY_X1_CAMERA_V2
    help
      Enable support for ky virtual camera
```

## drivers/media/platform/ky/vpu_x1/Kconfig
```kconfig
config VIDEO_LINLON_X1
	tristate "Linlon VPU support."
	depends on VIDEO_DEV && SOC_KY_X1
#	depends on VIDEO_V4L2
	select VIDEOBUF2_VMALLOC
	select VIDEOBUF2_CORE
	select DMA_SHARED_BUFFER
	select VIDEOBUF2_MEMOPS
	select VIDEOBUF2_DMA_SG
	default n
	help
	  This enables support for the Linlon VPU family.

config VIDEO_LINLON_FTRACE_X1
	depends on VIDEO_LINLON_X1
	bool "Send kernel space logs to ftrace."
	default n
	help
	  Send kernel space logs to ftrace.

config VIDEO_LINLON_PRINT_FILE_X1
	depends on VIDEO_LINLON_X1
	bool "Append file and line number to kernel space log messages."
	default y
	help
	  Append file and line number to kernel space log messages.
```

## drivers/media/platform/soph/sensor/Kconfig
```kconfig
# SPDX-License-Identifier: GPL-2.0-only
config VIDEO_SOPHGO_SENSOR
	bool "Sophgo Sensor Devices"
	help
	  If you have sensor device designed by Sophgo, say Y.

	  Note that this option doesn't include new drivers in the kernel:
	  saying N will just cause Kconfig to skip all the questions about
	  Sophgo sensor devices.

config SENSOR_V4L2_IMX585
	depends on VIDEO_V4L2 && I2C
	tristate "imx585 support"
	default n
	help
	  Support for Sensor on the CV186X SoC.

config SENSOR_V4L2_IMX307
	depends on VIDEO_V4L2 && I2C
	tristate "imx307 support"
	default n
	help
	  Support for Sensor on the CV186X SoC.

config SENSOR_V4L2_IMX327
	depends on VIDEO_V4L2 && I2C
	tristate "imx327 support"
	default n
	help
	  Support for Sensor on the CV186X SoC.

config SENSOR_V4L2_IMX412
	depends on VIDEO_V4L2 && I2C
	tristate "imx412 support"
	default n
	help
	  Support for Sensor on the CV186X SoC.

config SENSOR_V4L2_IMX415
	depends on VIDEO_V4L2 && I2C
	tristate "sony_imx415 support"
	default n
	help
	  Support for Sensor on the CV186X SoC.

config SENSOR_V4L2_IMX900
	depends on VIDEO_V4L2 && I2C
	tristate "imx900 support"
	default n
	help
	  Support for Sensor on the CV186X SoC.

config SENSOR_V4L2_LT6911
	depends on VIDEO_V4L2 && I2C
	tristate "lt6911 support"
	default n
	help
	  Support for Sensor on the CV186X SoC.

config SENSOR_V4L2_OS04A10
	depends on VIDEO_V4L2 && I2C
	tristate "os04a10 support"
	default n
	help
	  Support for Sensor on the CV186X SoC.

config SENSOR_V4L2_OS04E10
	depends on VIDEO_V4L2 && I2C
	tristate "os04e10 support"
	default n
	help
	  Support for Sensor on the CV186X SoC.

config SENSOR_V4L2_OS08B10
	depends on VIDEO_V4L2 && I2C
	tristate "os08b10 support"
	default n
	help
	  Support for Sensor on the Athena2 SoC.

config SENSOR_V4L2_GC4653
	depends on VIDEO_V4L2 && I2C
	tristate "gc4653 support"
	default n
	help
	  Support for Sensor on the CV186X SoC.

config SENSOR_V4L2_PR2100
	depends on VIDEO_V4L2 && I2C
	tristate "pr2100 support"
	default n
	help
	  Support for Sensor on the CV186X SoC.

config SENSOR_V4L2_AR2020
	depends on VIDEO_V4L2 && I2C
	tristate "ar2020 support"
	default n
	help
	  Support for Sensor on the CV186X SoC.

config SENSOR_V4L2_NC021
	depends on VIDEO_V4L2 && I2C
	tristate "nc021 support"
	default n
	help
	  Support for Sensor on the CV186X SoC.

config SENSOR_V4L2_OV13855
	depends on VIDEO_V4L2 && I2C
	tristate "ov_ov13855 support"
	default n
	help
	  Support for Sensor on the CV186X SoC.

config SENSOR_V4L2_OV13850
	depends on VIDEO_V4L2 && I2C
	tristate "ov_ov13850 support"
	default n
	help
	  Support for Sensor on the CV186X SoC.
```

## drivers/net/ethercat/device/Kconfig
```kconfig
# SPDX-License-Identifier: GPL-2.0-only
#
# Ethercat device configuration
#

config EC_GENERIC
	tristate "Ethercat generic device driver support"
	depends on ETHERCAT
	default n
	help
	  generic native ethercat device driver support.

config EC_X1_EMAC
	tristate "x1 native thercat device driver support"
	depends on ETHERCAT
	default n
	help
	  Ethercat generic device driver support.
```

## drivers/net/ethernet/ky/Kconfig
```kconfig
config NET_VENDOR_KY
	bool "Ky devices"
	default y
	depends on SOC_KY
	help
	  If you have a network (Ethernet) chipset belonging to this class,
	  say Y.

	  Note that the answer to this question does not directly affect
	  the kernel: saying N will just cause the configurator to skip all
	  the questions regarding Ky chipsets. If you say Y, you will
	  be asked for your specific chipset/driver in the following questions.

if NET_VENDOR_KY

config X1_EMAC
	bool "x1 Emac Driver"
	depends on SOC_KY_X1
	select PHYLIB
	help
	  This Driver support Ky x1-x Ethernet MAC
	  Say Y to enable support for the Ky Ethernet.

endif # NET_VENDOR_KY
```

## drivers/phy/ky/Kconfig
```kconfig
# SPDX-License-Identifier: GPL-2.0
#
# Phy drivers for Ky platforms
#
config PHY_KY_X1_COMBPHY
	tristate "Ky X1-x USB3&PCIE combo PHY driver"
	depends on OF
	select GENERIC_PHY
	default SOC_KY_X1 && USB_DWC3_KY
	help
	  USB3 and PCIE Combo PHY Support for Ky x1-x Soc
```

## drivers/pinctrl/ky/Kconfig
```kconfig
# SPDX-License-Identifier: GPL-2.0-only
config PINCTRL_KY
	tristate
	depends on OF
	select GENERIC_PINCTRL_GROUPS
	select GENERIC_PINMUX_FUNCTIONS
	select GENERIC_PINCONF

config PINCTRL_X1PRO
	bool "Ky X1PRO pinctrl driver"
	depends on OF
	depends on SOC_KY_X1_FPGA
	select PINCTRL_KY
	help
	  Say Y here to enable the x1-pro pinctrl driver
```

## drivers/soc/ky/Kconfig
```kconfig
# SPDX-License-Identifier: GPL-2.0-only
if SOC_KY

#
# ky Soc drivers
#
config KY_PM_DOMAINS
	bool "Ky generic power domain"
	depends on PM
	select PM_GENERIC_DOMAINS
	help
	  Say y here to enable power domain support.
	  In order to meet high performance and low power requirements, a power
	  management unit is designed or saving power.

endif

config KY_REBOOT_CONTROL
	tristate "Ky x1 reboot handler"
	depends on SOC_KY_X1
	help
	  Ky reboot into fastboot mode

config KY_LID_CONTROL
	tristate "Ky lid control"
	depends on SOC_KY_X1
	help
	  Ky screen lid control

config KY_X1_DMA_RANGE
	tristate "Ky dram range driver for x1"
	depends on SOC_KY_X1
	help
	  This driver is an empty shell, in order to make the dma-ranges function
          effective

config KY_SOCINFO
	tristate "Socinfo driver for ky SoCs"
	depends on SOC_KY && NVMEM_KY_EFUSE
	select MFD_SYSCON
	select SOC_BUS
	help
	  Ky SoCs information driver, which get information from efuse and
	  report to userspace.

config KY_DDRBW
	tristate "ddr_bw driver for ky x1 soc"
	depends on SOC_KY_X1
	help
	  Ky x1 soc ddrbw driver.

source "drivers/soc/ky/jpu/Kconfig"
source "drivers/soc/ky/v2d/Kconfig"
source "drivers/soc/ky/ky-rf/Kconfig"
```

## drivers/soc/ky/ky-rf/Kconfig
```kconfig
#
# Ky rfkill driver.
#
config KY_RFKILL
  tristate "Ky rfkill driver"
  depends on WIRELESS || RFKILL
  help
    Ky rfkill driver
```

## drivers/soc/ky/v2d/Kconfig
```kconfig
# SPDX-License-Identifier: GPL-2.0
config KY_V2D
        tristate "Ky V2D Engine Driver"
        depends on SYNC_FILE
        default m
        help
          This enables Ky V2D Engine driver
```

## sound/soc/ky/Kconfig
```kconfig
config SND_SOC_KY
	tristate "SoC Audio for KY System-on-Chip"
	select SND_SOC_COMPRESS
	select SND_SOC_GENERIC_DMAENGINE_PCM if (SND_SOC && SND)
	help
	  Say Y or N here if you want support for audio on KY SoC.

config KY_CARD
        tristate "Audio Simple Card"
        depends on SND_SOC_KY
        help
          Say Y or M here if you want to enable audio data dump function

config KY_PCM
        tristate "Audio Platform Pcm"
        depends on SND_SOC_KY
        help
          Say Y or M here if you want to enable audio data dump function

config KY_I2S
        tristate "Audio Cpudai I2S"
        depends on SND_SOC_KY
        help
          Say Y or M here if you want to enable audio data dump function

config KY_HDMIAUDIO
        tristate "Audio Cpudai HDMI Audio"
        depends on SND_SOC_KY && KY_HDMI
        help
          Say Y or M here if you want to enable audio data dump function

config KY_DUMMYCODEC
        tristate "Audio CodecDai Dummy Codec"
        depends on SND_SOC_KY
        help
          Say Y or M here if you want to enable audio data dump function

config KY_AUDIO_DATA_DEBUG
        bool "Audio Data Dump"
        depends on SND_SOC_KY
        help
          Say Y or N here if you want to enable audio data dump function

config KY_PLAY_DEBUG
        bool "Audio Playback Debug"
        depends on KY_AUDIO_DATA_DEBUG
        help
          Say Y or N here if you want to open playback debug

config KY_CAPT_DEBUG
        bool "Audio Capture Debug"
        depends on KY_AUDIO_DATA_DEBUG
        help
          Say Y or N here if you want to open capture debug

config  ADD_WAV_HEADER
        bool "Dump File Adds Wave Header"
        depends on KY_AUDIO_DATA_DEBUG
        help
          Say Y or N here if you want to add wave header to dump file
```
