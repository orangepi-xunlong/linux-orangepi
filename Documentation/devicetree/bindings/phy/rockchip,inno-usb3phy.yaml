## Documentation/devicetree/bindings/phy/rockchip,inno-usb3phy.yaml
```yaml
# SPDX-License-Identifier: GPL-2.0-only
%YAML 1.2
---
$id: http://devicetree.org/schemas/phy/rockchip,inno-usb3phy.yaml#
$schema: http://devicetree.org/meta-schemas/core.yaml#

title: Rockchip USB 3.0 phy with Innosilicon IP block

maintainers:
  - Heiko Stuebner <heiko@sntech.de>

properties:
  compatible:
    enum:
      - rockchip,rk3328-usb3phy

  reg:
    maxItems: 1

  clocks:
    minItems: 3
    maxItems: 3

  clock-names:
    items:
      - const: refclk-usb3otg
      - const: usb3phy-otg
      - const: usb3phy-pipe

  interrupts:
    minItems: 4

  interrupt-names:
    items:
      - const: bvalid
      - const: id
      - const: linestate
      - const: rxdet

  resets:
    minItems: 6

  reset-names:
    items:
      - const: usb3phy-u2-por
      - const: usb3phy-u3-por
      - const: usb3phy-pipe-mac
      - const: usb3phy-utmi-mac
      - const: usb3phy-utmi-apb
      - const: usb3phy-pipe-apb

  "#address-cells":
    const: 2

  "#size-cells":
    const: 2

  ranges: true

patternProperties:

  utmi-port@[0-9a-f]+$:
    type: object
    additionalProperties: false

    properties:
      compatible:
        enum:
          - rockchip,rk3328-usb3phy-utmi

      reg:
        maxItems: 1

      "#phy-cells":
        const: 0

      phy-supply:
        description:
          Phandle to a regulator that provides power to VBUS.
          See ./phy-bindings.txt for details.

    required:
      - compatible
      - reg
      - "#phy-cells"

  pipe-port@[0-9a-f]+$:
    type: object
    additionalProperties: false

    properties:
      compatible:
        enum:
          - rockchip,rk3328-usb3phy-pipe

      reg:
        maxItems: 1

      "#phy-cells":
        const: 0

      phy-supply:
        description:
          Phandle to a regulator that provides power to VBUS.
          See ./phy-bindings.txt for details.

    required:
      - compatible
      - reg
      - "#phy-cells"

required:
  - compatible
  - reg
  - clocks
  - clock-names
  - interrupts
  - interrupt-names
  - resets
  - reset-names

additionalProperties: false

examples:
  - |
    #include <dt-bindings/clock/rk3328-cru.h>
    #include <dt-bindings/interrupt-controller/arm-gic.h>
    #include <dt-bindings/interrupt-controller/irq.h>
    soc {
      #address-cells = <2>;
      #size-cells = <2>;

      usb3phy: usb3-phy@ff460000 {
        compatible = "rockchip,rk3328-usb3phy";
        reg = <0x0 0xff460000 0x0 0x10000>;
        clocks = <&cru SCLK_REF_USB3OTG>, <&cru PCLK_USB3PHY_OTG>, <&cru PCLK_USB3PHY_PIPE>;
        clock-names = "refclk-usb3otg", "usb3phy-otg", "usb3phy-pipe";
        interrupts = <GIC_SPI 75 IRQ_TYPE_LEVEL_HIGH>, <GIC_SPI 76 IRQ_TYPE_LEVEL_HIGH>,
                     <GIC_SPI 77 IRQ_TYPE_LEVEL_HIGH>, <GIC_SPI 78 IRQ_TYPE_LEVEL_HIGH>;
        interrupt-names = "bvalid", "id", "linestate", "rxdet";
        resets = <&cru SRST_USB3PHY_U2>,
                 <&cru SRST_USB3PHY_U3>,
                 <&cru SRST_USB3PHY_PIPE>,
                 <&cru SRST_USB3OTG_UTMI>,
                 <&cru SRST_USB3PHY_OTG_P>,
                 <&cru SRST_USB3PHY_PIPE_P>;
        reset-names = "usb3phy-u2-por", "usb3phy-u3-por",
                      "usb3phy-pipe-mac", "usb3phy-utmi-mac",
                      "usb3phy-utmi-apb", "usb3phy-pipe-apb";
        #address-cells = <2>;
        #size-cells = <2>;
        ranges;

        usb3phy_utmi: utmi-port@ff470000 {
          compatible = "rockchip,rk3328-usb3phy-utmi";
          reg = <0x0 0xff470000 0x0 0x8000>;
          #phy-cells = <0>;
        };

        usb3phy_pipe: pipe-port@ff478000 {
          compatible = "rockchip,rk3328-usb3phy-pipe";
          reg = <0x0 0xff478000 0x0 0x8000>;
          #phy-cells = <0>;
        };
      };
    };
```

## arch/riscv/Kconfig.socs
```kconfig
menu "SoC selection"

config ARCH_MICROCHIP_POLARFIRE
	def_bool SOC_MICROCHIP_POLARFIRE

config SOC_MICROCHIP_POLARFIRE
	bool "Microchip PolarFire SoCs"
	help
	  This enables support for Microchip PolarFire SoC platforms.

config ARCH_RENESAS
	bool "Renesas RISC-V SoCs"
	help
	  This enables support for the RISC-V based Renesas SoCs.

config ARCH_SIFIVE
	def_bool SOC_SIFIVE

config SOC_SIFIVE
	bool "SiFive SoCs"
	select ERRATA_SIFIVE if !XIP_KERNEL
	help
	  This enables support for SiFive SoC platform hardware.

config ARCH_STARFIVE
	def_bool SOC_STARFIVE

config SOC_STARFIVE
	bool "StarFive SoCs"
	select PINCTRL
	select RESET_CONTROLLER
	select ARM_AMBA
	help
	  This enables support for StarFive SoC platform hardware.

config ARCH_SUNXI
	bool "Allwinner sun20i SoCs"
	depends on MMU && !XIP_KERNEL
	select ERRATA_THEAD
	select SUN4I_TIMER
	help
	  This enables support for Allwinner sun20i platform hardware,
	  including boards based on the D1 and D1s SoCs.

config ARCH_THEAD
	bool "T-HEAD RISC-V SoCs"
	depends on MMU && !XIP_KERNEL
	select ERRATA_THEAD
	help
	  This enables support for the RISC-V based T-HEAD SoCs.

config ARCH_VIRT
	def_bool SOC_VIRT

config SOC_VIRT
	bool "QEMU Virt Machine"
	select CLINT_TIMER if RISCV_M_MODE
	select POWER_RESET
	select POWER_RESET_SYSCON
	select POWER_RESET_SYSCON_POWEROFF
	select GOLDFISH
	select RTC_DRV_GOLDFISH if RTC_CLASS
	select PM_GENERIC_DOMAINS if PM
	select PM_GENERIC_DOMAINS_OF if PM && OF
	select RISCV_SBI_CPUIDLE if CPU_IDLE && RISCV_SBI
	help
	  This enables support for QEMU Virt Machine.

config ARCH_CANAAN
	def_bool SOC_CANAAN

config SOC_CANAAN
	bool "Canaan Kendryte K210 SoC"
	depends on !MMU
	select CLINT_TIMER if RISCV_M_MODE
	select ARCH_HAS_RESET_CONTROLLER
	select PINCTRL
	select COMMON_CLK
	help
	  This enables support for Canaan Kendryte K210 SoC platform hardware.

if ARCH_CANAAN

config ARCH_CANAAN_K210_DTB_BUILTIN
	def_bool SOC_CANAAN_K210_DTB_BUILTIN

config SOC_CANAAN_K210_DTB_BUILTIN
	bool "Builtin device tree for the Canaan Kendryte K210"
	depends on ARCH_CANAAN
	default y
	select OF
	select BUILTIN_DTB
	help
	  Build a device tree for the Kendryte K210 into the Linux image.
	  This option should be selected if no bootloader is being used.
	  If unsure, say Y.

config ARCH_CANAAN_K210_DTB_SOURCE
	string
	default SOC_CANAAN_K210_DTB_SOURCE

config SOC_CANAAN_K210_DTB_SOURCE
	string "Source file for the Canaan Kendryte K210 builtin DTB"
	depends on ARCH_CANAAN
	depends on ARCH_CANAAN_K210_DTB_BUILTIN
	default "k210_generic"
	help
	  Base name (without suffix, relative to arch/riscv/boot/dts/canaan)
	  for the DTS file that will be used to produce the DTB linked into the
	  kernel.

endif # ARCH_CANAAN

config SOC_KY
	bool "Ky SoCs"
	select SIFIVE_PLIC
	help
	  This enables support for Ky SoCs platform hardware.

if SOC_KY

choice
	prompt "Ky SOCs platform"
	help
	  choice Ky soc platform

	config SOC_KY_X1
		bool "x1"
		help
		  select Ky x1 Platform SOCs.
endchoice

config BIND_THREAD_TO_AICORES
	bool "enable bind ai cores when use AI instruction"
	default y
	help
	  This enable bind ai cores when use AI instruction.

config KY_ERRATA_LOAD_ATOMIC
	bool "enable issue fix which caused by readforward and writeback"
	depends on SOC_KY_X1
	default y
	help
	  This enable fix errata caused by readforward and writeback.

endif

endmenu # "SoC selection"
```

## bsp/drivers/Kconfig
```kconfig
# SPDX-License-Identifier: GPL-2.0-only

menu "Device Drivers"

# Minimal System
source "bsp/drivers/clk/Kconfig"
source "bsp/drivers/pinctrl/Kconfig"
source "bsp/drivers/uart/Kconfig"
source "bsp/drivers/timer/Kconfig"

# Basic System
source "bsp/drivers/dma/Kconfig"
source "bsp/drivers/rtc/Kconfig"
source "bsp/drivers/bus/Kconfig"
source "bsp/drivers/dumpreg/Kconfig"
source "bsp/drivers/watchdog/Kconfig"
source "bsp/drivers/iommu/Kconfig"
source "bsp/drivers/mbus/Kconfig"

# Storage
source "bsp/drivers/mmc/Kconfig"
source "bsp/drivers/ufs/Kconfig"
source "bsp/modules/nand/Kconfig"
source "bsp/drivers/mtd/Kconfig"
source "bsp/drivers/redeposit/Kconfig"

# Graphics
source "bsp/drivers/video/Kconfig"
source "bsp/drivers/g2d/Kconfig"
source "bsp/drivers/di/Kconfig"
source "bsp/drivers/vin/Kconfig"
source "bsp/drivers/vfe/Kconfig"
source "bsp/drivers/tvd/Kconfig"
source "bsp/drivers/drm/Kconfig"
source "bsp/drivers/gpu/Kconfig"
source "bsp/drivers/car_reverse/car_reverse_2_0/Kconfig"
source "bsp/drivers/car_reverse/car_reverse_amp/Kconfig"

# Multi-Media
source "bsp/drivers/ve/Kconfig"
source "bsp/drivers/rt-media/Kconfig"

# Audio
source "bsp/drivers/sound/Kconfig"

# Security
source "bsp/drivers/ce/Kconfig"
source "bsp/drivers/smc/Kconfig"
source "bsp/drivers/sid/Kconfig"
source "bsp/drivers/secure_storage/Kconfig"
source "bsp/drivers/drm_heap/Kconfig"

# I/O Connectivity
source "bsp/drivers/pcie/Kconfig"
source "bsp/drivers/phy/Kconfig"
source "bsp/drivers/emac/Kconfig"
source "bsp/drivers/gmac/Kconfig"
source "bsp/drivers/stmmac/Kconfig"
source "bsp/drivers/usb/Kconfig"
source "bsp/drivers/twi/Kconfig"
source "bsp/drivers/spi/Kconfig"
source "bsp/drivers/spi-ng/Kconfig"
source "bsp/drivers/ledc/Kconfig"
source "bsp/drivers/pwm/Kconfig"
source "bsp/drivers/ir-tx/Kconfig"
source "bsp/drivers/ir-rx/Kconfig"
source "bsp/drivers/gpadc/Kconfig"
source "bsp/drivers/lradc/Kconfig"
source "bsp/drivers/rtp/Kconfig"
source "bsp/drivers/input/Kconfig"
source "bsp/drivers/ata/Kconfig"
source "bsp/drivers/smartcard/Kconfig"
source "bsp/drivers/wiegand/Kconfig"

# Wireless
source "bsp/drivers/net/Kconfig"
source "bsp/drivers/bluetooth/Kconfig"

# Power Management
source "bsp/drivers/irqchip/Kconfig"
source "bsp/drivers/standby/Kconfig"
source "bsp/drivers/thermal/Kconfig"
source "bsp/drivers/nvmem/Kconfig"
source "bsp/drivers/pm_domain/Kconfig"
source "bsp/drivers/power/Kconfig"
source "bsp/drivers/cpufreq/Kconfig"
source "bsp/drivers/devfreq/Kconfig"
source "bsp/drivers/dsufreq/Kconfig"

# AMP/XPU
source "bsp/drivers/msgbox/Kconfig"
source "bsp/drivers/hwspinlock/Kconfig"
source "bsp/drivers/remoteproc/Kconfig"
source "bsp/drivers/rpmsg/Kconfig"
source "bsp/drivers/rpbuf/Kconfig"
source "bsp/drivers/npu/Kconfig"

# Misc
source "bsp/drivers/misc/Kconfig"
source "bsp/drivers/vendor_hooks/Kconfig"
source "bsp/drivers/aw_trace/Kconfig"

# Debugging
source "bsp/drivers/crashdump/Kconfig"
source "bsp/drivers/jtag/Kconfig"
source "bsp/drivers/debug/Kconfig"

# pstore
source "bsp/drivers/pstore/Kconfig"

# FS
source "bsp/drivers/fs/Kconfig"

#andes adaptor
source "bsp/drivers/andes_adaptor/Kconfig"

#awlink
source "bsp/drivers/awlink/Kconfig"

endmenu
```

## bsp/drivers/drm/Kconfig
```kconfig
# SPDX-License-Identifier: GPL-2.0-only
menu "DRM Drivers"
	depends on AW_BSP

config AW_DRM
	tristate "DRM Support for Allwinner SoCs"
	depends on DRM && AW_BSP
	select DRM_KMS_HELPER
	select DRM_KMS_CMA_HELPER
	select DRM_KMS_DMA_HELPER
	select DRM_GEM_DMA_HELPER
	select DRM_DISPLAY_HELPER
	select VIDEOMODE_HELPERS
	default n

config AW_DRM_DE
	bool "Support Sunxi Display_Engine(DE)"
	depends on AW_DRM
	default y
	help
		If you want use DE of Version 35X, select it.

# remove it after both tcon_lcd/tcon_tv ready?
config AW_DRM_TCON
	bool "Support Timing Controller(TCON)"
	depends on AW_DRM
	default y
	help
		If you want use TCON, select it.

config AW_DRM_BOOT_COLORBAR
	int "Boot which Colorbar when Kernel Boot."
	depends on AW_DRM_TCON
	default 0
	range 0 7
	help
		If you need Colobar in kernel boot, select it.

config AW_DRM_TCON_TV
	bool "Support Timing Controller(TCON_TV)"
	depends on AW_DRM
	default y
	help
		If you want use TCON_TV, select it.

config AW_DRM_TCON_TOP
	bool "Support TCON TOP"
	depends on AW_DRM
	default y
	help
		If you want use TCON TOP, select it.

config AW_DRM_LVDS
	bool "Support LVDS Output"
	depends on AW_DRM
	select GENERIC_PHY
	default n
	help
		If you want use lvds, select it.

config AW_DRM_RGB
	bool "Support RGB Output"
	depends on AW_DRM
	select GENERIC_PHY
	default n
	help
		If you want use rgb, select it.

config AW_DRM_DSI
	bool "Support DSI Output"
	depends on AW_DRM
	select DRM_MIPI_DSI
	select GENERIC_PHY
	select GENERIC_PHY_MIPI_DPHY
	default n
	help
		If you want lcd-dsi output for drm driver, select it.

config AW_DRM_HDMI_TX
	tristate "Support Hdmi Output"
	depends on AW_DRM
	select DRM_DISPLAY_HDCP_HELPER
	select DRM_DISPLAY_HDMI_HELPER
	default y
	help
		If you want hdmi output for drm driver, select it.

config AW_DRM_HDMI14
	bool "Support HDMI1.4 Output"
	depends on AW_DRM_HDMI_TX
	default n
	help
		If you want hdmi1.4 output for drm driver, select it.

config AW_DRM_HDMI20
	bool "Support HDMI2.0 Output"
	depends on AW_DRM_HDMI_TX
	default y
	select CEC_CORE
	select CEC_NOTIFIER
	help
		If you want hdmi2.0 output for drm driver, select it.

menuconfig AW_DRM_EDP
	bool "Support eDP Output"
	depends on AW_DRM
	select VIDEOMODE_HELPERS
	default n
	help
		If you want edp/dp output for drm driver, select it.

config AW_DRM_EDP_CONTROLLER_USED
    def_bool n
    depends on (AW_DRM_EDP)
    default n
    help
        Selected when aw edp phy used.

config AW_DRM_DP_HDCP
    def_bool n
	bool "Support HDCP For DisplayPort"
    depends on (AW_DRM_EDP)
    default n
    help
        Selected when hdcp need authenticate by software.

config AW_DRM_INNO_EDP13
	bool "Support inno edp 1.3 controller"
	depends on AW_DRM_EDP
    select AW_DRM_EDP_CONTROLLER_USED
    default n
	help
		If you want inno edp 1.3 as edp controller, select it.

config AW_DRM_TRILINEAR_EDP14
	bool "Support trilinear edp 1.4 controller"
	depends on AW_DRM_EDP
    select AW_DRM_EDP_CONTROLLER_USED
    select AW_DRM_DP_HDCP
	default n
	help
		If you want trilinear edp 1.4 as edp controller, select it.

menu "sunxi drm panels select"
	depends on AW_DRM
source "bsp/drivers/drm/panel/Kconfig"
endmenu
source "bsp/drivers/drm/phy/Kconfig"

endmenu
```

## bsp/drivers/npu/aw_nna_vip/Kconfig
```kconfig
# SPDX-License-Identifier: GPL-2.0

config AW_NNA_VIP
	depends on (ARCH_SUNXI)
	tristate "aw nna vip driver"
	default n
	select DMA_SHARED_BUFFER
	help
	 Choose Y to enable aw nna vip driver

choice
	prompt "Select driver version"
	depends on (AW_NNA_VIP)
	config NNA_VIP1
		bool "vip version 1"
		help
		 This is vip version 1
	config NNA_VIP2
		bool "vip version 2"
		help
		 This is vip version 2
endchoice

config NPU_USER_IOMMU
	depends on (AW_NNA_VIP)
	tristate "NPU Use IOMMU"
	default n
	help
	 Choose M to enable NPU Use IOMMU

config NPU_SET_CLK_VOL
	depends on (AW_NNA_VIP)
	tristate "NPU SET CLK VOL"
	default n
	help
	 Choose M to enable NPU Use IOMMU

#if NNA_VIP1
#source "bsp/drivers/npu/aw_nna_vip/vip1/Kconfig"
#endif

#if NNA_VIP2
#source "bsp/drivers/npu/aw_nna_vip/vip2/Kconfig"
#endif
```

## bsp/drivers/sound/Kconfig
```kconfig
# SPDX-License-Identifier: GPL-2.0-or-later
#
# Allwinner audio driver Kconfig
#
# Copyright(c) 2022-2027 Allwinnertech Co., Ltd.

menu "SOUND Drivers"
	depends on AW_BSP

if SND_SOC
	source "bsp/drivers/sound/codecs/Kconfig"
	source "bsp/drivers/sound/platform/Kconfig"
	source "bsp/drivers/sound/misc/Kconfig"
	source "bsp/drivers/sound/pa/Kconfig"
endif

endmenu
```
