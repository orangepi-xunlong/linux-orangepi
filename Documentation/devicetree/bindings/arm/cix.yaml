## Documentation/devicetree/bindings/arm/cix.yaml
```yaml
# SPDX-License-Identifier: GPL-2.0-only OR BSD-2-Clause
%YAML 1.2
---
$id: http://devicetree.org/schemas/arm/cix.yaml#
$schema: http://devicetree.org/meta-schemas/core.yaml#

title: Cixcomputing SoC series device tree bindings

maintainers:
  - fugang.duan <fugang.duan@cixcomputing.com>

properties:
  $nodename:
    const: "/"
  compatible:
    oneOf:
      - description: sky1 based Boards
        items:
          - enum:
              - cix,sky1-evk       # sky1 EVK Board
              - cix,sky1-batura    # sky1 BATURA Board
          - const: cix,sky1

additionalProperties: true

...
```

## Documentation/devicetree/bindings/arm/sunxi/allwinner,sun4i-a10-mbus.yaml
```yaml
# SPDX-License-Identifier: GPL-2.0
%YAML 1.2
---
$id: http://devicetree.org/schemas/arm/sunxi/allwinner,sun4i-a10-mbus.yaml#
$schema: http://devicetree.org/meta-schemas/core.yaml#

title: Allwinner Memory Bus (MBUS) controller

maintainers:
  - Chen-Yu Tsai <wens@csie.org>
  - Maxime Ripard <mripard@kernel.org>

description: |
  The MBUS controller drives the MBUS that other devices in the SoC
  will use to perform DMA. It also has a register interface that
  allows to monitor and control the bandwidth and priorities for
  masters on that bus.

  Each device having to perform their DMA through the MBUS must have
  the interconnects and interconnect-names properties set to the MBUS
  controller and with "dma-mem" as the interconnect name.

properties:
  "#interconnect-cells":
    const: 1
    description:
      The content of the cell is the MBUS ID.

  compatible:
    enum:
      - allwinner,sun5i-a13-mbus
      - allwinner,sun8i-h3-mbus
      - allwinner,sun8i-r40-mbus
      - allwinner,sun50i-a64-mbus

  reg:
    maxItems: 2

  reg-names:
    items:
      - "dram"
      - "mbus"

  clocks:
    maxItems: 3

  clock-names:
    items:
      - "apb"
      - "dram"
      - "mbus"

  interrupts:
    maxItems: 1
    description:
      MBUS PMU activity interrupt.

  dma-ranges:
    description:
      See section 2.3.9 of the DeviceTree Specification.

  '#address-cells': true

  '#size-cells': true

required:
  - "#interconnect-cells"
  - compatible
  - reg
  - reg-names
  - clocks
  - clock-names
  - dma-ranges

additionalProperties: false

examples:
  - |
    #include <dt-bindings/clock/sun5i-ccu.h>

    mbus: dram-controller@1c01000 {
        compatible = "allwinner,sun5i-a13-mbus";
        reg = <0x01c01000 0x1000>;
        clocks = <&ccu CLK_MBUS>;
        #address-cells = <1>;
        #size-cells = <1>;
        dma-ranges = <0x00000000 0x40000000 0x20000000>;
        #interconnect-cells = <1>;
    };

...
```

## Documentation/devicetree/bindings/bitmain-ethernet.yaml
```yaml
Bitmain_Ethernet_Controller_Device_Tree_Binding:

  Required_properties:
    - compatible: "bitmain,ethernet"

  Optional_properties:
    - mac-address: "MAC address of the Ethernet controller"
    - interrupts: "Should specify the interrupt number for the controller"
    - reg: "Should specify the base address and size of the memory-mapped registers"


#Example:
#  ethernet@0:
#   compatible: "bitmain,ethernet"
#   mac-address: [00:11:22:33:44:55]
#   interrupts: <0>
#   reg: <0x0 0x1000>
```

## Documentation/devicetree/bindings/clock/cix,sky1-audss-clock.yaml
```yaml
# SPDX-License-Identifier: (GPL-2.0-only OR BSD-2-Clause)
%YAML 1.2
---
$id: http://devicetree.org/schemas/clock/cix,sky1-audss-clock.yaml#
$schema: http://devicetree.org/meta-schemas/core.yaml#

title: Cixtech Sky1 SoC Audio SubSystem Clock Controller Driver

maintainers:
  - Joakim Zhang <joakim.zhang@cixtech.com>

description: |
  All available clocks are defined as preprocessor macros in
  include/dt-bindings/clock/sky1-audss.h header.

properties:
  compatible:
    const: cix,sky1-audss-clock

  reg:
    maxItems: 1

  clocks:
    description:
      - audio_pll0 (FRAC) provides "audio_clk0" and "audio_clk1" that generates
        I2S function clock, such as 8KHz, 16KHz etc, "audio_clk0" is also the clock
        source of MCLK.
      - audio_pll1 (FRAC) provides "audio_clk2" and "audio_clk3" that generates
        I2S function clock, such as 11.025KHz, 22.5KHz etc, "audio_clk2" is also the clock
        source of MCLK.
      - mmsys_pll provides "audio_clk4" that generates AXI or APB clock for most devices
        in audio subsystem (DSP, NOC, SRAM, HDA, DMAC, I2S, Timer and Mailbox).
      - mmsys_pll provides "audio_clk5" that generates a fixed 48MHz clock for HDA, Timer
        and Watchdog.

  clock-names:
    minItems: 6
    items:
      - const: audio_clk0
      - const: audio_clk1
      - const: audio_clk2
      - const: audio_clk3
      - const: audio_clk4
      - const: audio_clk5

  "#clock-cells":
    const: 1

  resets:
    description: signal to reset all modules in audio subsystem except HIFI5 DSP.

  reset-names:
    const: noc

required:
  - compatible
  - reg
  - clocks
  - clock-names
  - "#clock-cells"
  - resets
  - reset-names

additionalProperties: false

examples:
  - |
    #include <dt-bindings/clock/sky1-audss.h>

    clock-controller@07100000 {
        compatible = "cix,sky1-audss-clock";
        reg = <0x0 0x07100000 0x0 0x1000>;
        clock-names = "audio_clk0", "audio_clk1",
                      "audio_clk2", "audio_clk3",
                      "audio_clk4", "audio_clk5";
        clocks = <&clocks CLK_AUDIO_CLK0>, <&clocks CLK_AUDIO_CLK1>,
                 <&clocks CLK_AUDIO_CLK2>, <&clocks CLK_AUDIO_CLK3>,
                 <&clocks CLK_AUDIO_CLK4>, <&clocks CLK_AUDIO_CLK5>;
        #clock-cells = <1>;
    };
```

## Documentation/devicetree/bindings/crypto/rockchip,rk3588-crypto.yaml
```yaml
# SPDX-License-Identifier: (GPL-2.0-only OR BSD-2-Clause)
%YAML 1.2
---
$id: http://devicetree.org/schemas/crypto/rockchip,rk3588-crypto.yaml#
$schema: http://devicetree.org/meta-schemas/core.yaml#

title: Rockchip cryptographic offloader V2

maintainers:
  - Corentin Labbe <clabbe@baylibre.com>

properties:
  compatible:
    enum:
      - rockchip,rk3568-crypto
      - rockchip,rk3588-crypto

  reg:
    maxItems: 1

  interrupts:
    maxItems: 1

  clocks:
    minItems: 1

  clock-names:
    items:
      - const: core

  resets:
    minItems: 1

  reset-names:
    items:
      - const: core

required:
  - compatible
  - reg
  - interrupts
  - clocks
  - clock-names
  - resets
  - reset-names

additionalProperties: false

examples:
  - |
    #include <dt-bindings/interrupt-controller/arm-gic.h>
    #include <dt-bindings/clock/rockchip,rk3588-cru.h>
    #include <dt-bindings/reset/rockchip,rk3588-cru.h>
    crypto@fe370000 {
      compatible = "rockchip,rk3588-crypto";
      reg = <0xfe370000 0x4000>;
      interrupts = <GIC_SPI 209 IRQ_TYPE_LEVEL_HIGH 0>;
      clocks = <&scmi_clk SCMI_CRYPTO_CORE>;
      clock-names = "core";
      resets = <&scmi_reset SRST_CRYPTO_CORE>;
      reset-names = "core";
    };
  - |
    #include <dt-bindings/interrupt-controller/arm-gic.h>
    #include <dt-bindings/clock/rockchip,rk3568-cru.h>
    #include <dt-bindings/reset/rockchip,rk3568-cru.h>
    crypto@fe380000 {
      compatible = "rockchip,rk3568-crypto";
      reg = <0xfe380000 0x4000>;
      interrupts = <GIC_SPI 4 IRQ_TYPE_LEVEL_HIGH>;
      clocks = <&cru ACLK_CRYPTO_NS>, <&cru HCLK_CRYPTO_NS>,
               <&cru CLK_CRYPTO_NS_CORE>;
      clock-names = "aclk", "hclk", "core";
      resets = <&cru SRST_CRYPTO_NS_CORE>, <&cru SRST_A_CRYPTO_NS>,
               <&cru SRST_H_CRYPTO_NS>;
      reset-names = "core", "a", "h";
    };
```

## Documentation/devicetree/bindings/hwlock/sky1-hwspinlock.yaml
```yaml
# SPDX-License-Identifier: (GPL-2.0-only OR BSD-2-Clause)
%YAML 1.2
---
$id: http://devicetree.org/schemas/hwlock/sky1-hwspinlock.yaml#
$schema: http://devicetree.org/meta-schemas/core.yaml#

title: Sky1 Hardware Mutex Block

maintainers:
  - Jerry.Zhu <jerry.zhu@cixtech.com>

description:
  The hardware block provides mutexes utilized between different processors on
  the SoC as part of the communication protocol used by these processors.

properties:
  compatible:
    oneOf:
      - enum:
          - sky1,hwspinlock
  reg:
    maxItems: 1

  '#hwlock-cells':
    const: 1

required:
  - compatible
  - reg
  - '#hwlock-cells'

additionalProperties: false

examples:
  - |
    hwclock: hwspinlock@06510000 {
    	compatible = "sky1,hwspinlock";
    	reg = <0x0 0x06510000 0x0 0x1000>;
    	#hwlock-cells = <1>;
    };
...
```

## Documentation/devicetree/bindings/leds/leds-axp20x.txt
```
Device Tree Bindings for LED support on X-Powers PMIC

Most of the X-Powers PMICs have integrated battery charger with LED indicator.
The output is open-drain, so the state is either high-Z or output-low. The
driver is a subnode of AXP20X MFD driver, since it uses shared bus with all
other cells.
The LED can be controlled either manually or automatically. Then in automatic
(controlled by the charger) there are two indication modes:

Mode-A
======
- output-low:		Charging
- high-Z:		Not charging
- 1Hz flashing:		Abnormal alarm
- 4Hz flashing:		Overvoltage alarm

Mode-B
======
- output-low:		Battery full
- high-Z:		Not charging
- 1Hz flashing:		Charging
- 4Hz flashing:		Overvoltage or abnormal alarm

The control and the mode can be changed from sysfs.

For AXP20X MFD bindings see:
Documentation/devicetree/bindings/mfd/axp20x.txt

Required properties:
- compatible : Must be "x-powers,axp20x-led"

Supported common LED properties, see ./common.txt for more informationn
- label : See Documentation/devicetree/bindings/leds/common.txt
- linux,default-trigger : See Documentation/devicetree/bindings/leds/common.txt
- default-state: See Documentation/devicetree/bindings/leds/common.txt

Optional properties:
- x-powers,charger-mode: 0 for Mode-A, 1 for Mode-B
			If omitted, then the control is set to manual mode.
			On invalid value, Mode-A is used.

Example:

	axp803: pmic@3a3 {
		compatible = "x-powers,axp803";

		...

		led@0 {
			compatible = "x-powers,axp20x-led";
			status = "okay";

			label = "axp20x:yellow:chgled";
			linux,default-trigger = "timer";
			default-state = "on";
		};
	};

or

	axp803: pmic@3a3 {
		compatible = "x-powers,axp803";

		...

		led@0 {
			compatible = "x-powers,axp20x-led";
			status = "okay";

			label = "axp20x:yellow:chgled";
			x-powers,charger-mode = <1>;
		};
	};
```

## Documentation/devicetree/bindings/leds/leds-axp20x.yaml
```yaml
# SPDX-License-Identifier: GPL-2.0
%YAML 1.2
---
$id: http://devicetree.org/schemas/leds/leds-axp20x.yaml#
$schema: http://devicetree.org/meta-schemas/core.yaml#

title: LED driver for AXP813 PMIC from X-Powers.

maintainers:
  - Ondrej Jirman <megous@megous.com>

description: |
  This module is part of the AXP20x MFD device. For more details
  see Documentation/devicetree/bindings/mfd/axp20x.txt.

  The LED controller is represented as a sub-node of the PMIC node on
  the device tree.

properties:
  compatible:
    const: x-powers,axp813-charger-led

required:
  - compatible
```

## Documentation/devicetree/bindings/leds/leds-sunxi.txt
```
Allwinner RGB LED Driver

The Allwinner LEDC is an high-efficiency RGB LED driver
which is integrated in the SoCs of Allwinner.

Required properties:
	- compatible: "allwinner,sunxi-leds"
	- reg: LEDC registers address.
	- interrupts: the interrupt information for LEDC.
	- interrupt-names: the interrupt name.
	- clocks: the clocks.
	- clock-names: the clock name.
	- pinctrl-names: the pinctrl names.
	- pinctrl-0: the pinctrl which stays in <platform name>-pinctrl.dtsi.

Optional properties:
	- led_count: LED count.
	- output_mode: the mode LEDC output R, G, B data, e.g. if
			the output mode is GRB, LEDC will output
			G data, then R data, and finally B data.
	- trans_mode: the mode that transport R, G, B data from DDR
			to LEDC FIFO, there are two ways: CPU and DMA.
	- reset_ns: the LED reset time in nanoseconds.
	- t1h_ns: 1 code, high level time in nanoseconds.
	- t1l_ns: 1 code, low level time in nanoseconds.
	- t0h_ns: 0 code, high level time in nanoseconds.
	- t0l_ns: 0 code, low level time in nanoseconds.
	- wait_time0_ns: the waiting time in nanoseconds between two LED data.
	- wait_time1_ns: the waiting time in nanoseconds between two frames.
	- wait_data_time_ns: the threshold time that LEDC waiting for the input
			data after LEDC is enabled.

----------------------------Note-------------------------
	Any time parameter has its default value which is
initialized by LEDC hardware, if not assigned in dts, it
will come into the default value got from registers.
---------------------------------------------------------

Example:

sunxi_leds: leds@6 {
	compatible = "allwinner,sunxi-leds";
	reg = <0x0 0x06700000 0x0 0x4c>;
	interrupts = <GIC_SPI 60 IRQ_TYPE_LEVEL_HIGH>;
	interrupt-names = "ledcirq";
	clocks = <&clk_ledc>, <&clk_cpuapb>;
	clock-names = "clk_ledc", "clk_cpuapb";
	pinctrl-names = "default";
	pinctrl-0 = <&ledc_pins_a>;
	led_count = <0x20>;
}
```

## Documentation/devicetree/bindings/mailbox/cix-mailbox.yaml
```yaml
# SPDX-License-Identifier: (GPL-2.0 OR BSD-2-Clause)
%YAML 1.2
---
$id: "http://devicetree.org/schemas/mailbox/cix-mailbox.yaml#"
$schema: "http://devicetree.org/meta-schemas/core.yaml#"

title: Cix mailbox controller bindings

maintainers:
  - Lihua Liu <Lihua.Liu@cixcomputing.com>

description:
  CIX mailbox controller is used to exchange message within
  multiple processors, such as AP, AUDIO DSP, SensorHub MCU,
  etc. It supports 10 mailbox channels with different operating
  mode and every channel is unidirectional.

properties:
  compatible:
    const: cix,sky1-mbox

  reg:
    maxItems: 1

  interrupts:
    maxItems: 1

  "#mbox-cells":
    description: |
      <&phandle channel>
      phandle   : Label name of controller
      channel   : Channel number

      This controller supports three types of unidirectional channels, they are
      1 register based channel, 1 fifo based channel and 8 fast channels.
      A total of 10 channels for each controller. Following types are
      supported:
      channel 0_7 - Fast channel with 32bit transmit register and IRQ support.
      channel 8   - Reg based channel with 32*32bit transsmit register and
                    Doorbell+transmit acknowledgment IRQ support
      channel 9   - Fifo based channel with 32*32bit depth fifo and IRQ support.
    const: 1

  cix,mbox_dir:
    description: Direction of the mailbox (0:TX or 1:RX)
    enum: [0, 1]

required:
  - compatible
  - reg
  - interrupts
  - "#mbox-cells"
  - cix,mbox_dir

additionalProperties: false

examples:
  - |
    #include <dt-bindings/interrupt-controller/arm-gic.h>

    mbox0: mailbox@30000000 {
        compatible = "cix,sky1-mbox";
        reg = <0x0 0x30000000 0x0 0x10000>;
        interrupts = <GIC_SPI 136 IRQ_TYPE_LEVEL_HIGH>;
        #mbox-cells = <1>;
        cix,mbox_dir = <0>;
        status = "okay";
    };
```
