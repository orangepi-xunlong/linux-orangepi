## Documentation/devicetree/bindings/media/i2c/ovti,ov13850.yaml
```yaml
# SPDX-License-Identifier: (GPL-2.0 OR BSD-2-Clause)
# Copyright (c) 2021 Sebastian Fricke
%YAML 1.2
---
$id: http://devicetree.org/schemas/media/i2c/ovti,ov13850.yaml#
$schema: http://devicetree.org/meta-schemas/core.yaml#

title: Omnivision OV13850 CMOS Sensor Device Tree Bindings

maintainers:
  - Sebastian Fricke <sebastian.fricke@posteo.net>

description: |-
  The Omnivision OV13850 is a 1/3.06-inch, up to 13.2 megapixel image sensor.
  It supports currently two image sizes from full-resolution at 4224x3136 (13.2 MP)
  to 2x2 binned mode 2112x1568.
  The sensor output is available via CSI-2 serial data output.

allOf:
  - $ref: /schemas/media/video-interface-devices.yaml#

properties:
  compatible:
    const: ovti,ov13850

  reg:
    maxItems: 1

  clocks:
    maxItems: 1

  clock-names:
    description:
      External clock for the sensor.
    items:
      - const: xvclk

  dovdd-supply:
    description:
      Definition of the regulator used as Digital I/O voltage supply.

  avdd-supply:
    description:
      Definition of the regulator used as Analog voltage supply.

  dvdd-supply:
    description:
      Definition of the regulator used as Digital core voltage supply.

  pwdn-gpios:
    description:
      Reference to the GPIO connected to the PWDN pin which is active high.
    maxItems: 1

  reset-gpios:
    description:
      Reference to the GPIO connected to the RSTB pin which is active high.
    maxItems: 1

  port:
    $ref: /schemas/graph.yaml#/$defs/port-base
    additionalProperties: false
    description:
      Video output port.

    properties:
      endpoint:
        $ref: /schemas/media/video-interfaces.yaml#
        unevaluatedProperties: false

        properties:
          remote-endpoint: true

          data-lanes:
            minItems: 1
            maxItems: 2

        required:
          - remote-endpoint
          - data-lanes

    required:
      - endpoint

required:
  - compatible
  - reg
  - clocks
  - clock-names
  - dovdd-supply
  - avdd-supply
  - dvdd-supply
  - pwdn-gpios
  - reset-gpios
  - port

additionalProperties: false

examples:
  - |
    #include <dt-bindings/gpio/gpio.h>

    i2c {
        ov13850p0: ov13850@10 {
            compatible = "ovti,ov13850";
            status = "okay";
            reg = <0x10>;
            clocks = <&cru SCLK_CIF_OUT>;
            clock-names = "xvclk";
            dovdd-supply = <&ov13850_dovdd_1p8v>;
            avdd-supply = <&ov13850_avdd_2p8v>;
            dvdd-supply = <&ov13850_dvdd_1p2v>;

            reset-gpios = <&gpio2 27 GPIO_ACTIVE_HIGH>;
            pwdn-gpios = <&gpio2 28 GPIO_ACTIVE_HIGH>;

            port {
                ucam_out: endpoint {
                    remote-endpoint = <&mipi_in_ucam>;
                    data-lanes = <1 2>;
                };
            };
        };
    };
...
```

## Documentation/devicetree/bindings/media/soph-v4l2-sensor.txt
```
* Sophgo V4l2 Sensor

Required Properties:
- compatible: Must be "cvitek,sensor*"
- reg: I2C slave address
- port: link to cif end point

Example:

	&i2c0 {
		sensor0@1a{
			status = "okay";
			compatible = "cvitek,sensor0";
			reg = <0x1a>;
			port {
				sensor0_out: endpoint {
					remote-endpoint = <&cif_in_ep0>;
				};
			};
		};
	};

	&i2c1 {
		sensor1@1a{
			status = "okay";
			compatible = "cvitek,sensor1";
			reg = <0x1a>;
			port {
				sensor1_out: endpoint {
					remote-endpoint = <&cif_in_ep1>;
				};
			};
		};
	};


	&i2c2 {
		sensor2@1a{
			status = "okay";
			compatible = "cvitek,sensor2";
			reg = <0x1a>;
			port {
				sensor2_out: endpoint {
					remote-endpoint = <&cif_in_ep2>;
				};
			};
		};
	};

	&i2c4 {
		sensor3@1a{
			status = "okay";
			compatible = "cvitek,sensor3";
			reg = <0x1a>;
			port {
				sensor3_out: endpoint {
					remote-endpoint = <&cif_in_ep3>;
				};
			};
		};
	};

	&i2c5 {
		sensor4@1a{
			status = "okay";
			compatible = "cvitek,sensor4";
			reg = <0x1a>;
			port {
				sensor4_out: endpoint {
					remote-endpoint = <&cif_in_ep4>;
				};
			};
		};
	};

	&i2c6 {
		sensor5@1a{
			status = "okay";
			compatible = "cvitek,sensor5";
			reg = <0x1a>;
			port {
				sensor5_out: endpoint {
					remote-endpoint = <&cif_in_ep5>;
				};
			};
		};
	};
```

## Documentation/devicetree/bindings/mmc/amlogic,meson-gx.txt
```
Amlogic SD / eMMC controller for S905/GXBB family SoCs

The MMC 5.1 compliant host controller on Amlogic provides the
interface for SD, eMMC and SDIO devices.

This file documents the properties in addition to those available in
the MMC core bindings, documented by mmc.txt.

Required properties:
- compatible : contains one of:
  - "amlogic,meson-gx-mmc"
  - "amlogic,meson-gxbb-mmc"
  - "amlogic,meson-gxl-mmc"
  - "amlogic,meson-gxm-mmc"
  - "amlogic,meson-axg-mmc"
- clocks     : A list of phandle + clock-specifier pairs for the clocks listed in clock-names.
- clock-names: Should contain the following:
	"core" - Main peripheral bus clock
	"clkin0" - Parent clock of internal mux
	"clkin1" - Other parent clock of internal mux
  The driver has an internal mux clock which switches between clkin0 and clkin1 depending on the
  clock rate requested by the MMC core.
- resets     : phandle of the internal reset line

Optional properties:
- amlogic,dram-access-quirk: set when controller's internal DMA engine cannot access the
  DRAM memory, like on the G12A dedicated SDIO controller.
- amlogic,mmc-phases: 3-element array of clock phases for core, tx, rx clock with values:
	0: CLK_PHASE_0 - 0 phase
	1: CLK_PHASE_90 - 90 phase
	2: CLK_PHASE_180 - 180 phase
	3: CLK_PHASE_270 - 270 phase
  By default driver use <CLK_PHASE_180 CLK_PHASE_0 CLK_PHASE_0> value.

Example:

	sd_emmc_a: mmc@70000 {
		compatible = "amlogic,meson-gxbb-mmc";
		reg = <0x0 0x70000 0x0 0x2000>;
		interrupts = < GIC_SPI 216 IRQ_TYPE_EDGE_RISING>;
		clocks = <&clkc CLKID_SD_EMMC_A>, <&xtal>, <&clkc CLKID_FCLK_DIV2>;
		clock-names = "core", "clkin0", "clkin1";
		pinctrl-0 = <&emmc_pins>;
		resets = <&reset RESET_SD_EMMC_A>;
		amlogic,mmc-phases = <CLK_PHASE_180 CLK_PHASE_0 CLK_PHASE_0>;
	};
```

## Documentation/devicetree/bindings/net/rtl8723bs-bluetooth.txt
```
RTL8723BS/RTL8723CS Bluetooth
---------------------

RTL8723CS/RTL8723CS is WiFi + BT chip. WiFi part is connected over SDIO, while
BT is connected over serial. It speaks H5 protocol with few extra commands
to upload firmware and change module speed.

Required properties:

 - compatible: should be one of the following:
   * "realtek,rtl8723bs-bt"
   * "realtek,rtl8723cs-bt"
Optional properties:

 - device-wake-gpios: GPIO specifier, used to wakeup the BT module (active high)
 - enable-gpios: GPIO specifier, used to enable the BT module (active high)
 - host-wake-gpios: GPIO specifier, used to wakeup the host processor (active high)
 - firmware-postfix: firmware postfix to be used for firmware config
 - reset-gpios: GPIO specifier, used to reset the BT module (active high)

Example:

&uart1 {
       pinctrl-names = "default";
       pinctrl-0 = <&uart1_pins>, <&uart1_rts_cts_pins>;
       status = "okay";

       bluetooth {
               compatible = "realtek,rtl8723bs-bt";
               reset-gpios = <&r_pio 0 4 GPIO_ACTIVE_LOW>; /* PL4 */
               device-wake-gpios = <&r_pio 0 5 GPIO_ACTIVE_HIGH>; /* PL5 */
               host-wakeup-gpios = <&r_pio 0 6 GPIO_ACTIVE_HIGH>; /* PL6 */
               firmware-postfix="pine64";
       };
};
```

## Documentation/devicetree/bindings/pinctrl/cix,sky1-pinctrl.yaml
```yaml
# SPDX-License-Identifier: GPL-2.0
%YAML 1.2
---
$id: http://devicetree.org/schemas/pinctrl/cix,sky1-pinctrl.yaml#
$schema: http://devicetree.org/meta-schemas/core.yaml#

title: Cix Sky1 IOMUX Controller

maintainers:
  - Jerry Zhu <Jerry.Zhu@cixtech.com>


properties:
  compatible:
    const: cix,sky1-iomuxc

  reg:
    maxItems: 1

# Client device subnode's properties
patternProperties:
  'grp$':
    type: object
    description:
      Pinctrl node's client devices use subnodes for desired pin configuration.
      Client device subnodes use below standard properties.

    properties:
      sky1,pins:
        description:
          each entry consists of 1 short represents for mux&conf reg and 1 integer
        items:
          items:
            - description: |
                "mux&conf_reg" indicates the offset of mux&conf register.
            - description: |
                "mux&conf_val" indicates the mux&conf value to be applied.

    required:
      - sky1,pins

    additionalProperties: false

required:
  - compatible
  - reg

additionalProperties: false

examples:
  # Pinmux controller node
  - |
    iomuxc: pinctrl@04160000 {
        compatible = "cix,sky1-iomuxc";
	reg = <0x0 0x04160000 0x0 0x10000>;

        pinctrl_uart2: uart2grp {
            sky1,pins =<
                0x14c 0x1b
                0x150 0x1b
            >;
        };
    };

...
```

## Documentation/devicetree/bindings/pwm/rockchip,rk3576-pwm.yaml
```yaml
# SPDX-License-Identifier: (GPL-2.0-only OR BSD-2-Clause)
%YAML 1.2
---
$id: http://devicetree.org/schemas/pwm/rockchip,rk3576-pwm.yaml#
$schema: http://devicetree.org/meta-schemas/core.yaml#

title: Rockchip PWMv4 controller

maintainers:
  - Nicolas Frattaroli <nicolas.frattaroli@collabora.com>

description: |
  The Rockchip PWMv4 controller is a PWM controller found on several Rockchip
  SoCs, such as the RK3576.

  It supports both generating and capturing PWM signals.

allOf:
  - $ref: pwm.yaml#

properties:
  compatible:
    items:
      - const: rockchip,rk3576-pwm

  reg:
    maxItems: 1

  clocks:
    items:
      - description: Used to derive the PWM signal.
      - description: Used as the APB bus clock.
      - description: Used as an alternative to derive the PWM signal.
      - description: Used as another alternative to derive the PWM signal.

  clock-names:
    items:
      - const: pwm
      - const: pclk
      - const: osc
      - const: rc

  interrupts:
    maxItems: 1

  "#pwm-cells":
    const: 3

required:
  - compatible
  - reg
  - clocks
  - clock-names
  - interrupts

additionalProperties: false

examples:
  - |
    #include <dt-bindings/clock/rockchip,rk3576-cru.h>
    #include <dt-bindings/interrupt-controller/arm-gic.h>
    #include <dt-bindings/interrupt-controller/irq.h>

    soc {
        #address-cells = <2>;
        #size-cells = <2>;

        pwm@2add0000 {
            compatible = "rockchip,rk3576-pwm";
            reg = <0x0 0x2add0000 0x0 0x1000>;
            clocks = <&cru CLK_PWM1>, <&cru PCLK_PWM1>, <&cru CLK_OSC_PWM1>,
                     <&cru CLK_RC_PWM1>;
            clock-names = "pwm", "pclk", "osc", "rc";
            interrupts = <GIC_SPI 102 IRQ_TYPE_LEVEL_HIGH>;
            #pwm-cells = <3>;
        };
    };
```

## Documentation/devicetree/bindings/pwm/sky1-pwm.yaml
```yaml
# SPDX-License-Identifier: (GPL-2.0-only OR BSD-2-Clause)
%YAML 1.2
---
$id: http://devicetree.org/schemas/pwm/sky1-pwm.yaml#
$schema: http://devicetree.org/meta-schemas/core.yaml#

title: Cix Sky1 PWM controller

maintainers:
  - Jerry Zhu <jerry.zhu@cixtech.com>

properties:
  "#pwm-cells":
    description: |
      Should 3 for sky1 SoCs. See pwm.yaml in this directory for
      a description of the cells format.
    enum:
      - 3

  compatible:
    oneOf:
      - enum:
          - cix,sky1-pwm
      - items:
          - const: cix,sky1-pwm

  reg:
    maxItems: 1

  clocks:
    items:
      - description: SoC PWM clock

  clock-names:
    items:
      - const: clk

required:
  - "#pwm-cells"
  - compatible
  - reg
  - clocks
  - clock-names

additionalProperties: false

examples:
  - |
    #include <dt-bindings/clock/sky1-clock.h>
pwm: pwm@16001000 {
	compatible = "cix,sky1-pwm";
	reg = <0x0 0x16001000 0x0 0x10000>;
	clock-names = "pclk", "iclk";
	status = "disabled";
};
```

## Documentation/devicetree/bindings/remoteproc/cix_dsp_rproc.yaml
```yaml
# SPDX-License-Identifier: (GPL-2.0 OR BSD-2-Clause)
%YAML 1.2
---
$id: "http://devicetree.org/schemas/remoteproc/cix_dsp_rproc.yaml#"
$schema: "http://devicetree.org/meta-schemas/core.yaml#"

title: Cix DSP Remoteproc Driver bindings

maintainers:
  - Lihua Liu <Lihua.Liu@cixcomputing.com>

description:
  CIX DSP remoteproc driver is used to control audio dsp core,
  such as start, stop and boot dsp. Mailbox will be
  used for msg exchange between AP and dsp. In additional,
  crash dump and recovery are supported with this driver when remote
  processor crash happen.

properties:
  compatible:
    const: cix,sky1-hifi5

  reg:
    maxItems: 1

  interrupts:
    description: Should contain the watchdog reset interrupt
    maxItems: 1

  clocks:
    maxItems: 6

  clock-names:
    items:
      - const: clk
      - const: bclk
      - const: pbclk
      - const: sramclk
      - const: mb0clk
      - const: mb1clk

  "#mbox-cells":
    description: |
      <&phandle channel>
      phandle   : Label name of controller
      channel   : Channel index

      channel 0_7 - Fast channel with 32bit transmit register and IRQ support.
      channel 8   - Reg based channel with 32*32bit transsmit register and
                    Doorbell+transmit acknowledgment IRQ support
      channel 9   - Fifo based channel with 32*32bit depth fifo and IRQ support.
    const: 1

  firmware-name:
    description: Default name of the firmware to load to the remote processor.

  memory-region:
    description:
      List of phandles to the reserved memory regions associated with the
      remoteproc device. It describes the memories shared with
      the remote processor (e.g. remoteproc firmware and carveouts, rpmsg
      vrings, ...).

  wakeup-source: true

  resets:
    maxItems: 1
    description: signal to reset HIFI5 DSP.

  reset-names:
    maxItems: 1
      - const: dsp

  cix,dsp-ctrl:
    description: Phandle to syscon block which provide access to Control Register Unit.

required:
  - compatible
  - reg
  - interrupts
  - clocks
  - clock-names
  - "#mbox-cells"
  - "firmware-name"
  - "memroy-region"
  - resets
  - reset-names
  - cix,dsp-ctrl

additionalProperties: false

examples:
  - |
    #include <dt-bindings/interrupt-controller/arm-gic.h>

  audio-dsp {
    compatible = "cix,sky1-hifi5";
    reg = <0x0 0x30000000 0x0 0x100000>; /* TBD */
    interrupts = <GIC_SPI 88 IRQ_TYPE_LEVEL_HIGH>;/* TBD.IRQ? */
    firmware-name = "cix/hifi5.bin";
    mbox-names = "tx0", "rx0";
    mboxes = <&mbox0 9>,	/* index=9: fifo base channel */
        <&mbox1 9>;
    memory-region = <&dsp_vdev0buffer>, <&dsp_vdev0vring0>,
        <&dsp_vdev0vring1>;
  };

    /* Reserve memory node */
    dsp_vdev0buffer: vdev0buffer@82008000 {	/* 1M for tx/rx buffer */
      compatible = "shared-dma-pool";
      reg = <0x0 0x82008000 0x0 0x100000>;
      no-map;
    };
```
