## Documentation/devicetree/bindings/remoteproc/cix_sfh_rproc.yaml
```yaml
# SPDX-License-Identifier: (GPL-2.0 OR BSD-2-Clause)
%YAML 1.2
---
$id: "http://devicetree.org/schemas/remoteproc/cix_sfh_rproc.yaml#"
$schema: "http://devicetree.org/meta-schemas/core.yaml#"

title: Cix SFH Remoteproc Driver bindings

maintainers:
  - Lihua Liu <Lihua.Liu@cixcomputing.com>

description:
  CIX Sensor Fusion Hub remoteproc driver is used to control sensorHub
  M33 core, such as start, stop and boot sensorhub mcu. Mailbox will be
  used for msg exchange between AP and sensorhub mcu. In additional,
  crash dump and recovery are supported with this driver when remote
  processor crash happen.

properties:
  compatible:
    const: cix,sky1-sfh

  reg:
    maxItems: 1

  interrupts:
    description: Should contain the watchdog reset interrupt
    maxItems: 1

  "#mbox-cells":
    description: |
      <&phandle channel>
      phandle   : Label name of controller
      channel   : Channel index

      channel 0_7 - Fast channel with 32bit transmit register and IRQ support.
      channel 8   - Reg based channel with 32*32bit transsmit register and
                    Doorbell+transmit acknowledgment IRQ support
      channel 9   - Fifo based channel with 32*32bit depth fifo and IRQ support.
    const: 1

  firmware-name:
    description: Default name of the firmware to load to the remote processor.

  memory-region:
    description:
      List of phandles to the reserved memory regions associated with the
      remoteproc device. It describes the memories shared with
      the remote processor (e.g. remoteproc firmware and carveouts, rpmsg
      vrings, ...).

  wakeup-source: true

required:
  - compatible
  - reg
  - interrupts
  - "#mbox-cells"
  - "firmware-name"
  - "memroy-region"
  - "wakeup-source"

additionalProperties: false

examples:
  - |
    #include <dt-bindings/interrupt-controller/arm-gic.h>

    sensor-mcu {
      compatible = "cix,sky1-sfh";
      reg = <0x0 0x30000000 0x0 0x100000>;
      interrupts = <GIC_SPI 88 IRQ_TYPE_LEVEL_HIGH>;
      firmware-name = "cix/sfh_fw.bin";
      mbox-names = "tx1", "rx1";
      mboxes = <&mbox2 0>,	/* index=0: Fast channel */
        <&mbox3 0>;
      memory-region = <&mcu_vdev0buffer>, <&mcu_vdev0vring0>,
          <&mcu_vdev0vring1>, <&mcu_ram>;
      wakeup-source;
    };

    /* Reserve memory node */
    mcu_vdev0buffer: vdev0buffer@40008000 {	/* 1M for tx/rx buffer */
      compatible = "shared-dma-pool";
      reg = <0x0 0x40008000 0x0 0x100000>;
      no-map;
    };
```

## Documentation/devicetree/bindings/reset/cix,sky1-src.yaml
```yaml
# SPDX-License-Identifier: (GPL-2.0-only OR BSD-2-Clause)
%YAML 1.2
---
$id: http://devicetree.org/schemas/reset/cix,sky1-src.yaml#
$schema: http://devicetree.org/meta-schemas/core.yaml#

title: Cix Sky1 System Reset Controller

maintainers:
  - Jerry Zhu <jerry.zhu@cixtech.com>

description: |
  The system reset controller can be used to reset various set of
  peripherals. Device nodes that need access to reset lines should
  specify them as a reset phandle in their corresponding node as
  specified in reset.txt.

  For list of all valid reset indices see
    <dt-bindings/reset/sky1-reset.h> for Sky1
properties:
  compatible:
    oneOf:
      - items:
          - enum:
              - cix,sky1-src
          - const: syscon
      - items:
          - enum:
              - cix,sky1-src
          - const: cix,sky1-src
          - const: syscon

  reg:
    maxItems: 1

  interrupts:
    maxItems: 1

  '#reset-cells':
    const: 1

required:
  - compatible
  - reg
  - interrupts
  - '#reset-cells'

additionalProperties: false

examples:
  - |
    #include <dt-bindings/interrupt-controller/arm-gic.h>

    reset-controller@30390000 {
        compatible = "cix,sky1-src", "syscon";
	reg = <0x0 0x16000000 0x0 0x10000>;
        interrupts = <GIC_SPI 176 IRQ_TYPE_LEVEL_HIGH>;
        #reset-cells = <1>;
    };
```

## Documentation/devicetree/bindings/reset/cvitek-restart.yaml
```yaml
# Documentation/devicetree/bindings/power/reset/cvitek-restart.yaml

description: |
  Cvitek hardware reset controller

properties:
  compatible:
    const: cvitek,restart

#examples:
#  - |
#    reset-controller@10000000 {
#        compatible = "cvitek,restart";
#        #reset-cells = <1>;
#        ...
#    };
```

## Documentation/devicetree/bindings/soc/cix/cix,ddr_exception.yaml
```yaml
# SPDX-License-Identifier: GPL-2.0-or-later
# Copyright 2025 Cix Technology Group Co., Ltd.
%YAML 1.2
---
$id: ""
$schema: ""

title: Cix ddr exception driver.

description: |
  When a DDR exception occurs, it informs the AP through an interrupt, and the AP will parse the interrupt information.

maintainers:
  - Vincent Wu <vincent.wu@cixtech.com>
  - Vimoon Zheng <vimoon.zheng@cixtech.com>

properties:
  compatible:
    enum:
      - cadence,ddr_ctrl

  reg:
    description: DDR interrupt information reg and DDR information reg
    maxItems: 2

  interrupts:
    description: DDR interrupt number

  channel_id:
    description: DDR channel id

  mbox-names:
    description: mailbox name

  mboxes:
    description: Mailbox in use
    maxItems: 1

required:
  - compatible
  - reg
  - interrupts
  - channel_id
  - mbox-names
  - mboxes

additionalProperties: false

examples:
  - |
		ddr_ctrl1: ddr_ctrl@0C030000 {
      compatible = "cadence,ddr_ctrl";
      reg = <0x0 0x0C030000 0x0 0x20000>,
        <0x0 0x83c00000 0x0 0x1000>;
      interrupts = <GIC_SPI 210 IRQ_TYPE_LEVEL_HIGH>;
      channel_id = <0x1>;
      mbox-names = "tx4";
      mboxes = <&mbox_ap2se 10>; /* index=9: fifo base channel */
      status = "disabled";
	  };
```

## Documentation/devicetree/bindings/soc/cix/cix,se_pm_execption.yaml
```yaml
# SPDX-License-Identifier: GPL-2.0-or-later
# Copyright 2025 Cix Technology Group Co., Ltd.
%YAML 1.2
---
$id: ""
$schema: ""

title: Cix SE & PM Exception Driver

description: |
  When an Exception occurs for SE or PM, AP will be notified to log this exception event.

maintainers:
  - Vincent Wu <vincent.wu@cixtech.com>
  - Vimoon Zheng <vimoon.zheng@cixtech.com>

properties:
  compatible:
    enum:
      - cix,se_pm_crash

  mbox-names:
    description: mailbox name
    maxItems: 4

  mboxes:
    description: Mailbox in use
    maxItems: 1

required:
  - compatible
  - mbox-names
  - mboxes

additionalProperties: false

examples:
  - |
		crash: cix_se_pm_crash {
			compatible = "cix,se_pm_crash";
			mbox-names = "rx4";
			mboxes = <&mbox_se2ap 9>;  /* index=9: fifo base channel */
			status = "disabled";
		};
```

## Documentation/devicetree/bindings/sound/alc256.txt
```
Alc256 ADC/DAC

Required properties:

  - compatible : "realtek,alc256"

  - "#sound-dai-cells" :
    const: 0

Example:

alc256_codec {
        compatible = "realtek,alc256";
};
```

## Documentation/devicetree/bindings/sound/alc257.txt
```
Alc256 ADC/DAC

Required properties:

  - compatible : "realtek,alc257"

  - "#sound-dai-cells" :
    const: 0

Example:

alc257_codec {
        compatible = "realtek,alc257";
};
```
