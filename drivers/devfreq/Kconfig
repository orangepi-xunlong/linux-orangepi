## drivers/input/touchscreen/chsc5xxx/Kconfig
```kconfig
#
# ChipSemi CHSC5XXX Touchscreen driver
#

config CHSC5XXX_TOUCHPANEL_DRIVER
	tristate "ChipSemi CHSC5XXX touchpanel driver"
	depends on TOUCHSCREEN_CHSC5XXX
	default y
	help
	  This is the main file for touchpanel driver for ChipSemi CHSC5XXX
	  touchscreens.

	  Say Y here if you have a ChipSemi CHSC5XXX touchscreen connected
	  to your system.

	  If unsure, say N.

	  To compile this driver as a module, choose M here: the
	  module will be called semi_touch_driver.

config SEMI_TOUCH_AUTO_UPDATE_EN
	tristate "ChipSemi CHSC5XXX touchpanel auto update support"
	depends on CHSC5XXX_TOUCHPANEL_DRIVER
	default n
	help
	  This enables support for firmware update for ChipSemi CHSC5XXX
	  touchscreens.

	  Say Y here if you have a ChipSemi CHSC5XXX touchscreen connected
	  to your system.

	  If unsure, say N.

	  To compile this driver as a module, choose M here: the
	  module will be called semi_touch_upgrade.

config SEMI_TOUCH_APK_NODE_EN
	tristate "ChipSemi CHSC5XXX Node for debuging"
	depends on CHSC5XXX_TOUCHPANEL_DRIVER
	default n
	help
	  This is application debug interface support for ChipSemi CHSC5XXX
	  touchscreens.

	  Say Y here if you want to have a Android app debug interface
	  to your system.

	  If unsure, say N.

	  To compile this driver as a module, choose M here: the
	  module will be called semi_touch_apk.
```

## drivers/input/touchscreen/ftxxxx/Kconfig
```kconfig
#
#  Touchscreen ft5x driver configuration
#

config TOUCHSCREEN_FT5X16_TS
       tristate  "ft5x16 touchscreen driver"
       default m
       depends on INPUT && I2C
       help
         ft5x16 touchscreen driver
```

## drivers/input/touchscreen/gt9xxnew/Kconfig
```kconfig
#
#  Touchscreen driver configuration
#
config  TOUCHSCREEN_GT9XXNEW_TS
       tristate  "gt9xxnew touchscreen driver"
       depends on INPUT && I2C
       default n
       help
         gt9xxnew touchscreen driver
```

## drivers/input/touchscreen/wacom_pen/Kconfig
```kconfig
config TOUCHSCREEN_WACOM_PEN
	tristate "wacom touch pen driver"
	default n
	depends on I2C
	help
		wacom touch pen driver
```

## drivers/leds/blink/Kconfig
```kconfig
config LEDS_BCM63138
	tristate "LED Support for Broadcom BCM63138 SoC"
	depends on LEDS_CLASS
	depends on ARCH_BCM4908 || ARCH_BCM_5301X || BCM63XX || COMPILE_TEST
	depends on HAS_IOMEM
	depends on OF
	default ARCH_BCM4908
	help
	  This option enables support for LED controller that is part of
	  BCM63138 SoC. The same hardware block is known to be also used
	  in BCM4908, BCM6848, BCM6858, BCM63148, BCM63381 and BCM68360.

	  If compiled as module it will be called leds-bcm63138.
```

## drivers/media/cedar-ve/Kconfig
```kconfig
config VIDEO_ENCODER_DECODER_SUNXI
	tristate "sunxi video encoder and decoder support"
	depends on ARCH_SUNXI
	depends on DMA_SHARED_BUFFER
	default y
	---help---
	  This is the driver for sunxi video decoder, including h264/
	  mpeg4/mpeg2/vc1/rmvb.
	  To compile this driver as a module, choose M here: the
	  module will be called cedar_dev.
```

## drivers/media/cedar-vp9/Kconfig
```kconfig
config VIDEO_GOOGLE_VP9_DECODER_SUNXI
	tristate "google video vp9 decoder support"
    select DMA_SHARED_BUFFER
	default y
	---help---
	  This is the driver for google video decoder, including vp9
	  To compile this driver as a module, choose M here: the
	  module will be called google_vp9.
```

## drivers/media/platform/cix/linlon-aeu/Kconfig
```kconfig
# SPDX-License-Identifier: GPL-2.0-only
config LINLON_AEU
	tristate "armchina LINLON AFBC Encoder Unit"
	depends on OF && (ARM || ARM64)
	depends on VIDEO_DEV
	select V4L2_MEM2MEM_DEV
	help
	  Support AEU device which could transfer the uncompressed buffer
	  to compressed buffer in AFBC format.
```

## drivers/media/platform/rockchip/iep/Kconfig
```kconfig
# SPDX-License-Identifier: GPL-2.0-only
 
config VIDEO_ROCKCHIP_IEP
	tristate "Rockchip Image Enhancement Processor"
	depends on V4L_MEM2MEM_DRIVERS
	depends on VIDEO_DEV
	depends on ARCH_ROCKCHIP || COMPILE_TEST
	select VIDEOBUF2_DMA_CONTIG
	select V4L2_MEM2MEM_DEV
	help
	  This is a v4l2 driver for Rockchip Image Enhancement Processor (IEP)
	  found in most Rockchip RK3xxx SoCs.
	  Rockchip IEP supports various enhancement operations for RGB and YUV
	  images. The driver currently implements YUV deinterlacing only.
	  To compile this driver as a module, choose M here: the module
	  will be called rockchip-iep
```

## drivers/media/platform/soph/Kconfig
```kconfig
# SPDX-License-Identifier: GPL-2.0-only
config SOPH_ISP_V4L2_SUPPORT
	tristate "Soph ISP V4L2 Support"
	depends on VIDEO_V4L2 && VIDEO_DEV
	select VIDEO_V4L2_SUBDEV_API
	select VIDEOBUF2_DMA_CONTIG
	select V4L2_MEM2MEM_DEV
	select V4L2_FWNODE
	default n
	help
	  If you have a v4l2 device designed by Sophgo, say Y.

	  Note that this option doesn't include new drivers in the kernel:
	  saying N will just cause Kconfig to skip all the questions about
	  Sophgo v4l2 devices.

if SOPH_ISP_V4L2_SUPPORT
menuconfig V4L_SENSOR_DRIVERS
	tristate "V4L2 Sensor driver"
	default y
	help
	  Say Y here to enable support for V4L sensor drivers.

if V4L_SENSOR_DRIVERS
	source "drivers/media/platform/soph/sensor/Kconfig"
endif

endif
```

## drivers/media/platform/sunxi-vin/Kconfig
```kconfig
config CSI_VIN
	tristate "v4l2 new driver for SUNXI"
	default m
	select VIDEOBUF2_DMA_CONTIG

config ENABLE_SENSOR_FLIP_OPTION
	bool "select sensor flip to replace vipp flip"
	default n
	help
	   you cant flip in vipp when you select LBC format,
	   so you can enable it to active sensor flip operation.

config CSI_CCI
	tristate "use cci function"
	default m
	help
		CCI is a hardware module in CSI. you can make it to
		be cci or i2c in the system.

if CSI_CCI
source "drivers/media/platform/sunxi-vin/vin-cci/Kconfig"
endif

config FLASH
	tristate "use flash module"
	default n

config ACTUATOR
	tristate "use actuator module"
	default n

config SENSOR_LIST
	tristate "sensor list for adaptive"
	default n

config BUF_AUTO_UPDATE
	bool "buf addr update for hardware"
	default n

config VIN_LOG
	bool "use vin log for debug"
	default n

config PIPELINE_RESET
	bool "use pipeline reset when timeout"
	default n

config MULTI_FRAME
	bool "multi-frame interrupt mode"
	default n

config SUPPORT_ISP_TDM
	bool "use isp for time sharing multiplex"
	default n

config DISPPLAY_SYNC
	bool "use one buffer for delay display"
	default n

config VIN_IOMMU
	bool "use IOMMU for memery alloc"
	default n

config D3D
	bool "ISP 3D denoise module"
	default n

config D3D_LTF_EN
	bool "ISP 3D denoise long time frame"
	depends on D3D
	default n

config D3D_COMPRESS_EN
	bool "ISP 3D denoise reduces buf size by compression"
	depends on D3D
	default	n

config WDR
	bool "ISP WDR module"
	default y

config WDR_COMPRESS_EN
	bool "ISP WDR reduces buf size by compression"
	depends on WDR
	default	n

config SAME_I2C
	bool "sensor same i2c addr"
	default n
```
