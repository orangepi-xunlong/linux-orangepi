## drivers/devfreq/Kconfig
```kconfig
menuconfig PM_DEVFREQ
	bool "Generic Dynamic Voltage and Frequency Scaling (DVFS) support"
	help
	  A device may have a list of frequencies and voltages available.
	  devfreq, a generic DVFS framework can be registered for a device
	  in order to let the governor provided to devfreq choose an
	  operating frequency based on the device driver's policy.

	  Each device may have its own governor and policy. Devfreq can
	  reevaluate the device state periodically and/or based on the
	  notification to "nb", a notifier block, of devfreq.

	  Like some CPUs with CPUfreq, a device may have multiple clocks.
	  However, because the clock frequencies of a single device are
	  determined by the single device's state, an instance of devfreq
	  is attached to a single device and returns a "representative"
	  clock frequency of the device, which is also attached
	  to a device by 1-to-1. The device registering devfreq takes the
	  responsiblity to "interpret" the representative frequency and
	  to set its every clock accordingly with the "target" callback
	  given to devfreq.

	  When OPP is used with the devfreq device, it is recommended to
	  register devfreq's nb to the OPP's notifier head.  If OPP is
	  used with the devfreq device, you may use OPP helper
	  functions defined in devfreq.h.

if PM_DEVFREQ

comment "DEVFREQ Governors"

config DEVFREQ_GOV_SIMPLE_ONDEMAND
	bool "Simple Ondemand"
	help
	  Chooses frequency based on the recent load on the device. Works
	  similar as ONDEMAND governor of CPUFREQ does. A device with
	  Simple-Ondemand should be able to provide busy/total counter
	  values that imply the usage rate. A device may provide tuned
	  values to the governor with data field at devfreq_add_device().

config DEVFREQ_GOV_PERFORMANCE
	bool "Performance"
	help
	  Sets the frequency at the maximum available frequency.
	  This governor always returns UINT_MAX as frequency so that
	  the DEVFREQ framework returns the highest frequency available
	  at any time.

config DEVFREQ_GOV_POWERSAVE
	bool "Powersave"
	help
	  Sets the frequency at the minimum available frequency.
	  This governor always returns 0 as frequency so that
	  the DEVFREQ framework returns the lowest frequency available
	  at any time.

config DEVFREQ_GOV_USERSPACE
	bool "Userspace"
	depends on ARCH_SUNXI
	help
	  Sets the frequency at the user specified one.
	  This governor returns the user configured frequency if there
	  has been an input to /sys/devices/.../power/devfreq_set_freq.
	  Otherwise, the governor does not change the frequnecy
	  given at the initialization.

config DEVFREQ_GOV_VANS
	depends on ARCH_SUN8IW3P1 && EVB_PLATFORM
	bool "Vans"
	help
	  Sets the frequency at the minimum available frequency when earlysuspend.

config DEVFREQ_GOV_DSM
	depends on EVB_PLATFORM
	depends on ARCH_SUN9IW1P1 || ARCH_SUN8IW5P1 || ARCH_SUN8IW6P1 || ARCH_SUN8IW8P1
	bool "Dsm"
	help
	  Sets the frequency according to dram scene management(DSM).

comment "DEVFREQ Drivers"

config ARM_EXYNOS4_BUS_DEVFREQ
	bool "ARM Exynos4210/4212/4412 Memory Bus DEVFREQ Driver"
	depends on CPU_EXYNOS4210 || CPU_EXYNOS4212 || CPU_EXYNOS4412
	select ARCH_HAS_OPP
	select DEVFREQ_GOV_SIMPLE_ONDEMAND
	help
	  This adds the DEVFREQ driver for Exynos4210 memory bus (vdd_int)
	  and Exynos4212/4412 memory interface and bus (vdd_mif + vdd_int).
	  It reads PPMU counters of memory controllers and adjusts
	  the operating frequencies and voltages with OPP support.
	  To operate with optimal voltages, ASV support is required
	  (CONFIG_EXYNOS_ASV).

config DEVFREQ_DRAM_FREQ
	bool "DRAM Frequency scaling"
	depends on DEVFREQ_GOV_USERSPACE || DEVFREQ_GOV_VANS || DEVFREQ_GOV_DSM
	help
	  DRAM Frequency scaling allows you to change the clock speed of
	  DRAM on the fly. This is a nice method to save power, because
	  the lower the DRAM clock speed, the less power the DRAM consumes.

	  If in doubt, say N.

config DEVFREQ_DRAM_FREQ_CFS_SW
	bool "Change dram frequency in CFS mode, need extra software operation"
	depends on DEVFREQ_DRAM_FREQ
	depends on ARCH_SUN8IW6P1
	help
	  This will need extra software operation after changing dram frequency in CFS mode.

	  If in doubt, say N.

config DEVFREQ_DRAM_FREQ_LOW_POWER_SW
	bool "Change dram frequency in software mode when low-power music playing"
	depends on DEVFREQ_DRAM_FREQ
	depends on ARCH_SUN8IW5P1
	help
	  This will use software mode to change dram frequency when low-power music playing.

	  If in doubt, say N.

config DEVFREQ_DRAM_FREQ_BUSFREQ
	bool "Change bus frequency with dram frequency changed when low-power music playing"
	depends on DEVFREQ_DRAM_FREQ
	depends on ARCH_SUN9IW1P1 || ARCH_SUN8IW5P1 || ARCH_SUN8IW6P1
	help
	  This will allow bus frequency changed when low-power music playing.

	  If in doubt, say N.

config DEVFREQ_DRAM_FREQ_VDDSYS
	bool "Change vdd-sys with dram frequency changed when low-power music playing"
	depends on DEVFREQ_DRAM_FREQ
	depends on ARCH_SUN9IW1P1 || ARCH_SUN8IW5P1
	help
	  This will allow vdd-sys changed when low-power music playing.

	  If in doubt, say N.

config DEVFREQ_DRAM_FREQ_IN_VSYNC
	bool "Change dram frequency in display vsync"
	depends on DEVFREQ_DRAM_FREQ
	depends on ARCH_SUN9IW1P1 || ARCH_SUN8IW5P1 || ARCH_SUN8IW6P1 || ARCH_SUN8IW8P1
	help
	  This will allow dram frequency changed in display vsync.

	  If in doubt, say N.

config DRAM_FREQ_DVFS
	bool "Dram work voltage change with frequency"
	depends on AW_AXP && DEVFREQ_DRAM_FREQ && ARCH_SUN8IW3P1
	help
	  This will allow dram work voltage dynamic changed when the frequency is changed.

	  If in doubt, say N.

config DRAM_FREQ_BSP_TEST
	bool "Dramfreq driver bsp test"
	depends on DEVFREQ_GOV_USERSPACE && DEVFREQ_DRAM_FREQ
	help
	  This will allow dramfreq driver for bsp test.

	  If in doubt, say N.

endif # PM_DEVFREQ
```

## drivers/firmware/cix/Kconfig
```kconfig
# SPDX-License-Identifier: GPL-2.0-only
config CIX_DSP
	tristate "CIX DSP Protocol driver"
	depends on CIX_MBOX
	help
	  This enables DSP IPC protocol between host AP (Linux) and
	  the firmware running on DSP.
	  It acts like a doorbell. Client might use shared memory to
	  exchange information with DSP side.
```

## drivers/firmware/meson/Kconfig
```kconfig
# SPDX-License-Identifier: GPL-2.0-only
#
# Amlogic Secure Monitor driver
#
config MESON_SM
	tristate "Amlogic Secure Monitor driver"
	depends on ARCH_MESON || COMPILE_TEST
	default y
	depends on ARM64_4K_PAGES
	help
	  Say y here to enable the Amlogic secure monitor driver

config MESON_GX_PM
	bool
	default ARCH_MESON if ARM64
	help
	  Say y here to enable the Amlogic GX SoC Power Management
```

## drivers/gator/Kconfig
```kconfig
#
# gator driver configuration
#

config GATOR_PERF
        tristate "Gator driver for DS-5"
        default n
        select PROFILING
        select TRACEPOINTS
        select RING_BUFFER
        select EVENT_TRACING
        select EVENT_POWER_TRACING_DEPRECATED
        select CONTEXT_SWITCH_TRACER
        select TRACING
        select FTRACE
        select ENABLE_DEFAULT_TRACERS
        select BRANCH_PROFILE_NONE
        select PERF_EVENTS
        ---help---
          Gator driver is a driver for streamline, which is
          a function in arm's DS-5.
          Strongly recommended that it should be configured
          as a module!
          NOTE
          Enable the High Resolution Timer Support option.
          Enable Use local timer interrupts if you are using
          a Symmetric MultiProcessing (SMP) target.
          
```

## drivers/gpu/drm/cix/Kconfig
```kconfig
# SPDX-License-Identifier: GPL-2.0-only
config DRM_CIX
	tristate "DRM Support for CiX Socs"
	select DRM_KMS_HELPER
	select VIDEOMODE_HELPERS
	select DRM_GEM_DMA_HELPER
	depends on DRM && ARCH_CIX
	help
	  enable CiX DRM display support

config DRM_LINLONDP
	tristate "ARMCHINA LINLON display driver"
	depends on DRM && OF
	depends on COMMON_CLK
	depends on DRM_CIX
	select DRM_KMS_HELPER
	select DRM_GEM_DMA_HELPER
	select VIDEOMODE_HELPERS
	help
	  Choose this option if you want to compile the ARMCHINA Linlon display
	  Processor driver. It supports the DP variants of the hardware.
	  If compiled as a module it will be called linlondp.

config DRM_CIX_VIRTUAL
	tristate "DRM Support for CiX Virtual Encoder"
	depends on DRM_CIX
	default y
	help
	  This is a virtual encoder and connector support which is
	  mainly used on EMU and FPGA. Disabled in default.

config DRM_LINLONDP_CLOCK_FIXED
	bool "linlondp clocks use fixed frequency"
	depends on DRM_CIX
	help
	  Choose this if linlondp clocks use fixed frequency

config DRM_TRILIN_DP_CIX
	tristate "DRM Support for Trilinear DisplayPort on CiX platforms"
	depends on DRM_CIX
	help
	  Choose this if you want to use DP display on CiX Socs

config DRM_CIX_EDP_PANEL
	tristate "DRM Support for edp panel on CiX platforms"
	help
	  Choose this if you want to use edp panel on CiX Socs

source "drivers/gpu/drm/cix/dptx/Kconfig"
```

## drivers/gpu/drm/cix/dptx/Kconfig
```kconfig
# SPDX-License-Identifier: GPL-2.0-only
config DRM_TRILIN_DPSUB
	tristate "Trilinear Technologies DisplayPort Controller Driver"
	depends on COMMON_CLK && DRM && OF
	select DRM_KMS_HELPER
	select DRM_DISPLAY_HELPER
	select DRM_DISPLAY_DP_HELPER
	select DRM_DISPLAY_HDMI_HELPER
	select DRM_DP_AUX_CHARDEV
	select GENERIC_PHY
	select SND_SOC_HDMI_CODEC if SND_SOC
	help
	  This is a DRM/KMS driver for Trilinear Technologies DisplayPort controller.
	  Choose this option if you are using an SoC with a Trilinear Technologies
	  DisplayPort subsystem.

config DRM_TRILIN_CADENCE_PHY
	tristate "Trilinear DisplayPort Controller with Cadence PHY"
	depends on DRM_TRILIN_DPSUB
	help
	  Choose this option if you are using a proper platform with a Trilinear
	  Technologies DisplayPort subsystem.
```

## drivers/gpu/drm/cvitek/Kconfig
```kconfig
# SPDX-License-Identifier: GPL-2.0-only

config DRM_CVITEK
	tristate "DRM Support for cvitek SoCs Platform"
	depends on DRM && OF
	select DRM_KMS_HELPER
	select DRM_GEM_CMA_HELPER
	select DRM_KMS_CMA_HELPER
	select VIDEOMODE_HELPERS
	help
	  Choose this option if you want to use drm on Cvitek SoC.
	  If M is selected the module will be called cvitek-drm.

config CVITEK_DW_HDMI
	bool "Cvitek specific extensions for DW_HDMI"
	select DRM_DW_HDMI
	select DRM_DW_HDMI_AHB_AUDIO
	help
	If you want to enable HDMI on Cvitek SoC, you should
	  select this option.

config CVITEK_MIPI_DSI
	bool "Cvitek specific extensions for MIPI DSI"
	depends on DRM_CVITEK
	select DRM_MIPI_DSI
	select DRM_PANEL
	help
	  If you want to enable MIPI DSI on Cvitek SoC, you should
	  select this option.

config CVITEK_LVDS
	bool "Cvitek specific extensions for LVDS"
	help
	  If you want to enable LVDS on Cvitek SoC, you should
	  select this option.

choice
    prompt "Cvitek display0 output"
	depends on DRM_CVITEK
    default CVITEK_MIPI_DSI0

	config CVITEK_MIPI_DSI0
		depends on CVITEK_MIPI_DSI
		bool "MIPI DSI0"
		help
		If you want to enable MIPI DSI on Cvitek SoC, you should
		select this option.

	config CVITEK_LVDS0
		depends on CVITEK_LVDS
		bool "LVDS0"
		help
		If you want to enable LVDS0 on Cvitek SoC, you should
		select this option.

endchoice

choice
    prompt "Cvitek display1 output"
	depends on DRM_CVITEK
    default CVITEK_HDMI

	config CVITEK_MIPI_DSI1
		depends on CVITEK_MIPI_DSI
		bool "MIPI DSI1"
		help
		If you want to enable MIPI DSI1 on Cvitek SoC, you should
		select this option.

	config CVITEK_HDMI
		depends on CVITEK_DW_HDMI
		bool "HDMI"
		help
		If you want to enable HDMI on Cvitek SoC, you should
		select this option.

	config CVITEK_LVDS1
		depends on CVITEK_LVDS
		bool "LVDS1"
		help
		If you want to enable LVDS1 on Cvitek SoC, you should
		select this option.

endchoice
```

## drivers/gpu/drm/img-rogue/Kconfig
```kconfig
config POWERVR_ROGUE
	tristate "PowerVR GPU"
	default n
	depends on DRM
	help
	  Driver for PowerVR graphics processor hardware.

	  Say Y here if your SoC contains a PowerVR GPU. For more
	  information, see <http://www.imgtec.com/powervr/>.
```

## drivers/gpu/drm/nulldisp/Kconfig
```kconfig
# SPDX-License-Identifier: GPL-2.0
config POWERVR_ROGUE_NULLDRMDISP
	tristate "null drm disp"
	default n
	depends on DRM && POWERVR_ROGUE
	select DRM_KMS_HELPER
        help
          This enables powervr null drm display driver
```

## drivers/gpu/drm/sunxi/Kconfig
```kconfig
menuconfig DRM_SUNXI
    tristate "DRM Support for Allwinnertech SoC A and R Series"
    depends on DRM && ARCH_SUNXI
    select DRM_KMS_HELPER
    help
      Choose this for Allwintertech  A64 R18 and others.
config DRM_SUNXI_ROTATER
	bool "Support the sunxi rotate device"

config DRM_SUNXI_HDMI
	bool "Support the sunxi hdmi device"
```

## drivers/gpu/ion/Kconfig
```kconfig
menuconfig ION
	tristate "Ion Memory Manager"
	select GENERIC_ALLOCATOR
	select DMA_SHARED_BUFFER
	help
	  Chose this option to enable the ION Memory Manager.

config ION_TEGRA
	tristate "Ion for Tegra"
	depends on ARCH_TEGRA && ION
	help
	  Choose this option if you wish to use ion on an nVidia Tegra.

config ION_SUNXI
	bool "ion for sunxi"
	depends on ARCH_SUNXI && ION
	help
	  ION for sunxi platforms.
      
config ION_SUNXI_RESERVE_LIST
	string "memory size(in MB) array for sunxi ion heap."
	default "96m,150m"
	depends on ION_SUNXI
	help
	  Select memory size for sunxi ion heap, the memory is used by modules that need physical continous memory.
	  This memory is either for CMA or for CARVE_OUT heap:
	  	if CONFIG_CMA is defined, the memory is reserved for CMA;
	  	if CONFIG_CMA not defined, the memory is reserved for CARVE_OUT heap;
	  Examples:
		96m,150m =>reserve 96m for 512M memory,150m for 1G memory
```

## drivers/hwmon/da380/Kconfig
```kconfig
#
# I2C gsensor chip drivers configuration
#

menuconfig DA380 
	bool "DA380 support"

if DA380
	  
config SENSORS_DA380
	tristate "DA380 acceleration sensor support"
	depends on I2C
	default m
	help
	  If you say yes here you get support for Bosch Sensortec's 
	  acceleration sensors DA380.

endif
```

## drivers/input/sensor/Kconfig
```kconfig
#
# sensor driver configuration
#
menuconfig INPUT_SENSOR
	bool "Sensors"
	help
	  Say Y here, and a list of supported sensor will be displayed.
	  This option doesn't affect the kernel.

	  If unsure, say Y.

if INPUT_SENSOR
config SENSORS_SC7A20
        tristate "SC7A20 3-Axis Orientation/Motion Detection Sensor Support"
        select I2C
        depends on INPUT_SENSOR
        default n
        help
          If you say yes here you get support for the Freescale 3-Axis
          Orientation/Motion Detection Sensor.

config SENSORS_MIR3DA
        tristate "mir3da 3-Axis Orientation/Motion Detection Sensor Support"
        select I2C
        depends on INPUT_SENSOR
        default n
        help
          If you say yes here you get support for the mir3da 3-Axis
          Orientation/Motion Detection Sensor.

config STK3X1X
	tristate "stl3x1x Light driver support"
	depends on I2C
	default n
	help
		This driver implements light device driver.
		It communicates with a back-end in another domain.
		To compile this driver as a module, choose M here: the
			module will be called xen-kbdfront.

config SUNXI_GPADC
        tristate "sunxi gpadc driver support"
        depends on INPUT_SENSOR
        default n
        help
          If you say yes here you get support for the gpadc collect analog input


endif
```

## drivers/input/sensor/da380/Kconfig
```kconfig
#
# I2C gsensor chip drivers configuration
#

config SENSORS_DA380
	tristate "DA380 acceleration sensor support"
	depends on INPUT_SENSOR && I2C
	default m
	help
	  If you say yes here you get support for Bosch Sensortec's 
	  acceleration sensors DA380.
```
