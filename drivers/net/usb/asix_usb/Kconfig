## drivers/net/usb/asix_usb/Kconfig
```kconfig
config USB_NET_ASIX
	tristate "ASIX USB 3.0/2.0 to Gigabit Ethernet"
	depends on USB_USBNET
	help
	  This option adds support for ASIX USB3.0/2.0 Gigabit Ethernet Network
	  Adapter Driver Compilation & Configuration on Linux
```

## drivers/net/wireless/aic8800/Kconfig
```kconfig
config AIC_WLAN_SUPPORT
	bool "AIC wireless Support"
	default n
	help
	  This is support for aic wireless chip.

choice
	prompt "Enable Chip Interface"
	depends on AIC_WLAN_SUPPORT
	help
		Enable Chip Interface.
config AIC_INTF_SDIO
		bool "SDIO interface support"
		depends on AIC_WLAN_SUPPORT && MMC
config AIC_INTF_USB
		bool "USB interface support"
		depends on AIC_WLAN_SUPPORT && USB
endchoice

choice
	prompt "Choice host wake IRQ type"
	default AIC_IRQ_ACTIVE_UNSET
	help
		Choice host wake IRQ type.
config AIC_IRQ_ACTIVE_UNSET
		bool "UNSET IRQ type use default config"
config AIC_IRQ_ACTIVE_HIGH
		bool "host wake High level trigger"
config AIC_IRQ_ACTIVE_RISING
		bool "host wake RISING trigger"
config AIC_IRQ_ACTIVE_LOW
		bool "host wake Low level trigger"
config AIC_IRQ_ACTIVE_FALLING
		bool "host wake FALLING trigger"
endchoice

config USB_MSG_EP
	bool "Enable usb message endpoint"
	default y if AIC_INTF_USB
	depends on AIC_INTF_USB
	help
	  This would enable usb message endpoint

if AIC_WLAN_SUPPORT
source "drivers/net/wireless/aic8800/aic8800_fdrv/Kconfig"
source "drivers/net/wireless/aic8800/aic8800_btlpm/Kconfig"
endif

if AIC_INTF_USB
source "drivers/net/wireless/aic8800/aic8800_btusb/Kconfig"
endif
```

## drivers/net/wireless/aic8800/aic8800_btlpm/Kconfig
```kconfig
config AIC8800_BTLPM_SUPPORT
	tristate "AIC8800 bluetooth Support (UART)"
	help
	  This is support for aic uart bluetooh driver.
```

## drivers/net/wireless/hflps170/Kconfig
```kconfig
config HFLPS170
	tristate "hi-flying HF-LPS170 SDIO WiFi"
	help
	  Help message of HFLPS170
```

## drivers/net/wireless/realtek/rtl8852be/Kconfig
```kconfig
config RTL8852BE
	tristate "Realtek 8852B PCIE WiFi"
	depends on WLAN && PCI && CFG80211
	help
	  Help message of RTL8852BE
```

## drivers/net/wireless/realtek/rtl8852bs/Kconfig
```kconfig
config RTL8852BS
	tristate "Realtek 8852B SDIO Wireless driver"
	depends on WLAN && MMC && CFG80211
	help
	This option enables support for RTL8852BS SDIO drivers
```

## drivers/net/wireless/rtl8189fs/Kconfig
```kconfig
config RTL8189FS
	tristate "Realtek 8189FS SDIO WiFi"
	depends on USB
	---help---
	  Help message of RTL8189FS
```

## drivers/net/wireless/rtl8703as/Kconfig
```kconfig
config RTL8723BS_VQ0
	tristate "Realtek 8723BS_VQ0 WiFi"
	select WIRELESS_EXT
	select WEXT_PRIV
	---help---
	  Help message of RTL8723BS_VQ0
```

## drivers/net/wireless/rtl8723bs/Kconfig
```kconfig
config RTL8723BS
	tristate "Realtek 8723B SDIO WiFi"
	select WIRELESS_EXT
	select WEXT_PRIV
	---help---
	  Help message of RTL8723BS
```

## drivers/net/wireless/rtl88x2CU/Kconfig
```kconfig
config RTL8822CU
	tristate "Realtek 8822C USB WiFi"
	depends on USB
	help
	  Help message of RTL8822CU
```

## drivers/net/wireless/rtl88x2cs/Kconfig
```kconfig
config RTL8822CS
	tristate "Realtek 8822C SDIO WiFi"
	help
	  Help message of RTL8822CS
```

## drivers/net/wireless/ssv6051/Kconfig
```kconfig
# SPDX-License-Identifier: GPL-2.0-only
config SSV6051
        tristate "South Silicon Valley (ssv) 6051 family WLAN support"
	depends on MAC80211
	depends on (MMC = y)
        default n
	select FW_LOADER
        help
		Enable South Silicon Valley (SSV) 6051 family support.
```

## drivers/net/wireless/xr819/Kconfig
```kconfig
menuconfig XR819_WLAN
	tristate "XR819 WLAN support"
	default n
	select CFG80211
	select AVERAGE
	select CRYPTO
	select CRYPTO_ARC4
	---help---
	  To compile this code as a module, choose M here.

if XR819_WLAN

source "drivers/net/wireless/xr819/umac/Kconfig"
source "drivers/net/wireless/xr819/wlan/Kconfig"

endif # XR819_WLAN
```

## drivers/net/wireless/xr829/Kconfig
```kconfig
config XR829_WLAN
	tristate "XR829 WLAN support"
	default n
	select CFG80211
	select AVERAGE
	select CRYPTO
	select CRYPTO_ARC4
	---help---
	  To compile this code as a module, choose M here.
```

## drivers/net/wireless/xr829/umac/Kconfig
```kconfig
menuconfig XRMAC
	tristate "XRadio MAC features"
	default m
	---help---
	  To compile this code as a module, choose M here.

if XRMAC

config XRMAC_RC_DEFAULT
	string "XRMAC_RC_DEFAULT"
	default "minstrel_ht"
	---help---

config XRMAC_RC_PID
	bool "XRMAC_RC_PID"
	depends on XRMAC
	default n
	---help---

config XRMAC_RC_MINSTREL
	bool "XRMAC_RC_MINSTREL"
	depends on XRMAC
	default y
	---help---

config XRMAC_RC_MINSTREL_HT
	bool "Minstrel 802.11n support" if EXPERT
	depends on XRMAC_RC_MINSTREL
	default y
	---help---
	  This option enables the 'minstrel_ht' TX rate control algorithm

config XRMAC_DEBUGFS
	bool "XRMAC_DEBUGFS"
	depends on XRMAC
	default y
	---help---
	  This option enables the debugfs of 'minstrel'(TX rate control algorithm)

endif
```

## drivers/net/wireless/xradio/Kconfig
```kconfig
# SPDX-License-Identifier: GPL-2.0-only

config WLAN_VENDOR_XRADIO
       tristate "XRADIO WLAN support"
       depends on MAC80211
       default y
	help
	  If you have a wireless card belonging to this class, say Y.

	  Note that the answer to this question doesn't directly affect the
	  kernel: saying N will just cause the configurator to skip all
	  the questions about cards. If you say Y, you will be asked for
	  your specific card in the following questions.

if WLAN_VENDOR_XRADIO

config XRADIO_NON_POWER_OF_TWO_BLOCKSIZES
	bool "Platform supports non-power-of-two SDIO transfer"
	depends on WLAN_VENDOR_XRADIO
	default y
	help
	  Say N here only if you are running the driver on a platform
	  which does not have support for non-power-of-two SDIO transfer.
	  If unsure, say Y.

config XRADIO_5GHZ_SUPPORT
	bool "5GHz band support"
	depends on WLAN_VENDOR_XRADIO
	default n
	help
	  Say Y if your device supports 5GHz band. If unsure, say N.

config XRADIO_WAPI_SUPPORT
	bool "WAPI support"
	depends on WLAN_VENDOR_XRADIO
	default n
	help
	  Say Y if your compat-wireless support WAPI.
	  If unsure, say N.

config XRADIO_USE_EXTENSIONS
	bool "Extensions for WFD and PS mode"
	depends on WLAN_VENDOR_XRADIO
	default y
	help
	  Say Y if you want to include XR extensions
	  If unsure, say Y.

endif # WLAN_VENDOR_XRADIO
```

## drivers/osdrv/extdrv/wireless/realtek/Kconfig
```kconfig
source "osdrv/extdrv/wireless/realtek/rtl8188f/Kconfig"
source "osdrv/extdrv/wireless/realtek/rtl8189fs/Kconfig"
```

## drivers/osdrv/extdrv/wireless/realtek/rtl8822ce/Kconfig
```kconfig
config RTL8822BE
	tristate "Realtek 8822C PCIE WiFi"
	depends on PCI
	---help---
	  Help message of RTL8822CE
```

## drivers/osdrv/extdrv/wireless/realtek/rtl8852be/Kconfig
```kconfig
config RTL8852BE
	tristate "Realtek 8852B PCIE WiFi"
	depends on PCIE
	---help---
	  Help message of RTL8852BE
```

## drivers/osdrv/extdrv/wireless/realtek/rtl8852ce/Kconfig
```kconfig
config RTL8852CE
	tristate "Realtek 8852C PCIE WiFi"
	depends on PCIE
	---help---
	  Help message of RTL8852CE
```

## drivers/osdrv/interdrv/v2/usb/bmusb/Kconfig
```kconfig
config USB_BM_DRD
	tristate "Bitmain USB DRD Core Support"
	depends on USB && HAS_DMA
	select USB_XHCI_PLATFORM if USB_SUPPORT && USB_XHCI_HCD
	help
	  Say Y or M here if your system has a Dual Role SuperSpeed
	  USB controller based on the Bitmain USB3 IP Core.

	  If you choose to build this driver is a dynamically linked
	  module, the module will be called bmusb_drd.ko.

if USB_BM_DRD

config USB_BM_MISC
	bool "Additional miscellaneous device for ioctl"
	depends on (USB=y || USB=USB_BM_DRD)
	help
	  Select this if you want to send commands to driver
	  using I/O control.

	  The miscellaneous function includes the drd state
	  configuration and gadget standby mode.

endif

config USB_BM_GADGET
	tristate "Bitmain device controller"
	depends on USB_GADGET
	help
	  Say 'Y' or 'M' here to enable device controller functionality
	  of the Bitmain driver.

comment "Platform Glue Driver Support"
```

## drivers/osdrv/interdrv/v2/usb/cviusb/Kconfig
```kconfig
config USB_CVITEK_DRD
	tristate "Cvitek USB DRD Core Support"
	depends on USB && HAS_DMA
	select USB_XHCI_PLATFORM if USB_SUPPORT && USB_XHCI_HCD
	help
	  Say Y or M here if your system has a Dual Role SuperSpeed
	  USB controller based on the Cvitek USB3 IP Core.

	  If you choose to build this driver is a dynamically linked
	  module, the module will be called cviusb_drd.ko.

if USB_CVITEK_DRD

config USB_CVITEK_MISC
	bool "Additional miscellaneous device for ioctl"
	depends on (USB=y || USB=USB_CVITEK_DRD)
	help
	  Select this if you want to send commands to driver
	  using I/O control.

	  The miscellaneous function includes the drd state
	  configuration and gadget standby mode.

endif

config USB_CVITEK_GADGET
	tristate "Cvitek device controller"
	depends on USB_GADGET
	help
	  Say 'Y' or 'M' here to enable device controller functionality
	  of the Cvitek driver.

comment "Platform Glue Driver Support"
```

## drivers/phy/cix/Kconfig
```kconfig
# SPDX-License-Identifier: GPL-2.0-only
#
# Phy drivers for Cix PHYs
#

config PHY_CIX_USBDP
	tristate "Cix USBDP PHY Driver"
	depends on OF && HAS_IOMEM
	select GENERIC_PHY
	help
	  Enable this to support the CIX USBDP PHY for TYPEC Connection

config PHY_CIX_USB2
	tristate "Cix USB2 PHY Driver"
	depends on OF
	select GENERIC_PHY
	help
	  Enable this to support the CIX USB2 PHY

config PHY_CIX_USB3
	tristate "Cix USB3 PHY Driver"
	depends on OF && HAS_IOMEM
	select GENERIC_PHY
	help
	  Enable this to support the CIX USB3 PHY for TYPEA Connection

config PHY_CIX_PCIE
	tristate "Cix PCIE PHY Driver"
	depends on OF && HAS_IOMEM
	select GENERIC_PHY
	help
	  Enable this to support the CIX PCIE PHY
```

## drivers/pinctrl/sunxi/Kconfig
```kconfig
if ARCH_SUNXI
menu "Allwinner SOC PINCTRL DRIVER"

config PINCTRL_SUNXI
	bool
	select PINMUX
	select GENERIC_PINCONF

config PINCTRL_SUNXI_TEST
	tristate "pinctrl sunxi test driver"
	default n

config PINCTRL_SUN4I_A10
	def_bool MACH_SUN4I
	select PINCTRL_SUNXI

config PINCTRL_SUN5I_A10S
	def_bool MACH_SUN5I
	select PINCTRL_SUNXI

config PINCTRL_SUN5I_A13
	def_bool MACH_SUN5I
	select PINCTRL_SUNXI

config PINCTRL_GR8
	def_bool MACH_SUN5I
	select PINCTRL_SUNXI_COMMON

config PINCTRL_SUN6I_A31
	def_bool MACH_SUN6I
	select PINCTRL_SUNXI

config PINCTRL_SUN6I_A31S
	def_bool MACH_SUN6I
	select PINCTRL_SUNXI

config PINCTRL_SUN6I_A31_R
	def_bool MACH_SUN6I
	depends on RESET_CONTROLLER
	select PINCTRL_SUNXI

config PINCTRL_SUN7I_A20
	def_bool MACH_SUN7I
	select PINCTRL_SUNXI

config PINCTRL_SUN8I_A23
	def_bool MACH_SUN8I
	select PINCTRL_SUNXI

config PINCTRL_SUN8I_A33
	def_bool MACH_SUN8I
	select PINCTRL_SUNXI

config PINCTRL_SUN8I_A83T
	def_bool MACH_SUN8I
	select PINCTRL_SUNXI

config PINCTRL_SUN8I_A23_R
	def_bool MACH_SUN8I
	depends on RESET_CONTROLLER
	select PINCTRL_SUNXI

config PINCTRL_SUN8I_H3
	def_bool MACH_SUN8I
	select PINCTRL_SUNXI

config PINCTRL_SUN8I_H3_R
	def_bool MACH_SUN8I
	select PINCTRL_SUNXI_COMMON

config PINCTRL_SUN9I_A80
	def_bool MACH_SUN9I
	select PINCTRL_SUNXI

config PINCTRL_SUN9I_A80_R
	def_bool MACH_SUN9I
	depends on RESET_CONTROLLER
	select PINCTRL_SUNXI

config PINCTRL_SUN8IW6P1
	def_bool ARCH_SUN8IW6
	depends on ARCH_SUN8IW6
	bool "Pinctrl sun8iw6p1 PIO controller"
	select PINCTRL_SUNXI_COMMON

config PINCTRL_SUN8IW6P1_R
	def_bool PINCTRL_SUN8IW6P1
	depends on PINCTRL_SUN8IW6P1
	bool "Pinctrl PINCTRL_SUN8IW6P1 R_PIO controller"
	select PINCTRL_SUNXI_COMMON

config PINCTRL_SUN8IW7P1
	def_bool ARCH_SUN8IW7
	depends on ARCH_SUN8IW7
	bool "Pinctrl sun8iw7p1 PIO controller"
	select PINCTRL_SUNXI_COMMON

config PINCTRL_SUN8IW7P1_R
	def_bool PINCTRL_SUN8IW7P1
	depends on PINCTRL_SUN8IW7P1
	bool "Pinctrl PINCTRL_SUN8IW7P1 R_PIO controller"
	select PINCTRL_SUNXI_COMMON

config PINCTRL_SUN8IW11P1
	def_bool ARCH_SUN8IW11
	depends on ARCH_SUN8IW11
	bool "Pinctrl sun8iw11p1 PIO controller"
	select PINCTRL_SUNXI_COMMON

config PINCTRL_SUN8IW15P1
	def_bool ARCH_SUN8IW15
	depends on ARCH_SUN8IW15
	bool "Pinctrl sun8iw15p1 PIO controller"
	select PINCTRL_SUNXI_COMMON

config PINCTRL_SUN8IW15P1_R
	def_bool PINCTRL_SUN8IW15P1
	depends on PINCTRL_SUN8IW15P1
	bool "Pinctrl PINCTRL_SUN8IW15P1 R_PIO controller"
	select PINCTRL_SUNXI_COMMON

config PINCTRL_SUN8IW17P1
	def_bool ARCH_SUN8IW17
	depends on ARCH_SUN8IW17
	bool "Pinctrl sun8iw17p1 PIO controller"
	select PINCTRL_SUNXI_COMMON

config PINCTRL_SUN8IW17P1_R
	def_bool PINCTRL_SUN8IW17P1
	depends on PINCTRL_SUN8IW17P1
	bool "Pinctrl PINCTRL_SUN8IW17P1 R_PIO controller"
	select PINCTRL_SUNXI_COMMON

config PINCTRL_SUN50IW1P1
	def_bool ARCH_SUN50IW1P1
	depends on ARCH_SUN50IW1P1
	bool "Pinctrl sun50iw1p1 PIO conctrller"
	select PINCTRL_SUNXI

config PINCTRL_SUN50IW1P1_R
	def_bool ARCH_SUN50IW1P1
	depends on ARCH_SUN50IW1P1
	bool "Pinctrl sun50iw1p1 R_PIO conctrller"
	select PINCTRL_SUNXI
config PINCTRL_SUN50IW3P1
	def_bool ARCH_SUN50IW3P1
	depends on ARCH_SUN50IW3P1
	bool "Pinctrl sun50iw3p1 PIO conctrller"
	select PINCTRL_SUNXI

config PINCTRL_SUN50IW3P1_R
	def_bool ARCH_SUN50IW3P1
	depends on ARCH_SUN50IW3P1
	bool "Pinctrl sun50iw3p1 R_PIO conctrller"
	select PINCTRL_SUNXI

config PINCTRL_SUN50IW6P1
	def_bool ARCH_SUN50IW6P1
	depends on ARCH_SUN50IW6P1
	bool "Pinctrl sun50iw6p1 PIO controller"
	select PINCTRL_SUNXI

config PINCTRL_SUN50IW6P1_R
	def_bool ARCH_SUN50IW6P1
	depends on ARCH_SUN50IW6P1
	bool "Pinctrl sun50iw6p1 R_PIO controller"
	select PINCTRL_SUNXI

config PINCTRL_SUN50IW8P1
	def_bool ARCH_SUN50IW8P1
	depends on ARCH_SUN50IW8P1
	bool "Pinctrl sun50iw8p1 PIO conctrller"
	select PINCTRL_SUNXI

config PINCTRL_SUN50IW8P1_R
	def_bool ARCH_SUN50IW8P1
	depends on ARCH_SUN50IW8P1
	bool "Pinctrl sun50iw8p1 R_PIO conctrller"
	select PINCTRL_SUNXI

config PINCTRL_SUN8IW18P1
	def_bool ARCH_SUN8IW18
	depends on ARCH_SUN8IW18
	bool "Pinctrl sun8iw18p1 PIO controller"
	select PINCTRL_SUNXI_COMMON

config PINCTRL_SUN8IW18P1_R
	def_bool PINCTRL_SUN8IW18P1
	depends on PINCTRL_SUN8IW18P1
	bool "Pinctrl PINCTRL_SUN8IW18P1 R_PIO controller"
	select PINCTRL_SUNXI_COMMON
config PINCTRL_SUN50IW5T
	def_bool ARCH_SUN50IW5T
	depends on ARCH_SUN50IW5T
	bool "Pinctrl sun50iw5t PIO conctrller"
	select PINCTRL_SUNXI

config PINCTRL_SUN50IW5T_R
	def_bool ARCH_SUN50IW5T
	depends on ARCH_SUN50IW5T
	bool "Pinctrl sun50iw5t R_PIO conctrller"
	select PINCTRL_SUNXI

config PINCTRL_SUN50IW9P1
	def_bool ARCH_SUN50IW9P1
	depends on ARCH_SUN50IW9P1
	bool "Pinctrl sun50iw9p1 PIO controller"
	select PINCTRL_SUNXI

config PINCTRL_SUN50IW9P1_R
	def_bool ARCH_SUN50IW9P1
	depends on ARCH_SUN50IW9P1
	bool "Pinctrl sun50iw9p1 R_PIO controller"
	select PINCTRL_SUNXI

config PINCTRL_SUN50IW10P1
	def_bool ARCH_SUN50IW10P1
	depends on ARCH_SUN50IW10P1
	bool "Pinctrl sun50iw10p1 PIO controller"
	select PINCTRL_SUNXI

config PINCTRL_SUN50IW10P1_R
	def_bool ARCH_SUN50IW10P1
	depends on ARCH_SUN50IW10P1
	bool "Pinctrl sun50iw10p1 R_PIO controller"
	select PINCTRL_SUNXI

endmenu
endif
```
