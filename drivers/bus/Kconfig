## drivers/bus/Kconfig
```kconfig
#
# Bus Devices
#

menu "Bus devices"

config SUNXI_GTBUS
	bool "SUNXI GTBUS driver support"
	depends on ARCH_SUNXI && HWMON && ARCH_SUN9IW1
	help
	  Driver supporting the gt bus for sun9i
	  platforms.

config SUNXI_MBUS
	bool "SUNXI MBUS driver support"
	depends on ARCH_SUNXI && HWMON && ARCH_SUN8I
	help
	  Driver supporting the mbus for sun8i
	  platforms.
endmenu
```

## drivers/char/arisc_test/Kconfig
```kconfig
#
# sunxi arisc test configuration.
#

config SUNXI_ARISC_TEST
	tristate "sunxi arisc test driver"
	default m
	help
	Nothing help.

	
```

## drivers/char/cma_test/Kconfig
```kconfig
#
# sunxi cma test driver.
#

config SUNXI_CMATESET
	bool "sunxi cma test driver"
	depends on CMA
	default y
	help
	Nothing help.
```

## drivers/char/cpus_test/Kconfig
```kconfig
#
# sunxi cpus test configuration.
#

config SUNXI_CPUS_TEST
	tristate "sunxi cpus test driver"
	default m
	help
	Nothing help.

	
```

## drivers/char/dump_reg/Kconfig
```kconfig
#
# dump reg config.
#

config DUMP_REG
	tristate "dump reg driver for sunxi platform"
	default y
	---help---
	  Say y here if you want to support dump regs module.
	  The dump regs module is used to dump regs of any device.
	  When in doubt, say "Y".

config DUMP_REG_MISC
	tristate "dump reg misc driver"
	depends on DUMP_REG
	default y
	---help---
	  Add misc driver support, you can use dump regs function
	  via ("/sys/class/...") sysfs interface.
	  When in doubt, say "Y".
```

## drivers/char/sunxi-di/Kconfig
```kconfig
menuconfig SUNXI_DI
	tristate "Allwinnertech DE-Interlace Driver"
	default n
	help
	  This is an option for de-interlace.

config SUNXI_DI_V1XX
  bool "Support DI V110/120"
  depends on (SUNXI_DI)
  default n
  ---help---
  Say Y here if you want to use DI110/120.
  Say N here if you do NOT want to use DI110/120.
  If unsure, say N.

config SUNXI_DI_V2X
  bool "Support DI V200"
  depends on (SUNXI_DI)
  default n
  ---help---
  Say Y here if you want to use DI200.
  Say N here if you do NOT want to use DI200.
  If unsure, say N.

config SUNXI_DI_V3X
  bool "Support DI V300"
  depends on (SUNXI_DI)
  default n
  ---help---
  Say Y here if you want to use DI300.
  Say N here if you do NOT want to use DI300.
  If unsure, say N.
```

## drivers/char/sunxi-gralloc/Kconfig
```kconfig
config SUNXI_GRALLOC
	depends on (ARCH_SUNXI)
	tristate "SUNXI GRALLOC Driver"
	default n
	help
	  Record gralloc buffer operations
```

## drivers/char/sunxi-scr/Kconfig
```kconfig
config SUNXI_SCR
	tristate "allwinnertech smartcard driver"
	default n
	help
	  allwinnertech smart card driver
```

## drivers/char/sunxi-sysinfo/Kconfig
```kconfig
#
# sunxi system information driver.
#

config SUNXI_SYS_INFO
	tristate "sunxi system info driver"
	default n
	help
	  This driver is used for query system information.
	  If you don't know whether need it, please select y.

config SUNXI_QA_TEST
	bool "sunxi QA test"
	depends on SUNXI_SYS_INFO
	help
	  support sunxi QA test.


config SUNXI_SMC
	tristate "sunxi smc interfaces"
	default n
	help
	  This driver support smc call interfaces depended on
	  monitor/aft/SecureOs. If you don't know whether need
	  it, please select y.
```

## drivers/char/sunxi_g2d/Kconfig
```kconfig
config SUNXI_G2D
	depends on (ARCH_SUNXI)
	tristate "SUNXI G2D Driver"
	default n
	help
	  Enable sunxi platform 2D Graphics engine

config SUNXI_G2D_MIXER
	depends on (SUNXI_G2D)
	bool "sunxi g2d mixer module"
	default n
	help
	  Choose Y to enable mixer module of g2d

config SUNXI_G2D_ROTATE
	depends on (SUNXI_G2D)
	bool "sunxi g2d rotate module"
	default n
	help
	  Choose Y to enable rotate module of g2d

config SUNXI_SYNCFENCE
	depends on (SUNXI_G2D)
	select SYNC_FILE
	default y
	bool "sunxi sync fence implement for rotate jobs synchronous"
	help
	  Choose Y to enable sync fence implement for sunxi G2D
```

## drivers/char/sunxi_id/Kconfig
```kconfig
#
# sunxi continous physic memory allocator.
#

config ID
	bool "sunxi  id "
	default n
	help
	Nothing help.
```

## drivers/char/sunxi_ir_cut/Kconfig
```kconfig
#
# sunxi continous physic memory allocator.
#

config IR_CUT
	bool "sunxi IR CUT "
	default n
	help
	Nothing help.
```

## drivers/char/sunxi_key/Kconfig
```kconfig
#
# sunxi continous physic memory allocator.
#

config RESET_KEY
	bool "sunxi rest_key "
	default n
	help
	Nothing help.
```

## drivers/char/sunxi_module/Kconfig
```kconfig
#
# sunxi module driver configuration.
#
config SUNXI_MODULE
	tristate "sunxi module driver"
	depends on ARCH_SUNXI
	help
	  sunxi module driver support sunxi family SOCs.
	  add sunxi-moudle to manage all module's information include
	  firmware version and commit information and so on.
	  Set y here to support the sunxi module driver.
	  If unsure, set N.
```

## drivers/char/sunxi_soc_info/Kconfig
```kconfig
#
# sunxi cpus test configuration.
#

config SUNXI_SOC_INFO
	tristate "sunxi SOC info driver"
	default y

	
```

## drivers/char/sunxi_standby/Kconfig
```kconfig
#
# sunxi standby debug config.
#

config SUNXI_STANDBY_DEBUG
	tristate "sunxi standby debug driver"
	depends on ARCH_SUNXI && PM && (ARM || ARM64)
	default y
	---help---
	  Say y here if you want to support standby debug module.
	  The standby debug module is used to debug system suspend.
	  When in doubt, say "Y".
```

## drivers/char/sunxi_sw_sync/Kconfig
```kconfig
config SUNXI_SW_SYNC
	depends on SYNC_FILE
	tristate "Software Sync File Framework for sunxi platform"
	default n
	---help---
	  A sync object driver that uses a 32bit counter to coordinate
	  synchronization.  Useful when there is no hardware primitive backing
	  the synchronization.
```

## drivers/char/sunxi_tr/Kconfig
```kconfig
#
# Transform configuration for sunxi platform
#

config SUNXI_TRANSFORM
  tristate "Transform Driver Support(sunxi)"
  depends on ARCH_SUNXI
  default n
  ---help---
```

## drivers/char/tda7729/Kconfig
```kconfig
config TDA7729_AUDIO_DSP
tristate "external audio asp support  multiple input and output"
default M
help
This is SUN8I external asp driver
```

## drivers/char/timer_test/Kconfig
```kconfig
#
# sunxi timer test configuration.
#

config SUNXI_TIMER_TEST
	tristate "sunxi timer test driver"
	default n
	help
	Nothing help.
```

## drivers/clk/cix/Kconfig
```kconfig
# SPDX-License-Identifier: GPL-2.0
# Common clock support for Cixtech SoC family
menu "Clock support for Cixtech"

comment "Clock options for Cixtech CPUs:"

config COMMON_CLK_CIX
	tristate "Support for Cix's clock controllers"
	depends on ARCH_CIX || COMPILE_TEST
	select REGMAP_MMIO
	select RESET_CONTROLLER

config CIX_CLK_DEBUG
	tristate "Cix SoC Clock Debug Driver"
	depends on COMMON_CLK_CIX
	help
	  Support on-line debug soc clocks from the debugfs interface.

config CLK_SKY1_AUDSS
	tristate "Cixtech Sky1 Audio Subsystem Clock Driver"
	depends on COMMON_CLK_CIX || COMPILE_TEST
	help
	    Support for the Audio Subsystem clock controller present on
	    Cixtech Sky1 SoC. Choose M or Y here if you want to build this
	    driver.

config CIX_ACPI_CLK
        bool "CIX Clock Management API for acpi"
        depends on ARCH_CIX && ACPI
        help
          This provid the clock management API for CIX Technologies,Inc.
          Say Y if you want to supprot clock driver.

endmenu
```

## drivers/clk/sunxi-ng/Kconfig
```kconfig
# SPDX-License-Identifier: GPL-2.0-only
config SUNXI_CCU
	tristate "Clock support for Allwinner SoCs"
	depends on ARCH_SUNXI || COMPILE_TEST
	select RESET_CONTROLLER
	select SUNXI_RTC_CCU
	default ARCH_SUNXI

if SUNXI_CCU
config SUN50IW10_CCU
	tristate "Support for the Allwinner SUN50IW10 CCU"
	default ARCH_SUN50IW10
	depends on ARCH_SUNXI || COMPILE_TEST

config SUN50IW10_R_CCU
	tristate "Support for the Allwinner SUN50IW10 PRCM CCU"
	default ARCH_SUN50IW10
	depends on ARCH_SUNXI || COMPILE_TEST

config SUN50IW10_DDR_CCU
	tristate "Support for the Allwinner A100 DDR CCU"
	default ARCH_SUN50IW10
	depends on ARCH_SUNXI || COMPILE_TEST

config SUN50IW9_CCU
	tristate "Support for the Allwinner SUN50IW9 CCU"
	default ARCH_SUN50IW9
	depends on (ARM64 && ARCH_SUNXI) || COMPILE_TEST

config SUN50IW9_R_CCU
	tristate "Support for the Allwinner SUN50IW9 PRCM CCU"
	default ARCH_SUN50IW9
	depends on (ARM64 && ARCH_SUNXI) || COMPILE_TEST

config SUNIV_F1C100S_CCU
	bool "Support for the Allwinner newer F1C100s CCU"
	default MACH_SUNIV
	depends on MACH_SUNIV || COMPILE_TEST

config SUN50I_A64_CCU
	bool "Support for the Allwinner A64 CCU"
	default ARM64 && ARCH_SUNXI
	depends on (ARM64 && ARCH_SUNXI) || COMPILE_TEST

config SUN50I_A100_CCU
	bool "Support for the Allwinner A100 CCU"
	default ARM64 && ARCH_SUNXI
	depends on (ARM64 && ARCH_SUNXI) || COMPILE_TEST

config SUN50I_A100_R_CCU
	bool "Support for the Allwinner A100 PRCM CCU"
	default ARM64 && ARCH_SUNXI
	depends on (ARM64 && ARCH_SUNXI) || COMPILE_TEST

config SUN50I_H6_CCU
	bool "Support for the Allwinner H6 CCU"
	default ARM64 && ARCH_SUNXI
	depends on (ARM64 && ARCH_SUNXI) || COMPILE_TEST

config SUN50I_H6_R_CCU
	bool "Support for the Allwinner H6 PRCM CCU"
	default ARM64 && ARCH_SUNXI
	depends on (ARM64 && ARCH_SUNXI) || COMPILE_TEST

config SUN4I_A10_CCU
	bool "Support for the Allwinner A10/A20 CCU"
	default MACH_SUN4I
	default MACH_SUN7I
	depends on MACH_SUN4I || MACH_SUN7I || COMPILE_TEST

config SUN5I_CCU
	bool "Support for the Allwinner sun5i family CCM"
	default MACH_SUN5I
	depends on MACH_SUN5I || COMPILE_TEST

config SUN6I_A31_CCU
	bool "Support for the Allwinner A31/A31s CCU"
	default MACH_SUN6I
	depends on MACH_SUN6I || COMPILE_TEST

config SUN8I_A23_CCU
	bool "Support for the Allwinner A23 CCU"
	default MACH_SUN8I
	depends on MACH_SUN8I || COMPILE_TEST

config SUN8I_A33_CCU
	bool "Support for the Allwinner A33 CCU"
	default MACH_SUN8I
	depends on MACH_SUN8I || COMPILE_TEST

config SUN8I_A83T_CCU
	bool "Support for the Allwinner A83T CCU"
	default MACH_SUN8I

config SUN8I_H3_CCU
	bool "Support for the Allwinner H3 CCU"
	default MACH_SUN8I || (ARM64 && ARCH_SUNXI)
	depends on MACH_SUN8I || (ARM64 && ARCH_SUNXI) || COMPILE_TEST

config SUN8I_V3S_CCU
	bool "Support for the Allwinner V3s CCU"
	default MACH_SUN8I
	depends on MACH_SUN8I || COMPILE_TEST

config SUN8I_DE2_CCU
	bool "Support for the Allwinner SoCs DE2 CCU"
	default MACH_SUN8I || (ARM64 && ARCH_SUNXI)

config SUN8I_R40_CCU
	bool "Support for the Allwinner R40 CCU"
	default MACH_SUN8I
	depends on MACH_SUN8I || COMPILE_TEST

config SUN9I_A80_CCU
	bool "Support for the Allwinner A80 CCU"
	default MACH_SUN9I
	depends on MACH_SUN9I || COMPILE_TEST

config SUN8I_R_CCU
	bool "Support for Allwinner SoCs' PRCM CCUs"
	default MACH_SUN8I || (ARCH_SUNXI && ARM64)

endif
config SUNXI_RTC_CCU
	tristate "Clock support in RTC domain for Allwinner SoCs"
	depends on ARCH_SUNXI
	default y
	help
	  sunxi clock provider in RTC domain, which provides clocks such as
          dcxo24M-out, iosc, osc32k, osc32k-out and rtc-1k. This module is
	  mandatory for sunxi SoCs. Say 'Y' here.
```

## drivers/cpuidle/Kconfig.arm
```kconfig
#
# ARM CPU Idle drivers
#
config ARM_CPUIDLE
        bool "Generic ARM/ARM64 CPU idle Driver"
        select DT_IDLE_STATES
        help
          Select this to enable generic cpuidle driver for ARM.
          It provides a generic idle driver whose idle states are configured
          at run-time through DT nodes. The CPUidle suspend backend is
          initialized by calling the CPU operations init idle hook
          provided by architecture code.
```

## drivers/crypto/sunxi-ce/Kconfig
```kconfig
# SPDX-License-Identifier: GPL-2.0-only

comment"Choose one according to the actual usage"

config CRYPTO_DEV_SUNXI
	tristate "CE support the AF_ALG interface for user api"
	depends on ARCH_SUNXI
	select CRYPTO_MD5
	select CRYPTO_SHA1
	select CRYPTO_AES
	select CRYPTO_DES
	select CRYPTO_BLKCIPHER
	help
	  Allwinner Sunxi SoC have a crypto accelerator named
	  CryptoEngine.Select this if you want to use it.

config CRYPTO_DEV_SUNXI_IOCTL
	tristate "CE support the systemcall interface for user api"
	depends on ARCH_SUNXI
	help
	  Allwinner Sunxi SoC have a crypto accelerator named
	  CryptoEngine.Select this if you want to use it.
```

## drivers/crypto/sunxi-emce/Kconfig
```kconfig
#
# sunxi emce driver configuration.
#
config SUNXI_EMCE
	tristate "sunxi emce driver"
	depends on ARCH_SUNXI && CRYPTO_SHA256
	help
	  Sunxi emce driver support sunxi family SOCs.
	  Set y here to support the sunxi emce driver.
	  If unsure, set N.
```
