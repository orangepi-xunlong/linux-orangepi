## drivers/soc/sunxi/arisc/Kconfig
```kconfig
#
# sunxi arisc driver configuration.
#
config SUNXI_ARISC
	tristate "sunxi arisc driver"
	depends on ARCH_SUNXI && HWSPINLOCK_SUNXI
	help
	  Arisc driver support sunxi family SOCs.
	  Previously known as "ar100" or "cpus".
	  Set y here to support the sunxi arisc driver.
	  If unsure, set N.

config MCPM_WITH_ARISC_DVFS_SUPPORT
	tristate "mcpm with arisc dvfs support"
	depends on MCPM && CPU_FREQ
	depends on EVB_PLATFORM && SUNXI_ARISC
	help
	  Arisc driver support dvfs when mcpm init.
	  Set y here to support mcpm with arisc dvfs.
	  If unsure, set N.
```

## drivers/staging/android/switch/Kconfig
```kconfig
menuconfig ANDROID_SWITCH
	tristate "Android Switch class support"
	help
	  Say Y here to enable Android switch class support. This allows
	  monitoring switches by userspace via sysfs and uevent.

config SWITCH_HEADSET
	tristate "swith headset support"
	help
	  Say Y here to enable GPIO based switch support.

config ANDROID_SWITCH_GPIO
	tristate "Android GPIO Switch support"
	depends on GENERIC_GPIO && ANDROID_SWITCH
	help
	  Say Y here to enable GPIO based switch support.

config SUNXI_SWITCH_GPIO
	bool "SUNXI GPIO Switch support"
	depends on ARCH_SUN8IW6
	help
	  Say Y here to enable GPIO based switch support.

config ANDROID_SWITCH_GPIO_TS3A225
	tristate "ts3a225 Switch support"
	depends on ARCH_SUN8IW6 && SUNXI_SWITCH_GPIO
	help
	  Say Y here to enable GPIO based switch support.

config SOC_SWITCH_GPIO
	tristate "GPIO Switch support"
	depends on ARCH_SUN8IW6 && SUNXI_SWITCH_GPIO
	help
	  Say Y here to enable GPIO based switch support.
```

## drivers/staging/fusb30x/Kconfig
```kconfig
config FUSB_30X
	tristate "Fairchild FUSB30X Type-C chip driver"
	depends on I2C
	help
	  This is a driver for the Fairchild FUSB302 Type-C chip.  It supports
	  USB Type-C PD functionality controlled using I2C.

	  This driver supports extcon reporting not yet implemented in the
	  mainline FUSB302 driver.
```

## drivers/staging/hievent/Kconfig
```kconfig
# SPDX-License-Identifier: GPL-2.0
config HIEVENT
	tristate "Enable hievent"
	help
	  hievent buffer manager

config BBOX_BUFFER_SIZE
	int "bbox buffer size"
	depends on HIEVENT
	default 2048
	help
	  Define the default ring buffer size of BBOX
```

## drivers/staging/hisysevent/Kconfig
```kconfig
# SPDX-License-Identifier: GPL-2.0
config HISYSEVENT
	tristate "Enable hisysevent"
	depends on HIEVENT
	help
	  Say Y here to enable hisysevent feature support.
```
