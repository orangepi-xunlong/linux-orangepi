## drivers/platform/chrome/cix_ec/Kconfig
```kconfig
# SPDX-License-Identifier: GPL-2.0-only
config CIX_EC
	tristate "CIX Embedded Controller"
	depends on CROS_EC_I2C
	help
	  If you say Y here, you get support for talking to the CIX EC over an I2C bus.
```

## drivers/power/axp_power/Kconfig
```kconfig
menuconfig AW_AXP
	bool "AXP Power drivers"
	depends on REGULATOR
	default y
	---help---
	This option allows you to select AXP power driver

if AW_AXP

config AW_AXP81X
	bool "AXP81X driver"
	depends on SUNXI_ARISC
	---help---
	AXP81X driver

menuconfig AW_AXP22
	bool "AXP22 driver"
	depends on SUNXI_ARISC
	---help---
	AXP22 driver

if AW_AXP22
config AXP809
	bool "AXP809 chip"
	depends on AW_AXP22
	---help---
	AXP809 driver
endif

config AW_AXP19
	bool "AXP19 driver"
	depends on I2C
	---help---
	AXP19 driver

config AW_AXP15
	bool "AXP15 driver"
	depends on SUNXI_ARISC
	---help---
	AXP15 driver

if AW_AXP15
config AXP15_IRQ
	tristate "AXP15 irq driver"
	default n
	depends on AW_AXP15
	---help---
	The irq driver for AXP808,
	When use AXP808 as the primary power manage IC,
	Need to enable.
endif

config AW_AXP20
	bool "AXP20 driver"
	depends on I2C
	depends on AXP_TWI_USED
	---help---
	AXP20 driver
	
if AW_AXP20
choice
	prompt "AXP calculate type:"
	default AW_AXP20_COU

	config AW_AXP20_COU
		bool "COULOMB"
		---help---
			AXP driver for coulomb
	config AW_AXP20_OCV
		bool "OCV"
		---help---
			AXP driver for ocv

endchoice
endif # !AW_AXP20
	
config AXP_CHARGEINIT
	bool "AXP initial charging environment set"
	default y

config AXP_CHGCHANGE
	bool "AXP charging current set when suspend\resume\shutdown"
	default y

config AXP_TWI_USED
	bool "AXP use twi as transfer channel"
	default n
	
endif # !AW_AXP
```

## drivers/pwm/Kconfig
```kconfig
menuconfig PWM
	bool "Pulse-Width Modulation (PWM) Support"
	help
	  Generic Pulse-Width Modulation (PWM) support.

config PWM_SUNXI
	tristate "sunxi pwm support"
	depends on PWM
	help
		Generic PWM framework driver for sunxi.

		To compile this driver as a moudle, choose M here: the module
		will be called pwm-sunxi
```

## drivers/soc/allwinner/Kconfig
```kconfig
#
# Allwinner sunXi SoC drivers
#
config SUNXI_SRAM
	bool "Allwinner SOC SRAM controlloer"
	default ARCH_SUNXI
	help
	  Say y here to enable the SRAM controller support. This
	  device is responsible on mapping the SRAM in the sunXi SoCs
	  whether to the CPU/DMA, or to the devices.

config SUNXI_BOOTUP_EXTEND
       bool "support ir bootup feature"
       depends on SUNXI_ARISC
       default y
       help
         support ir bootup feature.
         but must has the module known as "ar100" or "cpus".
         the feature is support power up with ir when poweroff.
```

## drivers/soc/cix/Kconfig
```kconfig
# SPDX-License-Identifier: GPL-2.0-only
menu "Cix Dst drivers"

config SOC_CIX
	bool "Cix Sky SoC family support"
	default n
	help
	  If you say yes here you get support for the Cix sky family
	  support, it will provide the SoC info like SoC family,
	  ID and revision etc.

config CIX_CPU_INSTPIPE_FRESH
	bool "fresh instpipe in sched_clock"
	depends on ARCH_CIX
	help
	  Say yes will fresh instpipe in sched_clock.

config CIX_SKY1_SOCINFO
	bool "Cix Sky1 SoC Information driver"
	depends on ARCH_CIX
	select SOC_BUS
	help
	  Say yes to support decoding of CIX Sky1 SoC family information
	  about the type and version.

config CIX_SE_CONFIG
	bool "Cix Sky1 AP config SE interface"
	depends on ARCH_CIX
	help
	  Say yes to support AP config SE settings by AP2SE mailbox

config CIX_SOC_ACPI
	bool "Cix SoC ACPI drivers"
	depends on ARCH_CIX && ACPI
	select SOC_BUS
	help
	  Say yes to support CIX SoC ACPI drivers.

config CIX_AP2SE_IPC
	bool "Cix AP2SE IPC drivers"
	depends on ARCH_CIX
	select CIX_MBOX
	help
	  Say yes to support Cix SE2AP IPC drivers.

if SOC_CIX
source "drivers/soc/cix/cix_dst/Kconfig"
endif #SOC_CIX

menu "Cix Performance"
source "drivers/soc/cix/sched/Kconfig"
endmenu # Cix Performance

endmenu
```

## drivers/soc/cix/cix_dst/Kconfig
```kconfig
# SPDX-License-Identifier: GPL-2.0

menuconfig CIX_DST
	bool "Cix DST support"
	default n
	help
	  Say yes here to support the cix DST

if CIX_DST

config PLAT_PRINTK_EXT
	default n
	bool "Enable support for log level control"
	help
	  This option enables log level control in no log load, Debug kernel log
	  will not be saved to memory if this option is enabled.

config PLAT_BOOT_TIME
	default n
	bool "platform boot time"
	help
	  only open on eng mode.

config PLAT_BOOT_POSTCODE
	bool "Platform OS boot postcode support"
	default n
	help
	  Platform OS boot postcode support

config PLAT_REBOOT_REASON
	bool "Platform hardware reboot reason"
	default n
	help
	  Platform hardware reboot reason support

config SKY1_REBOOT_REASON
	bool "Platform hardware reboot reason"
	default n
	depends on PLAT_REBOOT_REASON && ARM_SDE_INTERFACE
	help
	  Platform hardware reboot reason support

config PLAT_MNTNDUMP
	bool "CIX platform mntn dump driver"
	default n
	help
	  Say 'Y' here if you want to support mntn dump.

config PLAT_SDEI_EXCEPTIONS
	bool "Platform exceptions debug by SDEI support"
	depends on SKY1_WATCHDOG && PLAT_BBOX
	default n
	select ARM_SDE_INTERFACE
	help
	  Platform watchdog debug by SDEI support

config PLAT_SDEI_EXCEPTIONS_TEST
	bool "Platform test for SDEI exceptions"
	depends on PLAT_SDEI_EXCEPTIONS
	default n
	help
          Platform test for SDEI exceptions

config PLAT_FDLEAK
	depends on PLAT_LOGGER
	bool "Platform fd leak driver"
	default n
	help
	  This feature support to catch fd leak log

config PLAT_IDM_DETECT
	bool "Platform ni700 idm error detection"
	depends on PLAT_BBOX
	default n
	select ARM_SDE_INTERFACE
	help
	  This feature support to detect idm error

config PLAT_TEE_EXCEPTIONS
	bool "Platform tee error detection"
	depends on PLAT_BBOX
	default n
	select ARM_SDE_INTERFACE
	help
	  This feature support to detect tee error


config PLAT_TZC400_DETECT
	bool "Platform tzc400 error detection"
	depends on PLAT_BBOX
	default n
	select ARM_SDE_INTERFACE
	help
	  This feature support to detect idm error

config PLAT_SKY1_AUDIO_TIMEOUT
	bool "Sky1 platform audiot timeout error detection"
	depends on PLAT_BBOX
	default n
	help
	  This feature support to detect rcsu gasket error

config PLAT_SKY1_RCSU_GASKET_ERROR
	bool "Platform sky1 rcsu gasket error detection"
	depends on PLAT_BBOX
	default n
	help
	  This feature support to detect sky1 rcsu gasket error

config PLAT_SKY1_SE_PM_CRASH
	bool "Platform sky1 pm se crash monitor"
	depends on PLAT_BBOX
	default n
	help
	  This feature support to detect sky1 se pm error

config PLAT_TFA_TRACE
	bool "Platform tfa trace info"
	depends on PLAT_BBOX
	default n
	select ARM_SDE_INTERFACE
	help
	  This feature support trace tfa info

config PLAT_DDR_EXCEPTION_DETECT
	bool "Detect DDR abnormalities."
	default n
	help
	  This feature support detect ddr exceptions

if PLAT_MNTNDUMP
source "drivers/soc/cix/cix_dst/memory_dump/Kconfig"
endif #PLAT_MNTNDUMP

source "drivers/soc/cix/cix_dst/blackbox/Kconfig"

source "drivers/soc/cix/cix_dst/logger/Kconfig"

source "drivers/soc/cix/cix_dst/dsm/Kconfig"

source "drivers/soc/cix/cix_dst/hw_breakpoint/Kconfig"

source "drivers/soc/cix/cix_dst/pm_exception_monitor/Kconfig"

source "drivers/soc/cix/cix_dst/cache_exception_monitor/Kconfig"

endif #CIX_DST
```

## drivers/soc/cix/cix_dst/blackbox/Kconfig
```kconfig
# SPDX-License-Identifier: GPL-2.0

menu "RDR - Running data recorder menu"

config PLAT_BBOX
	bool "kernel run data recorder"
	depends on SYSFS
	select BCH
	default n
	help
	  This module can record some data about kernel internal info.
	  Include:
	  the task switch,
	  interrupts switch,
	  arm exception info,
	  etc ...

config PLAT_AP_HOOK
	bool "kernel ap hook config"
	depends on SYSFS && PLAT_BBOX
	select PLAT_REBOOT_REASON
	default n
	help
	  Enable AP hook.

config PLAT_BBOX_TEST
	bool "rdr exception test"
	depends on PLAT_BBOX && CONFIG_HISYSEVENT
	default n
	help
	  rdr exception test.

config PLAT_BBOX_BCH_M
	int "bch Galois field order, should be in the range 5-15"
	default 9
	range 5 15
	help
	  Galois field order, should be in the range 5-15

config PLAT_BBOX_BCH_T
	int "bch maximum error correction capability, in bits"
	default 4
	help
	  bch maximum error correction capability, in bits

endmenu
```

## drivers/soc/cix/cix_dst/cache_exception_monitor/Kconfig
```kconfig
# SPDX-License-Identifier: GPL-2.0
#
# Sky1 cache exception monitor driver
#

config PLAT_CACHE_EXCEPTION_MONITOR
	bool "platform cache exception monitor"
	default n
	help
	  If you say yes here you get support for Cache exception.

config PLAT_CACHE_EXCEPTION_MONITOR_TEST
	bool "platform cache exception monitor test"
	default n
	help
	  If you say yes here you get support for Cache exception.
```

## drivers/soc/cix/cix_dst/dsm/Kconfig
```kconfig
# SPDX-License-Identifier: GPL-2.0
#
# Platform device state monitor configuration
#

config PLAT_DSM
	bool "platform dsm"
	default n
	help
	  If you say yes here you get support for DSM.

config PLAT_DSM_TEST
	bool "platform dsm test"
	default n
	help
	  If you say yes here you get support for DSM test.
	  
```

## drivers/soc/cix/cix_dst/dsm/dsm_earlyboot_client/Kconfig
```kconfig
# SPDX-License-Identifier: GPL-2.0

config DSM_EARLYBOOT_CLIENT
    default n
    help
This module adds support for bus dmd.
```

## drivers/soc/cix/cix_dst/hw_breakpoint/Kconfig
```kconfig
# SPDX-License-Identifier: GPL-2.0

config PLAT_HW_BREAKPOINT
	bool "Platform hardware breakpoint support"
	default y
	depends on HAVE_HW_BREAKPOINT
	select KALLSYMS
	select KALLSYMS_ALL
	help
	  This feature support to enable hardware breakpoint
```

## drivers/soc/cix/cix_dst/logger/Kconfig
```kconfig
# SPDX-License-Identifier: GPL-2.0

config PLAT_LOGGER
	bool "platform log driver"
	default n
	help
	  This adds support for system-wide logging using two log buffers.
```

## drivers/soc/cix/cix_dst/memory_dump/Kconfig
```kconfig
config PLAT_KERNELDUMP
	bool "Support CIX KERNELDUMP"
	default n
	help
	  This driver supports Cix SkyX KERNELDUMP,
	  including kerneldump driver.

config KERNELDUMP_RESERVED_DESC
	hex "KERNELDUMP Reserve memory size"
	depends on PLAT_KERNELDUMP
	default 0x83e02000
	help
	  KERNELDUMP requires running an efi file within the UEFI environment,
	  allocating memory for its execution.
```

## drivers/soc/cix/cix_dst/pm_exception_monitor/Kconfig
```kconfig
# SPDX-License-Identifier: GPL-2.0-only

config PM_EXCEPTION_PROTOCOL
	bool "Enable support for PM exception protocol"
	depends on ARM_SCMI_PROTOCOL


config PM_EXCEPTION_DRIVER
	default n
	bool "Enable support for PM exception driver"
	select PM_EXCEPTION_PROTOCOL

config PM_EXCP_DSM_DRIVER
	default n
	bool "Enable support for PM dsm driver"

config CIX_EC_EXCEPTION_DRIVER
	default n
	bool "Enable support for EC exception driver"
```

## drivers/soc/cix/cix_dst/se_crash_monitor/Kconfig
```kconfig
# SPDX-License-Identifier: GPL-2.0-only

config PLAT_SKY1_SE_PM_CRASH
	bool "Platform sky1 pm se crash monitor"
	depends on PLAT_BBOX && CIX_AP2SE_IPC
	default y
	help
	  This feature support to detect sky1 se pm error
```

## drivers/soc/cix/sched/Kconfig
```kconfig
config MAX_NR_CPUS
	int "Maximum number of CPUs (2-32)"
	range 2 32
	depends on SMP
	default "8"

config CIX_SCHED
	tristate "cix scheduler feature"
	help
	  Choose this option to enable mtk schduler feature.
	  These features include
		cluster core control

config CIX_CORE_CTL
	tristate "CIX Core Control with CPU Isolation"
	default n
	help
	  This config is for the core control policy with CPU isolation.
	  The core control online and offline CPU cores based on task
	  utilizations from scheduler information automatically.
	  If you are not sure about whether to enable it or not,
	  please set n.

config CIX_CORE_PAUSE
	bool "core pause driver"
	depends on CIX_SCHED
	help
	  Choose this option to provide core pause related API.
	  core pause intends to have a way to force a CPU to go idle
	  and to resume as quickly as possible, with as little
	  disruption as possible on the system.

config CIX_VENDOR_HOOKS
	bool "Cix Vendor Hooks"
	depends on TRACEPOINTS
	help
	  Enable vendor hooks implemented as tracepoints

	  Allow vendor modules to attach to tracepoint "hooks" defined via
	  DECLARE_HOOK or DECLARE_RESTRICTED_HOOK.
```

## drivers/soc/friendlyelec/Kconfig
```kconfig
#
# Machine drivers
#

if ARCH_ROCKCHIP

config VENDOR_FRIENDLYELEC
	bool "FriendlyElec board based on RK33XX SoCs"
	default n

endif
```

## drivers/soc/ky/jpu/Kconfig
```kconfig
config CHIP_MEDIA_JPU
	tristate "chip media jpu driver"
	help
		This enables the chip media jpu driver

config JPU_ENABLE_DEBUG_MSG
	depends on CHIP_MEDIA_JPU
	bool "chip media jpu driver debug"
	default n
	help
		This enabled debug message output
```

## drivers/soc/rockchip/Kconfig
```kconfig
# SPDX-License-Identifier: GPL-2.0-only
if ARCH_ROCKCHIP || COMPILE_TEST

menu "Rockchip SoC drivers"

source "drivers/soc/rockchip/Kconfig.cpu"

#
# Rockchip Android Features
#

config NO_GKI
        bool "Disable Android GKI support"
        default y if !GKI_HACKS_TO_FIX
        help
          Say y here to disable Android GKI support. Then
          all the ABI compatibilities are not applicable.

          If unsure, say Y.


#
# Rockchip Soc drivers
#

config ROCKCHIP_CPUINFO
        tristate "Rockchip cpuinfo support"
        depends on (NVMEM_ROCKCHIP_EFUSE || NVMEM_ROCKCHIP_OTP) && (ARM64 || ARM)
        help
          Say y here to enable Rockchip cpuinfo support.
          Set system_serial_low/high from eFuse ID.
          Serial can read from /proc/cpuinfo.

          If unsure, say N.

config ROCKCHIP_GRF
	bool "Rockchip General Register Files support" if COMPILE_TEST
	default y if ARCH_ROCKCHIP
	help
	  The General Register Files are a central component providing
	  special additional settings registers for a lot of soc-components.
	  In a lot of cases there also need to be default settings initialized
	  to make some of them conform to expectations of the kernel.

config ROCKCHIP_IODOMAIN
	tristate "Rockchip IO domain support"
	depends on OF
	help
	  Say y here to enable support io domains on Rockchip SoCs. It is
	  necessary for the io domain setting of the SoC to match the
	  voltage supplied by the regulators.

config ROCKCHIP_PM_DOMAINS
	bool "Rockchip generic power domain"
	depends on PM
	select PM_GENERIC_DOMAINS
	help
	  Say y here to enable power domain support.
	  In order to meet high performance and low power requirements, a power
	  management unit is designed or saving power when RK3288 in low power
	  mode. The RK3288 PMU is dedicated for managing the power of the whole chip.

	  If unsure, say N.

config ROCKCHIP_DTPM
	tristate "Rockchip DTPM hierarchy"
	depends on DTPM && m
	help
	  Describe the hierarchy for the Dynamic Thermal Power Management tree
	  on this platform. That will create all the power capping capable
	  devices.

endmenu

endif
```

## drivers/soc/sunxi/Kconfig
```kconfig
# SPDX-License-Identifier: GPL-2.0-only
#
# Allwinner sunXi SoC drivers
#
config SUNXI_SRAM
	bool
	default ARCH_SUNXI
	select REGMAP_MMIO
	help
	  Say y here to enable the SRAM controller support. This
	  device is responsible on mapping the SRAM in the sunXi SoCs
	  whether to the CPU/DMA, or to the devices.

config GPU_PM_DOMAINS
	tristate "Allwinner gpu power domain"
	depends on PM
	depends on ARCH_SUN50IW10
	select PM_GENERIC_DOMAINS
	select PM_GENERIC_DOMAINS_OF
	help
	 Say y here to enable power domain support.
	 In order to meet high performance and low power requirements, a power
	 management unit is designed or saving power when gpu in low power
	 mode. The PPU is dedicated for managing the power of the GPU.

	 If unsure, say N.

config SUNXI_SID
	tristate "Allwinner sunxi sid support"
	default n
	help
	 Say y here to enable the sunxi sid support.

config SUNXI_DUMP
	bool "sunxi dump help to dump all dram area for crash tool"
```
