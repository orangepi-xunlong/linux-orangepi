## drivers/media/platform/sunxi-vin/vin-cci/Kconfig
```kconfig
choice
	depends on CSI_CCI
	prompt "select cci or cci to twi"
	default CCI

config CCI
	bool "use internal cci"

config CCI_TO_TWI
	bool "chenge cci to twi"

endchoice
```

## drivers/media/platform/sunxi_car_reverse/Kconfig
```kconfig
#
# Platform drivers
#	All drivers here are currently for webcam support

config VIDEO_SUNXI_CAR_REVERSE
	tristate "sunxi fast car reverse driver"
	depends on ARCH_SUN8IW11 || ARCH_SUN8IW17 || ARCH_SUN50IW9
	default n

config SUPPORT_BIRDVIEW
	tristate "Support car oview"
	depends on VIDEO_SUNXI_CAR_REVERSE
	default n
	help
	  Support for the car reverse.

config SUPPORT_AUXILIARY_LINE
	bool "support auxiliary line display"
	depends on VIDEO_SUNXI_CAR_REVERSE
	default n

config VIDEO_SUNXI_VIN_SPECIAL
	bool "support vin special"
	depends on VIDEO_SUNXI_CAR_REVERSE
	default n

config VIDEO_SUNXI_TVD_SPECIAL
	bool "support tvd special"
	depends on VIDEO_SUNXI_CAR_REVERSE
	default n
```

## drivers/media/tsc/Kconfig
```kconfig
config AW_TSC
	tristate "AW tsc module support"
	default n
	help
	This enables support for the RAONTECH tsc module
```

## drivers/media/video/sunxi-fd/Kconfig
```kconfig
config SUNXI_FD
tristate "FD driver" 
depends on ARCH_SUN9I
default m
help
	  This is the driver for allwinner platform facedetector module
```

## drivers/media/video/sunxi-tsc/Kconfig
```kconfig
config AW_TSC
    tristate "AW tsc module support"
    help
      This enables support for the RAONTECH tsc module=======
```

## drivers/media/video/sunxi-vfe/Kconfig
```kconfig
config CSI_VFE
	tristate "v4l2 driver for SUNXI"
	default m
	select VIDEOBUF_DMA_CONTIG
		
if ARCH_SUN8IW8

menu "Sensor CSI"
config OV2710_MIPI
	tristate "ov2710_mipi"
	default n
config OV4689
	tristate "ov4689"
	default n
config OV4689_60FPS
	tristate "ov4689 60fps"
	default n
config AR0330_MIPI
	tristate "ar0330 mipi"
	default n
config OV4689_SDV
	tristate "ov4689 sdv"
	default n
config GC1004_MIPI
	tristate "gc1004_mipi"
	default n	
config H22_MIPI
	tristate "h22_mipi"
	default n
endmenu

endif	
```

## drivers/misc/cix/sensor/cix_sensorhub/Kconfig
```kconfig
config CIX_KERNEL_SENSORHUB
	tristate "CUSTOM KERNEL SENSORHUB support"
	help
	  Kernel space sensor hub driver.
	  Define project used all sensor hub sensors.
	  The value is combination of sensor hub driver (get data ...etc)
	  and sensor hub framework driver (transmit shf info).
```

## drivers/misc/cix/sensor/core/Kconfig
```kconfig
config CIX_SENSORHUB
	tristate "sensorhub architecture for CIX package"
	help
	  It support CIX sensorhub architecture.
	  If this option is set,
	  it will support
	  cix sensorhub architecture.
```

## drivers/misc/cix/sensor/scp/Kconfig
```kconfig
config CIX_SF_SCP_SUPPORT
	bool "Specify Interface Support SCP"
	default n
	help
	  SCP is a CIX in-house star-core which can receive
	  command from IPI interface.
	  Set Y to enable this feature.
	  If unsure,
	  Set N to stay with legancy feature.
```

## drivers/misc/sunxi-addr/Kconfig
```kconfig
config SUNXI_ADDR_MGT
  tristate "Allwinner Network MAC Addess Manager"
  depends on SUNXI_RFKILL || BT || ETHERNET
  help
    allwinner network mac address management
```

## drivers/misc/sunxi-bootevent/Kconfig
```kconfig
#
# sunxi bootevent debugger driver.
#
config SUNXI_BOOTEVENT
  tristate "Enable sunxi bootevent debugger tool"
  default n
  help
    SUNXI_BOOTEVENT is used to debug bootting time,If you are not sure
	about whether to enable it or not, please set n.
```

## drivers/misc/sunxi-clk-prepare/Kconfig
```kconfig
config SUNXI_CLK_PREPARE
	tristate "allwinnertech clk related modules prepare driver"
	depends on COMMON_CLK && ARCH_SUNXI
	default n
	help
	  This is a driver for manager module clk's relation.
```

## drivers/misc/sunxi-rf/Kconfig
```kconfig
#
# Allwinner rfkill driver.
#
config SUNXI_RFKILL
  tristate "Allwinner rfkill driver"
  depends on WIRELESS || RFKILL
  help
    allwinner rfkill driver
```

## drivers/misc/sw_3g_module/Kconfig
```kconfig
#
# softwinner 3G module driver.
#

menuconfig SW_3G_MODULE
    tristate "softwinner 3G module driver"
    help
        softwinner 3G module driver

choice

    prompt "3G modem support"
    depends on SW_3G_MODULE
    help
        3G modem slecet.

config HUAWEI_MU509
    boolean "huawei mu509"
    help
        huawei mu509 modem support.

config YUGA_CWM600
    boolean "yuga cwm600"
    help
        yuga cwm600 modem support.

config OVIPHONE_EM55
    boolean "Oviphone em55"
    help
        Oviphone em55 modem support.
        
config OVIPHONE_EM56_EM66
    boolean "Oviphone em56/em66"
    help
        Oviphone em56/em66 modem support.

config SPREADWIN_G3
    boolean "Spreadwin G3"
    select SW_USB_3G_MODULE
    help
        Spreadwin g3 modem support.

config LONGCHEER_WM5608
    boolean "longcheer wm5608"
    help
        longcheer wm5608 modem support.

config USI_MT6276MA
    boolean "Usi MT6276MA"
    select SW_USB_3G_MODULE
    help
        Usi MT6276MA modem support.
endchoice

choice

    prompt "3G suspend/resume mode support"
    depends on SW_3G_MODULE
    help
        3G suspend/resume mode slecet.

config SW_3G_SLEEP_BY_GPIO_WAKEUP_BY_GPIO
    boolean "bp sleep by gpio, ap wakeup by gpio"
    help
        bp sleep by gpio, ap wakeup by gpio.

config SW_3G_SLEEP_BY_USB_WAKEUP_BY_USB
    boolean "bp sleep by usb, ap wakeup by usb"
    help
        bp sleep by usb, ap wakeup by usb.

config SW_3G_SLEEP_BY_USB_WAKEUP_BY_GPIO
    boolean "bp sleep by usb, ap wakeup by gpio"
    help
        bp sleep by usb, ap wakeup by gpio.

endchoice
```

## drivers/mpp/Kconfig
```kconfig
#
# SUNXI MPP drivers
#

config SUNXI_MPP
	bool "SUNXI MPP support"
	depends on ARCH_SUNXI && DEBUG_FS
	help
	  This adds the mpp driver for the Allwinner SUNXI SoC.

	  If in doubt, say N.
```

## drivers/mtd/nand/Kconfig
```kconfig
# SPDX-License-Identifier: GPL-2.0-only

menu "NAND"

config MTD_NAND_CORE
	tristate

source "drivers/mtd/nand/onenand/Kconfig"
source "drivers/mtd/nand/raw/Kconfig"
source "drivers/mtd/nand/spi/Kconfig"

menu "ECC engine support"

config MTD_NAND_ECC
       bool
       depends on MTD_NAND_CORE

config MTD_NAND_MTK_BMT
	bool "Support MediaTek NAND Bad-block Management Table"
	default n

endmenu

endmenu
```

## drivers/mtd/spi-nor/Kconfig
```kconfig
# SPDX-License-Identifier: GPL-2.0-only
menuconfig MTD_SPI_NOR
	tristate "SPI NOR device support"
	depends on MTD
	depends on MTD && SPI_MASTER
	select SPI_MEM
	help
	  This is the framework for the SPI NOR which can be used by the SPI
	  device drivers and the SPI NOR device driver.

if MTD_SPI_NOR

config MTD_SPI_NOR_USE_VARIABLE_ERASE
	bool "Disable uniform_erase to allow use of all hardware supported erasesizes"
	depends on !MTD_SPI_NOR_USE_4K_SECTORS
	default n
	help
	  Allow mixed use of all hardware supported erasesizes,
	  by forcing spi_nor to use the multiple eraseregions code path.
	  For example: A 68K erase will use one 64K erase, and one 4K erase
	  on supporting hardware.

config MTD_SPI_NOR_USE_4K_SECTORS
	bool "Use small 4096 B erase sectors"
	default y
	help
	  Many flash memories support erasing small (4096 B) sectors. Depending
	  on the usage this feature may provide performance gain in comparison
	  to erasing whole blocks (32/64 KiB).
	  Changing a small part of the flash's contents is usually faster with
	  small sectors. On the other hand erasing should be faster when using
	  64 KiB block instead of 16 × 4 KiB sectors.

	  Please note that some tools/drivers/filesystems may not work with
	  4096 B erase size (e.g. UBIFS requires 15 KiB as a minimum).

config MTD_SPI_NOR_USE_4K_SECTORS_LIMIT
	int "Maximum flash chip size to use 4K sectors on (in KiB)"
	depends on MTD_SPI_NOR_USE_4K_SECTORS
	default "4096"
	help
	  There are many flash chips that support 4K sectors, but are so large
	  that using them significantly slows down writing large amounts of
	  data or using a writable filesystem.
	  Any flash chip larger than the size specified in this option will
	  not use 4K sectors.

source "drivers/mtd/spi-nor/controllers/Kconfig"

endif # MTD_SPI_NOR
```

## drivers/net/can/cvitek/Kconfig
```kconfig
# SDVT-License-Identifier: GPL-2.0-only

config CAN_SDVT_CAN
	tristate "Generic Platform Bus based SDVT_CAN driver"
	help
	  This driver adds SDVT IP SDVT_CAN


config CAN_SDVT_PLATFORM
	tristate "Generic Platform Bus based SDVT_CAN driver"
	help
	  This driver adds SDVT IP SDVT_CAN


config CAN_SDVT_BASIC
	tristate "Generic Platform Bus based SDVT_CAN driver"
	help
	  This driver adds SDVT IP SDVT_CAN
```

## drivers/net/ethercat/Kconfig
```kconfig
# SPDX-License-Identifier: GPL-2.0-only
#
# Ethercat device configuration
#

menuconfig ETHERCAT
	bool "Ethercat native network driver support"
	depends on NET
	default y
	help
	  This section contains all the Ethercat drivers.

if ETHERCAT

source "drivers/net/ethercat/master/Kconfig"
source "drivers/net/ethercat/device/Kconfig"

endif # ETHERCAT
```

## drivers/net/ethercat/master/Kconfig
```kconfig
# SPDX-License-Identifier: GPL-2.0-only
#
# Ethercat device configuration
#

config EC_MASTER
	tristate "Ethercat master driver support"
	depends on ETHERCAT
	default n
	help
	  Ethercat master driver support.
```

## drivers/net/ethernet/allwinner/Kconfig
```kconfig
#
# Allwinner device configuration
#

config NET_VENDOR_ALLWINNER
	bool "Allwinner devices"
	default y

	depends on ARCH_SUNXI
	---help---
	  If you have a network (Ethernet) card belonging to this
	  class, say Y here.

	  Note that the answer to this question doesn't directly
	  affect the kernel: saying N will just cause the configurator
	  to skip all the questions about Allwinner cards. If you say Y,
	  you will be asked for your specific card in the following
	  questions.

if NET_VENDOR_ALLWINNER

config SUN4I_EMAC
        tristate "Allwinner A10 EMAC support"
	depends on ARCH_SUNXI
	depends on OF
	select CRC32
	select MII
	select PHYLIB
	select MDIO_SUN4I
        ---help---
          Support for Allwinner A10 EMAC ethernet driver.

          To compile this driver as a module, choose M here.  The module
          will be called sun4i-emac.

config SUNXI_GMAC
        tristate "Allwinner GMAC support"
	depends on ARCH_SUNXI
	depends on OF
	select CRC32
	select MII
	select PHYLIB
	select MDIO_SUNXI
        ---help---
          Support for Allwinner Gigabit ethernet driver.

          To compile this driver as a module, choose M here.  The module
          will be called sunxi-gmac.

config SUNXI_EXT_PHY
	bool "Use extern phy"
	depends on SUNXI_GMAC
	default y
	---help---
	  Allwinnertech SOC support both internal & extern PHY, Say "Y" to
	  choose use extern phy, Say "N" to use internal phy

endif # NET_VENDOR_ALLWINNER
```

## drivers/net/ethernet/sunxi/Kconfig
```kconfig
config NET_VENDOR_SUNXI
	bool "SUNXI Platform Network devices drivers"
	default y
	depends on HAS_IOMEM
	---help---
	The gmac device of sun6i platform soc.

if NET_VENDOR_SUNXI

source "drivers/net/ethernet/sunxi/eth/Kconfig"

endif # NET_VENDOR_SUNXI
```

## drivers/net/ethernet/sunxi/eth/Kconfig
```kconfig
config SUNXI_GETH
	tristate "Sunxi platform Gigabit Ethernet driver"
	depends on HAS_IOMEM && NET_VENDOR_SUNXI
	select NET_CORE
	select PHYLIB
	select CRC32
	---help---
	  This is the driver for the Sunxi Gigabit Ethernet.

if SUNXI_GETH

config GETH_SCRIPT_SYS
	bool "Use sunxi platform script"
	depends on SUNXI_GETH
	default y
	---help---
	 The gabit ethernet gpio request and control by the script
	 of sunxi platform. Select it, by script. If not, ioremap
	 by drivers itself.

config GETH_CLK_SYS
	bool "Clock use system interface"
	depends on SUNXI_GETH
	default y
	---help---
	 It select the clock controler is system or the driver itself.
	 If you want to use the system interface, select it. If not, the
	 driver will control the clock by ioremap.

config GETH_PHY_POWER
	bool "External PHY power control"
	depends on SUNXI_GETH && REGULATOR
	default y
	---help---
	 If external PHY power is exist, and it want to be controled,
	 select it.  If not, it mean the power of PHY already on.

endif
```

## drivers/net/ethernet/veth/Kconfig
```kconfig
config SOPHGO_VETH
	tristate "Sophgon Virtual Ethernet Driver over PCIe"
	default y
	help
		Sophgo virtual network interface card transmit packages though
		PCIe. This is the EP end driver. It needs support of RC end
		(host). If RC end donnot load device driver, any packages will
		lost.
```
