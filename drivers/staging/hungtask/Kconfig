## drivers/video/fbdev/sunxi/Kconfig
```kconfig
#
# Video configuration for sunxi platform
#

menu "Video support for sunxi"
	depends on FB

config FB_CONSOLE_SUNXI
	bool "Framebuffer Console Support(sunxi)"
	select FB_CFB_FILLRECT
	select FB_CFB_COPYAREA
	select FB_CFB_IMAGEBLIT
	default n
	---help---
	  Frame buffer driver for sunxi based boards.

config DISP2_SUNXI
	tristate "DISP Driver Support(sunxi-disp2)"
	depends on (ARCH_SUNXI)
	default n
	---help---
	  Display driver for sunxi based boards.

menuconfig HDMI_DISP2_SUNXI
	tristate "HDMI Driver Support(sunxi-disp2)"
	depends on (DISP2_SUNXI)
	default n
	---help---
	  Hdmi driver for sunxi based boards.

menuconfig HDMI2_HDCP_SUNXI
  bool "HDMI2.0 HDCP"
  depends on (HDMI2_DISP2_SUNXI)
  default n
  ---help---
  Say Y here if you want to handle the cec message by User Space.
  Say N here if you want to handle the cec message by Kernel.
  If unsure, say N.

config HDMI2_HDCP22_SUNXI
  bool "HDMI2.0 HDCP2.2"
  depends on (HDMI2_HDCP_SUNXI && HDMI2_DISP2_SUNXI)
  default n
  ---help---
  Say Y here if you want to handle the cec message by User Space.
  Say N here if you want to handle the cec message by Kernel.
  If unsure, say N.


menuconfig HDMI2_CEC_SUNXI
  bool "HDMI2.0 CEC"
  depends on (HDMI2_DISP2_SUNXI)
  default n
  ---help---
  Say Y here if you want to handle the cec message by User Space.
  Say N here if you want to handle the cec message by Kernel.
  If unsure, say N.

config HDMI2_CEC_USER
  bool "HDMI2.0 CEC handled by user space"
  depends on (HDMI2_CEC_SUNXI && HDMI2_DISP2_SUNXI)
  default n
  ---help---
  Say Y here if you want to handle the cec message by User Space.
  Say N here if you want to handle the cec message by Kernel.
  If unsure, say N.

config HDMI2_FREQ_SPREAD_SPECTRUM
  bool "new frequency spread spectrum(hershey) of sunxi"
  depends on HDMI2_DISP2_SUNXI
  default n
  ---help---
  Say Y here if you want to use new frequency spread spectrum(hershey) of sunxi.
  Say N here if you do NOT want to new frequency spread spectrum of sunxi.
  If unsure, say N

config HDMI2_DISP2_SUNXI
  tristate "HDMI2.0 Driver Support(sunxi-disp2)"
  depends on (DISP2_SUNXI)
  default n
  ---help---
  Say Y here if you want to have support for HDMI2.0 controller
  on the sunxi based boards. The HDMI2.0 controller include edid,
  hdcp1.4,hdcp2.2,cec feature and is compatible with hdmi1.4,support
  HDR,4k@60Hz. If unsure, say N.

config TV_DISP2_SUNXI
	 tristate "TV Driver Support(sunxi-disp2)"
	 depends on (DISP2_SUNXI)
	 default n
	 ---help---
	  TV driver for sunxi based boards.
config VDPO_DISP2_SUNXI
	 tristate "VDPO Driver Support(sunxi-disp2)"
	 depends on (DISP2_SUNXI)
	 default n
	 ---help---
	  VDPO driver for sunxi based boards.
config DISP2_TV_GM7121
	tristate "GM7121 TV module Support(sunxi-disp2)"
 	depends on (DISP2_SUNXI && TV_DISP2_SUNXI)
	default n
	---help---

config EDP_DISP2_SUNXI
	tristate "EDP Driver Support(sunxi-disp2)"
	depends on (DISP2_SUNXI)
	default n
	---help---
      EDP 1.2 driver for sunxi. Embedded Display Port is
      a high speed display interface for embedded device.
      DisplayPort can be used to transmit audio and video
      simultaneously, but each one is optional and can be
      transmitted without the other.

config DISP2_TV_AC200
	tristate "AC200 TV module Support(sunxi-disp2)"
	depends on (DISP2_SUNXI && MFD_ACX00)
	default n
	---help---

config EINK_PANEL_USED
	bool "Eink panel used"
	depends on (DISP2_SUNXI && (ARCH_SUN8IW10 || ARCH_SUN8IW15))
	default n
	---help---

config EINK200_SUNXI
	bool "Eink Driver Version 2.0 Support"
	depends on (DISP2_SUNXI && ARCH_SUN50IW10)
	default n
	---help---

config DISP2_SUNXI_BOOT_COLORBAR
	bool "boot colorbar Support for disp driver(sunxi-disp2)"
	depends on DISP2_SUNXI
	default n
	---help---
	  If true, the framebuffer will be filled by specified data
	  to display vertical colorbar.

config DISP2_SUNXI_DEBUG
	bool "debugfs support for disp driver(sunxi-disp2)"
	depends on DISP2_SUNXI
	default n
	---help---
	  This enable debugfs support for display driver. You can
	  get debug info or debug the driver via debugfs interface.

config DISP2_SUNXI_COMPOSER
	bool "composer support for disp driver(sunxi-disp2)"
	depends on DISP2_SUNXI
	default n
	---help---
	  This enable composer support for display driver. The composer
	  will serve hwc only.
config DISP2_LCD_ESD_DETECT
	bool "ESD detect support for LCD panel"
	depends on DISP2_SUNXI
	default n
	---help---
	  This enable lcd  esd detect and panel reset for display driver. User must
	  define panel_reset and esd_check function.
endmenu
```

## drivers/video/fbdev/sunxi/disp2/disp/Kconfig
```kconfig
config DISP2_SUNXI_SUPPORT_SMBL
	bool "Support smart backlight"
	default y
	---help---
		If you want to support smart backlight, select it.

config DISP2_SUNXI_SUPPORT_ENAHNCE
	bool "Support Video Enhance Process"
	default y
	---help---
		If you want to support video enhance process, select it.

config DISP2_SUNXI_DEVICE_OFF_ON_RELEASE
	bool "Clear all layers and turn off display device on /dev/disp release"
	default y
	help
		Select it to enable this feature.
```

## drivers/video/fbdev/sunxi/lcd_fb/panels/Kconfig
```kconfig
config LCD_SUPPORT_KLD35512
	bool "LCD support kld35512 panel"
        default n
        ---help---
                If you want to support kld35512 panel for display driver, select it.

config LCD_SUPPORT_KLD39501
	bool "LCD support kld39501 panel"
	default n
	---help---
		If you want to support kld39501 panel for display driver, select it.

config LCD_SUPPORT_KLD2844B
	bool "LCD support kld2844B panel"
	default y
	---help---
		If you want to support kld2844b panel for display driver, select it.
```

## drivers/video/sunxi/Kconfig
```kconfig
#
# Video configuration for sunxi platform
#

menu "Video support for sunxi"
	depends on FB

config FB_CONSOLE_SUNXI
  bool "Framebuffer Console Support(sunxi)"
  select FB_CFB_FILLRECT
  select FB_CFB_COPYAREA
  select FB_CFB_IMAGEBLIT
  default n
  ---help---

config DISP2_SUNXI
  tristate "DISP Driver Support(sunxi-disp2)"
  depends on (ARCH_SUNXI)
  default n
  ---help---

config HDMI_DISP2_SUNXI
	tristate "HDMI Driver Support(sunxi-disp2)"
	depends on (DISP2_SUNXI)
	default n
	---help---

config TV_DISP2_SUNXI
  tristate "TV Driver Support(sunxi-disp2)"
  depends on (DISP2_SUNXI)
  default n
  ---help---

config DISP2_TV_GM7121
  tristate "GM7121 TV module Support(sunxi-disp2)"
  depends on (DISP2_SUNXI && TV_DISP2_SUNXI)
  default n
  ---help---

config DISP2_TV_AC200
  tristate "AC200 TV module Support(sunxi-disp2)"
  depends on (DISP2_SUNXI && TV_DISP2_SUNXI && MFD_ACX00)
	default n
	---help---

config EINK_PANEL_USED
  bool "Eink panel used"
  depends on (DISP2_SUNXI && ARCH_SUN8IW10)
	default n
	---help---

config DISP2_SUNXI_BOOT_COLORBAR
  bool "boot colorbar for disp driver(sunxi-disp2)"
  depends on DISP2_SUNXI
  default n
  ---help---

config DISP2_SUNXI_DEBUG
  bool "debugfs for disp driver(sunxi-disp2)"
  depends on DISP2_SUNXI
  default n
  ---help---

endmenu
```

## fs/fatfs/Kconfig
```kconfig
config FATFS_FS
	tristate "FatFs for mmc support"
    default n
	help
	  FatFs is used for writing sd card with less memory cache.
	  When system contain very small memory, use this FatFs
	  can help to reduce system load.

	  If you want to compile it in module, select m.
```

## fs/msdcardfs/Kconfig
```kconfig
config MSDCARD_FS
	tristate "msdcard file system"
	default y
	help
	  Sdcardfs is based on Wrapfs file system.

config SDCARD_FS_FADV_NOACTIVE
	bool "msdcardfs fadvise noactive support"
	depends on FADV_NOACTIVE
	default y
	help
	  Sdcardfs supports fadvise noactive mode.

config SDCARD_FS_CI_SEARCH
	tristate "msdcardfs case-insensitive search support"
	depends on MSDCARD_FS
	default y

config SDCARD_FS_XATTR
	bool "mSdcardfs extended attribute"
	default y
	depends on MSDCARD_FS
	help
	  Modification of sdcard file system for xattr
```

## modules/gpu/Kconfig
```kconfig
menu "GPU support for sunxi"

config SUNXI_GPU_TYPE
	string "The GPU type"
	default "None"
	help
	  The GPU type used on the platform.

endmenu
```

## modules/mali/DX910-SW-99002-r3p2-01rel2/driver/src/devicedrv/mali/Kconfig
```kconfig
config MALI400
	tristate "Mali-300/400/450 support"
	depends on ARM
	select DMA_SHARED_BUFFER
	---help---
	  This enables support for the ARM Mali-300, Mali-400, and Mali-450
	  GPUs.

	  To compile this driver as a module, choose M here: the module will be
	  called mali.

config MALI400_DEBUG
	bool "Enable debug in Mali driver"
	depends on MALI400
	---help---
	  This enabled extra debug checks and messages in the Mali driver.

config MALI400_PROFILING
	bool "Enable Mali profiling"
	depends on MALI400
	select TRACEPOINTS
	default y
	---help---
	  This enables gator profiling of Mali GPU events.

config MALI400_INTERNAL_PROFILING
	bool "Enable internal Mali profiling API"
	depends on MALI400_PROFILING
	default n
	---help---
	  This enables the internal legacy Mali profiling API.

config MALI400_UMP
	bool "Enable UMP support"
	depends on MALI400
	---help---
	  This enables support for the UMP memory sharing API in the Mali driver.

config MALI_DMA_BUF_MAP_ON_ATTACH
	bool "Map dma-buf attachments on attach"
	depends on MALI400 && DMA_SHARED_BUFFER
	default y
	---help---
	  This makes the Mali driver map dma-buf attachments after doing
	  attach. If this is not set the dma-buf attachments will be mapped for
	  every time the GPU need to access the buffer.

	  Mapping for each access can cause lower performance.

config MALI_SHARED_INTERRUPTS
	bool "Support for shared interrupts"
	depends on MALI400
	default n
	---help---
	  Adds functionality required to properly support shared interrupts.  Without this support,
	  the device driver will fail during insmod if it detects shared interrupts.  Works even if
	  the GPU is not using shared interrupts, but can cause lower performance.
```

## modules/nand/Kconfig
```kconfig
config SUNXI_NAND
	tristate  "The sunxi nand driver"
	default n
	depends on (SUNXI_SID)
	help
	  The nand used on the platform.

	  If unsure, say m.
source "modules/nand/common1/Kconfig"
```

## modules/nand/common1/Kconfig
```kconfig
choice
	prompt "choice spinand or rawnand"
	depends on (SUNXI_NAND)

	config SUNXI_RAWNAND
		bool "sunxi raw nand driver"

	config	SUNXI_SPINAND
		bool "sunxi spi nand driver"

endchoice
```
