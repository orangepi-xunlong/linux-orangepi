## drivers/staging/hungtask/Kconfig
```kconfig
# SPDX-License-Identifier: GPL-2.0
config DFX_HUNGTASK
	bool "DFX hungtask"
	depends on DETECT_HUNG_TASK
	default n
	help
	  Base DFX hungtask module

config DFX_HUNGTASK_USER
	bool "DFX hungtask user watchdog module"
	depends on DFX_HUNGTASK
	default n
	help
	  DFX hungtask user watchdog module
```

## drivers/staging/iio/imu/Kconfig
```kconfig
#
# IIO imu drivers configuration
#
#menu "Inertial measurement units"

menuconfig INV_SENSOR
       bool "Invensense MPU devices"
       default y

if INV_SENSOR
#config ADIS16400
#	tristate "Analog Devices ADIS16400 and similar IMU SPI driver"
#	depends on SPI
#	select IIO_SW_RING if IIO_BUFFER
#	select IIO_TRIGGER if IIO_BUFFER
#	help
#	  Say yes here to build support for Analog Devices adis16300, adis16344,
#	  adis16350, adis16354, adis16355, adis16360, adis16362, adis16364,
#	  adis16365, adis16400 and adis16405 triaxial inertial sensors
#	  (adis16400 series also have magnetometers).
	  
#config INV_SENSORS_MPU6500
#	tristate "Invensense MPU 6500 devices"
#	depends on I2C && SYSFS && IIO && IIO_KFIFO_BUF && IIO_TRIGGER
#	default y
#	help
#	  This driver supports the Invensense MPU devices.
#	  This includes MPU6500.
#	  This driver can be built as a module. The module will be called
#	  inv-mpu-iio.

source "drivers/staging/iio/imu/inv_mpu/Kconfig"
endif
#endmenu
```

## drivers/staging/iio/imu/inv_mpu/Kconfig
```kconfig
#
# inv-mpu-iio driver for Invensense MPU devices and combos
#

config INV_MPU6500_IIO
	tristate "Invensense MPU6500 devices"
	depends on I2C && SYSFS && IIO && IIO_KFIFO_BUF && IIO_TRIGGER
	default m
	help
	  This driver supports the Invensense MPU devices.
	  This includes MPU6050/MPU3050/MPU9150/ITG3500/MPU6500/MPU9250.
	  This driver can be built as a module. The module will be called
	  inv-mpu-iio.
```

## drivers/staging/nanohub/Kconfig
```kconfig
config NANOHUB
	tristate "Nanohub"
	default N
	help
	  Enable support for the nanohub sensorhub driver.

	  This driver supports the android nanohub sensorhub.

	  If in doubt, say N here.

if NANOHUB

config NANOHUB_SPI
	bool "Nanohub SPI"
	default N
	help
	  Enable nanohub SPI support.

	  Either this or NANOHUB_I2C/NANOHUB_MEMSHARE should be selected.

	  If in doubt, say N here.

config NANOHUB_I2C
	bool "Nanohub I2C"
	default N
	help
	  Enable nanohub I2C support.

	  Either this or NANOHUB_SPI/NANOHUB_SHAREMEM should be selected.

	  If in doubt, say N here.

config NANOHUB_SHAREMEM
	bool "Nanohub SHAREMEM"
	default Y
	help
	  Enable nanohub SHAREMEM support.

	  Either this or NANOHUB_I2C/NANOHUB_SPI should be selected.

	  If in doubt, say Y here.
endif # NANOHUB
```

## drivers/staging/rtl8723cs/Kconfig
```kconfig
# SPDX-License-Identifier: GPL-2.0
config RTL8723CS
	tristate "Realtek RTL8723CS SDIO or SPI WiFi driver (2020)"
	depends on WLAN && MMC && CFG80211
	select WIRELESS_EXT
	select WEXT_PRIV
	help
	  Help message of RTL8723CS
```

## drivers/staging/sunxi/Kconfig
```kconfig
if ARCH_SUNXI

config SUNXIOOPS
	bool "Log panic/oops to a partition"
	default n
	help
	  This enables panic and oops messages to be logged to a partition where it can be read back at some later point.

endif
```

## drivers/sunxi_drm_heap/Kconfig
```kconfig
# SPDX-License-Identifier: GPL-2.0-only
# Generic Trusted Execution Environment Configuration
config SUNXI_DRM_HEAP
	tristate "sunxi drm heap"
	depends on TEE
	help
	  This implements a interface for sunxi drm management
```

## drivers/tee/optee/Kconfig
```kconfig
# OP-TEE Trusted Execution Environment Configuration
config OPTEE
	tristate "OP-TEE"
	depends on HAVE_ARM_SMCCC
	help
	  This implements the OP-TEE Trusted Execution Environment (TEE)
	  driver.

config OPTEE_BENCHMARK
	bool "OP-TEE Benchmark (EXPERIMENTAL)"
	depends on OPTEE
	help
	  This enables benchmarking feature in the OP-TEE Trusted
	  Execution Environment (TEE) driver.
```

## drivers/thermal/Kconfig
```kconfig
#
# Generic thermal sysfs drivers configuration
#

menuconfig THERMAL
	tristate "Generic Thermal sysfs driver"
	help
	  Generic Thermal Sysfs driver offers a generic mechanism for
	  thermal management. Usually it's made up of one or more thermal
	  zone and cooling device.
	  Each thermal zone contains its own temperature, trip points,
	  cooling devices.
	  All platforms with ACPI thermal support can use this driver.
	  If you want this support, you should say Y or M here.

if THERMAL

config THERMAL_HWMON
	bool
	depends on HWMON=y || HWMON=THERMAL
	default y

choice
	prompt "Default Thermal governor"
	default THERMAL_DEFAULT_GOV_STEP_WISE
	help
	  This option sets which thermal governor shall be loaded at
	  startup. If in doubt, select 'step_wise'.

config THERMAL_DEFAULT_GOV_STEP_WISE
	bool "step_wise"
	select STEP_WISE
	help
	  Use the step_wise governor as default. This throttles the
	  devices one step at a time.

config THERMAL_DEFAULT_GOV_FAIR_SHARE
	bool "fair_share"
	select FAIR_SHARE
	help
	  Use the fair_share governor as default. This throttles the
	  devices based on their 'contribution' to a zone. The
	  contribution should be provided through platform data.

config THERMAL_DEFAULT_GOV_USER_SPACE
	bool "user_space"
	select USER_SPACE
	help
	  Select this if you want to let the user space manage the
	  lpatform thermals.

endchoice

config FAIR_SHARE
	bool "Fair-share thermal governor"
	help
	  Enable this to manage platform thermals using fair-share governor.

config STEP_WISE
	bool "Step_wise thermal governor"
	help
	  Enable this to manage platform thermals using a simple linear

config USER_SPACE
	bool "User_space thermal governor"
	help
	  Enable this to let the user space manage the platform thermals.

config SUNXI_THERMAL_DYNAMIC
	tristate "sunxi thermal dynamic binding"
	depends on ARCH_SUNXI
	depends on SUNXI_THERMAL
	help
	  Adds sunxi thermal dynamic binding support.
      
config CPU_THERMAL
	tristate "generic cpu cooling support"
	depends on CPU_FREQ
	select CPU_FREQ_TABLE
	help
	  This implements the generic cpu cooling mechanism through frequency
	  reduction, cpu hotplug and any other ways of reducing temperature. An
	  ACPI version of this already exists(drivers/acpi/processor_thermal.c).
	  This will be useful for platforms using the generic thermal interface
	  and not the ACPI interface.
	  If you want this support, you should say Y here.

config CPU_BUDGET_THERMAL
	tristate "generic cpu budget cooling support"
	depends on CPU_FREQ && !CPU_THERMAL
	select CPU_FREQ_TABLE
	help
	  This implements the generic cpu budget with cpufreq and hotplug cooling mechanism through frequency
	  reduction, cpu hotplug and any other ways of reducing temperature. An
	  ACPI version of this already exists(drivers/acpi/processor_thermal.c).
	  This will be useful for platforms using the generic thermal interface
	  and not the ACPI interface.
	  If you want this support, you should say Y here.

config SPEAR_THERMAL
	bool "SPEAr thermal sensor driver"
	depends on PLAT_SPEAR
	depends on OF
	help
	  Enable this to plug the SPEAr thermal sensor driver into the Linux
	  thermal framework

config RCAR_THERMAL
	tristate "Renesas R-Car thermal driver"
	depends on ARCH_SHMOBILE
	help
	  Enable this to plug the R-Car thermal sensor driver into the Linux
	  thermal framework

config SUNXI_THERMAL
	tristate "Temperature sensor on ALLWINNERTECH"
	depends on ARCH_SUNXI
	help
	  If you say yes here you get support for (Thermal Management
	  Unit) on ALLWINEER series of SoC.

config SUNXI_BATTERY
	tristate "Battery vol sensor on ALLWINNERTECH"
	depends on ARCH_SUN9IW1P1
	help
	  If you say yes here you get support for (BATTERY VOL Thermal Management
	  Unit) on ALLWINEER series of SoC.

config SUNXI_CPUFREQ_COOLING
	tristate "sunxi cpufreq cooling"
	depends on ARCH_SUNXI
	depends on CPU_THERMAL
	help
	  Adds sunxi cpufreq cooling devices, and these cooling devices can be
	  bound to thermal zone trip points. When a trip point reached, the
	  bound cpufreq cooling device turns active to set CPU frequency low to
	  cool down the CPU.

config SUNXI_BUDGET_COOLING
	tristate "sunxi cpu budget cooling"
	depends on ARCH_SUNXI
	depends on CPU_BUDGET_THERMAL
	help
	  Adds sunxi cpu budget cooling devices, and these cooling devices can be
	  bound to thermal zone trip points. When a trip point reached, the
	  bound cpufreq cooling device turns active to set CPU frequency low to
	  cool down the CPU.

config SUNXI_BUDGET_COOLING_VFTBL
	tristate "sunxi cpu budget cooling parse VF table support"
	depends on CPU_BUDGET_THERMAL
	depends on SUNXI_BUDGET_COOLING
	default y
	help
	  Adds support to parse VF table when set cooling state params as VF table index
endif
```

## drivers/thermal/cix/Kconfig
```kconfig
# SPDX-License-Identifier: GPL-2.0-only
config CIX_THERMAL
	tristate "Cix thermal IPA driver"
	depends on ARCH_CIX && THERMAL_GOV_POWER_ALLOCATOR
	select CIX_SCMI_ENERGY_MODEL
	help
	  If you say yes here you get support IPA for CPU

config CIX_SCMI_ENERGY_MODEL
	tristate "SCMI based Cix Energy Model driver"
	depends on ENERGY_MODEL
	depends on CIX_THERMAL
	help
	  It uses SCMI Message Protocol driver to register
	  Energy Model (EM) for Cix platforms.
```

## drivers/thermal/sunxi_thermal/Kconfig
```kconfig
menu "allwinner(SUNXI) thermal cooling device drivers"
source "drivers/thermal/sunxi_thermal/sunxi_cooling_device/Kconfig"
endmenu

menu "allwinner(SUNXI) thermal sensor drivers"
source "drivers/thermal/sunxi_thermal/sunxi_thermal_sensor/Kconfig"
endmenu
```

## drivers/thermal/sunxi_thermal/sunxi_cooling_device/Kconfig
```kconfig
#
# SUNXI cooling device drivers configuration
#
config SUNXI_BUDGET_COOLING
	tristate "sunxi budget cooling"
	depends on ARCH_SUNXI
	depends on CPU_FREQ
	depends on !CPU_THERMAL
	help
	  Adds sunxi cpu budget cooling devices, and these cooling devices can be
	  bound to thermal zone trip points. When a trip point reached, the
	  bound cpufreq cooling device turns active to set CPU frequency low to
	  cool down the CPU.

config SUNXI_BUDGET_COOLING_CPU_DVFS
	tristate "sunxi budget cooling about CPU-DVFS"
	depends on THERMAL_OF
	depends on CPU_FREQ
	depends on SUNXI_BUDGET_COOLING
	help
	  Adds CPU cooling device about CPU dynamic-voltage-frequence-scaling.

config SUNXI_BUDGET_COOLING_HOTPLUG
	tristate "sunxi budget cooling about Hotplug"
	depends on THERMAL_OF
	depends on HOTPLUG_CPU
	depends on SUNXI_BUDGET_COOLING
	help
	  Adds CPU cooling device use hotplug limit.

config SUNXI_GPU_COOLING
	tristate "sunxi gpu cooling"
	depends on THERMAL_OF
	help
	  Adds sunxi gpu cooling devices, and these cooling devices can be
	  bound to thermal zone trip points. When a trip point reached, the
	  gpu cooling device turns active to set gpu frequency low to
	  cool down the CPU.
```

## drivers/thermal/sunxi_thermal/sunxi_thermal_sensor/Kconfig
```kconfig
config SUNXI_THERMAL_SENSOR
	tristate "Thermal sensor driver"
	depends on ARCH_SUNXI
	help
	  Thermal sensor on SUNXI platform.

config SUNXI_THS_DRIVER
	tristate "Thermal sensor driver for SUNXI platform"
	depends on SUNXI_THERMAL_SENSOR
	help
	  Temperature sensor on SUNXI platform. The thermal sensor driver used to
	  get temp. It call the thermal driver core interface.
```

## drivers/usb/sunxi_usb/Kconfig
```kconfig
#
# softwinner SUNXI USB2.0 Dual Role Controller Driver.
#

#---------------------------------------------
#-
#- config USB2.0 Dual Role Controller.
#-
#---------------------------------------------
menuconfig USB_SUNXI_USB
    tristate "SUNXI USB2.0 Dual Role Controller support"
    depends on ARCH_SUNXI
    help
        SUNXI USB2.0 Dual Role Controller

config USB_SUNXI_USB_MANAGER
    tristate "SUNXI USB2.0 Manager"
    depends on USB_SUNXI_USB
    help
        manager all usb controller.

#---------------------------------------------
#-
#- usb0 mode slecet.
#-
#---------------------------------------------
choice

    prompt "USB0 Controller support"
    depends on (USB_SUNXI_USB && USB_SUNXI_USB_MANAGER)
    help
        usb0 Controller mode slecet. choice "device only", then usb0 can only use for device.
        choice "host only", then usb0 can only use for host. choice "OTG", then usb0 can only
        use device and host.

config USB_SUNXI_USB0_NULL
    boolean "usb manager not support"
    help
        usb0 do not monitor hardware, then drvier insmod shoud by application.

config USB_SUNXI_USB0_DEVICE_ONLY
    boolean "device only support"
    help
        usb0 can only use for device.

config USB_SUNXI_USB0_HOST_ONLY
    boolean "host only support"
    help
        usb0 can only use for host.

config USB_SUNXI_USB0_OTG
    boolean "otg support"
    help
        usb0 can only use for device and host.


endchoice

config USB_SUNXI_USB_DEBUG
    tristate "SUNXI USB driver debug message"
    depends on USB_SUNXI_USB
    help
        SUNXI USB driver debug message.

config UDC_HIGH_BANDWITH_ISO
    tristate "SUNXI UDC HIGH BANDWITH ISO"
    depends on USB_SUNXI_USB && ARCH_SUN8IW6
    help
       udc support high bandwidth iso .

config USB_SUNXI_HOST
    tristate "SUNXI USB HOST driver"
    depends on USB_SUNXI_USB
    help
        SUNXI USB driver debug message.
```

## drivers/usb/sunxi_usb/usb3/Kconfig
```kconfig
config USB_SUNXI
	tristate "SUNXI USB3 DRD Core Support"
	depends on (USB && USB_GADGET)
	select USB_OTG_UTILS
	select USB_GADGET_DUALSPEED
	select USB_GADGET_SUPERSPEED
	select USB_XHCI_PLATFORM
	help
	  Say Y or M here if your system has a Dual Role SuperSpeed
	  USB controller based on the DesignWare USB3 IP Core.

	  If you choose to build this driver is a dynamically linked
	  module, the module will be called sunxi.ko.

if USB_SUNXI

config USB_XHCI_ENHANCE
    bool "Enhance for xhci controlle"
    depends on ARCH_SUN9IW1
	help
	  Say Y here to susport special usb3 udev on SUNXI Driver.

config USB_SUNXI_DEBUG
	bool "Enable Debugging Messages"
	help
	  Say Y here to enable debugging messages on SUNXI Driver.

config USB_SUNXI_VERBOSE
	bool "Enable Verbose Debugging Messages"
	depends on USB_SUNXI_DEBUG
	help
	  Say Y here to enable verbose debugging messages on SUNXI Driver.

endif
```
