## bsp/drivers/video/sunxi/disp2/disp/lcd/Kconfig
```kconfig
# SPDX-License-Identifier: GPL-2.0-or-later
config LCD_SUPPORT_GG1P4062UTSW
	bool "LCD support cpu_gg1p4062utsw panel"
	default n
	help
		If you want to support cpu_gg1p4062utsw panel for display driver, select it.

config LCD_SUPPORT_DX0960BE40A1
	bool "LCD support dx0960be40a1 panel"
	default n
	help
		If you want to support dx0960be40a1 panel for display driver, select it.

config LCD_SUPPORT_TFT720X1280
	bool "LCD support dx0960be40a1 panel"
	default n
	help
		If you want to support dx0960be40a1 panel for display driver, select it.

config LCD_SUPPORT_FD055HD003S
	bool "LCD support fd055hd003s panel"
	default n
	help
		If you want to support fd055hd003s panel for display driver, select it.

config LCD_SUPPORT_HE0801A068
	bool "LCD support he0801a068 panel"
	default y
	help
		If you want to support he0801a068 panel for display driver, select it.

config LCD_SUPPORT_ILI9341
	bool "LCD support ili9341 panel"
	default n
	help
		If you want to support ili9341 panel for display driver, select it.

config LCD_SUPPORT_LH219WQ1
	bool "LCD support LH219WQ1 panel"
	default n
	help
		If you want to support LH219WQ1 panel for display driver, select it.

config LCD_SUPPORT_LS029B3SX02
	bool "LCD support ls029b3sx02 panel"
	default n
	help
		If you want to support ls029b3sx02 panel for display driver, select it.

config LCD_SUPPORT_LT070ME05000
	bool "LCD support lt070me05000 panel"
	default n
	help
		If you want to support lt070me05000 panel for display driver, select it.


config LCD_SUPPORT_S6D7AA0X01
	bool "LCD support S6D7AA0X01 panel"
	default n
	help
		If you want to support S6D7AA0X01 panel for display driver, select it.


config LCD_SUPPORT_T27P06
	bool "LCD support t27p06 panel"
	default n
	help
		If you want to support t27p06 panel for display driver, select it.

config LCD_SUPPORT_TFT720x1280
	bool "LCD support tft720x1280 panel"
	default n
	help
		If you want to support tft720x1280 panel for display driver, select it.


config LCD_SUPPORT_WTQ05027D01
	bool "LCD support wtq05027d01 panel"
	default n
	help
		If you want to support wtq05027d01 panel for display driver, select it.

config LCD_SUPPORT_H245QBN02
	bool "LCD support H245QBN02 panel"
	default n
	help
		If you want to support H245QBN02 panel for display driver, select it.

config LCD_SUPPORT_ST7789V
	bool "LCD support ST7789V panel"
	default n
	help
		If you want to support ST7789V panel for display driver, select it.

config LCD_SUPPORT_ST7796S
	bool "LCD support ST7796S panel"
	default n
	help
		If you want to support ST7796S panel for display driver, select it.

config LCD_SUPPORT_ST7701S
	bool "LCD support ST7701S panel"
	default n
	help
		If you want to support ST7701S panel for display driver, select it.

config LCD_SUPPORT_EQT371BYZ009G
	bool "LCD support eqt371byz009g panel"
	default n
	help
		If you want to support eqt371byz009g panel for display driver, select it.

config LCD_SUPPORT_T30P106
	bool "LCD support T30P106 panel"
	default n
	help
		If you want to support T30P106 panel for display driver, select it.

config LCD_SUPPORT_TO20T20000
	bool "LCD support TO20T20000 panel"
	default n
	help
		If you want to support TO20T20000 panel for display driver, select it.

config LCD_SUPPORT_FRD450H40014
	bool "LCD support FRD450H40014 panel"
	default n
	help
		If you want to support FRD450H40014 panel for display driver, select it.

config LCD_SUPPORT_S2003T46G
	bool "LCD support S2003T46G panel"
	default n
	help
		If you want to support S2003T46G panel for display driver, select it.

config LCD_SUPPORT_WILLIAMLCD
	bool "LCD support WilliamLcd panel"
	default y
	help
		If you want to support WilliamLcd panel for display driver, select it.

config LCD_SUPPORT_LQ101R1SX03
	bool "LCD support lq101r1sx03 panel"
	default y
	help
		If you want to support lq101r1sx03 panel for display driver, select it.

config LCD_SUPPORT_LQ079L1SX01
	bool "LCD support lq079l1sx01 panel"
	default n
	help
		If you want to support lq079l1sx01 panel for display driver, select it.

config LCD_SUPPORT_INET_DSI_PANEL
	bool "LCD support inet_dsi_panel panel"
	default y
	help
		If you want to support inet_dsi_panel panel for display driver, select it.

config LCD_SUPPORT_WTL096601G03
	bool "LCD support WTL096601G03 panel"
	default n
	help
		If you want to support WTL096601G03 panel for display driver, select it.

config LCD_SUPPORT_RT13QV005D
	bool "LCD support rt13qv005d panel"
	default n
	help
		If you want to support rt13qv005d panel for display driver, select it.

config LCD_SUPPORT_ST7789V_CPU
	bool "LCD support st7789v_cpu panel"
	default n
	help
		If you want to support st7789v_cpu panel for display driver, select it.

config LCD_SUPPORT_CC08021801_310_800X1280
	bool "LCD support CC08021801_310_800X1280 panel"
	default y
	help
		If you want to support CC08021801_310_800X1280 panel for display driver, select it.

config LCD_SUPPORT_JD9366AB_3
	bool "LCD support JD9366AB_3 panel"
	default n
	help
		If you want to support JD9366AB_3 panel for display driver, select it.

config LCD_SUPPORT_TFT08006
	bool "LCD support TFT08006 panel"
	default n
	help
		If you want to support tft08006 panel for display driver, select it.

config LCD_SUPPORT_BP101WX1_206
	bool "LCD support bp101wx1-206 panel"
	default y
	help
		If you want to support bp101wx1-206 panel for display driver, select it.

config LCD_SUPPORT_FX070
	bool "LCD support fx070 panel"
	default y
	help
		If you want to support fx070 panel for display driver, select it.

config LCD_SUPPORT_K101IM2QA04
	bool "LCD support K101IM2QA04 panel"
	default y
	help
		If you want to support K101IM2QA04 panel for display driver, select it.

config LCD_SUPPORT_K101_IM2BYL02_L_800X1280
	bool "LCD support K101_IM2BYL02_L_800X1280 panel"
	default y
	help
		If you want to support K101_IM2BYL02_L_800X1280 panel for display driver, select it.

config LCD_SUPPORT_K080_IM2HYL802R_800X1280
	bool "LCD support K080_IM2HYL802R_800X1280 panel"
	default y
	help
		If you want to support K080_IM2HYL802R_800X1280 panel for display driver, select it.

config LCD_SUPPORT_FX070_DHM18BOEL2_1024X600
	bool "LCD support FX070_DHM18BOEL2_1024X600 panel"
	default y
	help
		If you want to support FX070_DHM18BOEL2_1024X600 panel for display driver, select it.

config LCD_SUPPORT_FT8021_TV097WXM_LH0
	bool "LCD FT8021_TV097WXM_LH0 panel"
	default n
	help
		if you want to support FT8021_TV097WXM_LH0 panel for display driver, select it.

config LCD_SUPPORT_JD9365DA_SAT080BO31I21Y03_26114M018IB
	bool "LCD support JD9365DA_SAT080BO31I21Y03_26114M018I panel"
	default n
	help
		if you want to support JD9365DA_SAT080BO31I21Y03_26114M018I panel for display driver, select it.
config LCD_SUPPORT_JD9365DA_SAT080AT31I21Y03_26114M019IB
	bool "LCD support JD9365DA_SAT080AT31I21Y03_26114M019IB panel"
	default n
	help
		if you want to support JD9365DA_SAT080AT31I21Y03_26114M019IB panel for display driver, select it.
config LCD_SUPPORT_JD9365DA_SQ101A_B4EI313_39R501
	bool "LCD support JD9365DA_SQ101A_B4EI313_39R501 panel"
	default n
	help
		if you want to support JD9365DA_SQ101A_B4EI313_39R501 panel for display driver, select it.
config LCD_SUPPORT_KD080D24
	bool "LCD support kd080d24 panel"
	default y
	help
		if you want to support kd080d24 panel for display driver, select it.
config LCD_SUPPORT_CC10132007_40A
	bool "LCD support CC10132007_40A panel"
	default y
	help
		if you want to support CC10132007_40A panel for display driver, select it.
		CC10132007_40A
config LCD_SUPPORT_CC10127007_31AB
	bool "LCD support LCD_SUPPORT_CC10127007_31AB panel"
	default y
	help
		If you want to support LCD_SUPPORT_CC10127007_31AB panel for display driver, select it.
config LCD_SUPPORT_ILI9881T_INCELL_800X1280
	bool "LCD support LCD_SUPPORT_ILI9881T_INCELL_800X1280 panel"
	default n
	help
		If you want to support LCD_SUPPORT_ILI9881T_INCELL_800X1280 panel for display driver, select it.

config LCD_SUPPORT_NT36523_INCELL_1200X1920
	bool "LCD support LCD_SUPPORT_NT36523_INCELL_1200X1920 panel"
	default y
	help
		if you want to support LCD_SUPPORT_NT36523_INCELL_1200X1920 panel for display driver, select it.

config LCD_SUPPORT_GM7321C
	bool "LCD support LCD_SUPPORT_GM7321C panel"
	default y
	help
		if you want to support LCD_SUPPORT_GM7321C panel for display driver, select it.
```

## bsp/drivers/video/sunxi/disp2/edp2/lowlevel/Kconfig
```kconfig
# SPDX-License-Identifier: GPL-2.0-or-later
config AW_EDP_PHY_USED
    def_bool n
    depends on (EDP2_AW_DISP2)
    default n
    help
        Selected when aw edp phy used.

config DISP_PHY_INNO_EDP_1_3
    tristate "support innosilicon eDP 1.3 phy"
    depends on (EDP2_AW_DISP2)
    select AW_EDP_PHY_USED
    default n
    help
        Innosilicon eDP 1.3 phy for Allwinner eDP module.
```

## bsp/drivers/video/sunxi/disp2/edp2/panels/Kconfig
```kconfig
# SPDX-License-Identifier: GPL-2.0-or-later
config EDP_SUPPORT_VVX10T025J00_2560X1600
    tristate "eDP panel support VVX10T025J00_2560X1600"
    depends on (EDP2_AW_DISP2)
    default n
    help
        If you want to support VVX10T025J00_2560X1600 panel for edp2 driver, select it.

config EDP_SUPPORT_LM116X001A40_1920X1080
    tristate "eDP panel support LM116X001A40_1920X1080"
    depends on (EDP2_AW_DISP2)
    default n
    help
        If you want to support LM116X001A40_1920X1080 panel for edp2 driver, select it.

config EDP_SUPPORT_GENERAL_PANEL
    tristate "eDP panel support general_panel"
    depends on (EDP2_AW_DISP2)
    default n
    help
        If you want to support general panel for edp2 driver, select it.
```

## bsp/drivers/video/sunxi/lcd_fb/panels/Kconfig
```kconfig
# SPDX-License-Identifier: GPL-2.0
config LCD_SUPPORT_KLD35512
	bool "LCD support kld35512 panel"
        default n
        help
                If you want to support kld35512 panel for display driver, select it.

config LCD_SUPPORT_KLD39501
	bool "LCD support kld39501 panel"
	default n
	help
		If you want to support kld39501 panel for display driver, select it.

config LCD_SUPPORT_KLD2844B
	bool "LCD support kld2844B panel"
	default y
	help
		If you want to support kld2844b panel for display driver, select it.

config LCD_SUPPORT_NV3029S
	bool "LCD support nv3029s panel"
	default n
	help
		If you want to support nv3029s panel for display driver, select it.
```

## bsp/drivers/vin/Kconfig
```kconfig
# SPDX-License-Identifier: GPL-2.0-only
menu "VIN (camera) Drivers"
	depends on AW_BSP

config AW_VIDEO_SUNXI_VIN
       tristate "sunxi video input (camera csi/mipi isp vipp) driver"
	   select MEDIA_SUPPORT
       default n

config AW_SENSOR_POWER
       tristate "sensor power in front of vin"
       depends on AW_VIDEO_SUNXI_VIN
       default n
config CSI_VIN
	tristate "v4l2 new driver for SUNXI"
	depends on AW_VIDEO_SUNXI_VIN
	default m
	select VIDEOBUF2_DMA_CONTIG

config ENABLE_SENSOR_FLIP_OPTION
	bool "select sensor flip to replace vipp flip"
	depends on AW_VIDEO_SUNXI_VIN
	default n
	help
	   you cant flip in vipp when you select LBC format,
	   so you can enable it to active sensor flip operation.

config VIDEO_SUNXI_VIN_SPECIAL
	bool "special function for vin"
	depends on AW_VIDEO_SUNXI_VIN
	default n
	help
	   if say Y, some special function will be support for
           some scence, such as fast car reverse and so on.

config CSI_CCI
	tristate "use cci function"
	depends on AW_VIDEO_SUNXI_VIN
	default n
	help
		CCI is a hardware module in CSI. you can make it to
		be cci or i2c in the system.

if CSI_CCI
source "bsp/drivers/vin/vin-cci/Kconfig"
endif

config FLASH
	tristate "use flash module"
	depends on AW_VIDEO_SUNXI_VIN
	default m

config ACTUATOR
	tristate "use actuator module"
	depends on AW_VIDEO_SUNXI_VIN
	default n

if ACTUATOR
source "bsp/drivers/vin/modules/actuator/Kconfig"
endif

config SENSOR_LIST
	tristate "sensor list for adaptive"
	depends on AW_VIDEO_SUNXI_VIN
	default m

config BUF_AUTO_UPDATE
	bool "buf addr update for hardware"
	depends on AW_VIDEO_SUNXI_VIN
	default n

config VIN_LOG
	bool "use vin log for debug"
	depends on AW_VIDEO_SUNXI_VIN
        depends on DYNAMIC_DEBUG
	default y

config PIPELINE_RESET
	bool "use pipeline reset when timeout"
	depends on AW_VIDEO_SUNXI_VIN
	default n

config MULTI_FRAME
	bool "multi-frame interrupt mode"
	depends on AW_VIDEO_SUNXI_VIN
	default n

config SUPPORT_ISP_TDM
	bool "use isp for time sharing multiplex"
	depends on AW_VIDEO_SUNXI_VIN
	default n

config TDM_LBC_EN
	bool "tdm reduces buf size by compression"
	depends on SUPPORT_ISP_TDM
	default n

config TDM_ONE_BUFFER
	bool "tdm use one buffer mode"
	depends on SUPPORT_ISP_TDM
	default n
	help
		need ensure sensor vbland > 20%

choice
	depends on AW_VIDEO_SUNXI_VIN
	prompt "select rgb mode"
	default VIPP_YUV2RGB

config SENSOR_RGB
	bool "sensor output rgb"

config VIPP_YUV2RGB
	bool "vipp yuv to rgb"

endchoice

config MULTI_FRM_MERGE_INT
	bool "multi-frame image merge interrupt"
	depends on AW_VIDEO_SUNXI_VIN
	default n

config DISPPLAY_SYNC
	bool "use one buffer for delay display"
	depends on AW_VIDEO_SUNXI_VIN
	default n

config VIN_IOMMU
	bool "use IOMMU for memery alloc"
	depends on AW_VIDEO_SUNXI_VIN
	default y

config D3D
	bool "ISP 3D denoise module"
	depends on AW_VIDEO_SUNXI_VIN
	default n

config D3D_LTF_EN
	bool "ISP 3D denoise long time frame"
	depends on D3D
	depends on AW_VIDEO_SUNXI_VIN
	default n

config D3D_COMPRESS_EN
	bool "ISP 3D denoise reduces buf size by compression"
	depends on AW_VIDEO_SUNXI_VIN
	depends on D3D
	default	n

choice
	depends on D3D
	prompt "select d3d mode"
	default D3D_PKG_MODE

config D3D_PKG_MODE
	bool "use d3d pkg mode"

config D3D_LBC_MODE
	bool "use d3d lbc mode"
endchoice

config WDR
	bool "ISP WDR module"
	depends on AW_VIDEO_SUNXI_VIN
	default n

config WDR_COMPRESS_EN
	bool "ISP WDR reduces buf size by compression"
	depends on AW_VIDEO_SUNXI_VIN
	depends on WDR
	default	n

config SAME_I2C
	bool "sensor same i2c addr"
	depends on AW_VIDEO_SUNXI_VIN
	default y

config VIN_SDRAM_DFS
	bool "use vin sdram dfs"
	depends on AW_VIDEO_SUNXI_VIN
	default n

config CSI_SDRAM_DFS_TEST
	bool "sensor first debug for sdram dfs"
	depends on VIN_SDRAM_DFS
	default n

config ISP_SERVER_MELIS
	bool "use ISP server from melis"
	depends on AW_VIDEO_SUNXI_VIN
	default n

config VIN_INIT_MELIS
	bool "vin and isp init in melis"
	depends on AW_VIDEO_SUNXI_VIN
	default n

config RV_RUN_CAR_REVERSE
	bool "special function for vin used on rv"
	depends on VIN_INIT_MELIS && VIDEO_SUNXI_VIN_SPECIAL
	default n

source "bsp/drivers/vin/modules/sensor/Kconfig"

endmenu
```

## bsp/drivers/vin/modules/actuator/Kconfig
```kconfig
# SPDX-License-Identifier: GPL-2.0-only
menu "actuator driver select"
    depends on AW_VIDEO_SUNXI_VIN

config ACTUATOR_AD5820
	tristate "use ad5820 driver"
	default n

config ACTUATOR_DW9714
	tristate "use dw9714 driver"
	default n

config ACTUATOR_FP5510
	tristate "use fp5510 driver"
	default n

config ACTUATOR_OV8825
	tristate "use ov8825 driver"
	default n

config ACTUATOR_AN41908A
	tristate "use an41908a driver"
    depends on SPI
	default n

config ACTUATOR_AD5823
	tristate "use ad5823 driver"
	default n

config ACTUATOR_CN3927
	tristate "use cn3927 driver"
	default n

endmenu
```
