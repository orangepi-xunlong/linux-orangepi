## bsp/drivers/vin/modules/sensor/Kconfig
```kconfig
# SPDX-License-Identifier: GPL-2.0-only
menu "sensor driver select"
	depends on AW_VIDEO_SUNXI_VIN

config SENSOR_RN6854M
	tristate "use rn6854m driver"
	default n

config SENSOR_NVP6158C
	tristate "use nvp6158c driver"
	default n

config SENSOR_GC02M1B
	tristate "use gc02m1b driver"
	default n

config SENSOR_GC02M1
	tristate "use gc02m1 driver"
	default n

config SENSOR_GC030A
	tristate "use gc030a driver"
	default n

config SENSOR_GC05A2
	tristate "use gc05a2 driver"
	default n

config SENSOR_GC2385
	tristate "use gc2385 driver"
	default n

config SENSOR_GC5025
	tristate "use gc5025 driver"
	default n

config SENSOR_GC6133
	tristate "use gc6133 driver"
	default n

config SENSOR_BF30A2
	tristate "use bf30a2 driver"
	default n

config SENSOR_IMX278
	tristate "use imx278 driver"
	default n

config SENSOR_IMX278_2LANE
	tristate "use imx278_2lane driver"
	default n

config SENSOR_IMX386
	tristate "use imx386 driver"
	default n

config SENSOR_IMX386_2LANE
	tristate "use imx386_2lane driver"
	default n

config SENSOR_OV5640
	tristate "use ov5640 driver"
	default n

config SENSOR_OV5648_MIPI
    tristate "use ov5648_mipi driver"
    default n

config SENSOR_OV2775
	tristate "use ov2775 driver"
	default n

config SENSOR_OV5675
	tristate "use ov5675 driver"
	default n

config SENSOR_OV02A10
	tristate "use ov02a10 driver"
	default n

config SENSOR_GC2145
	tristate "use gc2145 driver"
	default n

config SENSOR_GC0310
	tristate "use gc0310 driver"
	default n

config SENSOR_GC2355
	tristate "use gc2355 driver"
	default n

config SENSOR_GC5024
	tristate "use gc5024 driver"
	default n

config SENSOR_GC5035
	tristate "use gc5035 driver"
	default n

config SENSOR_GC2590
	tristate "use gc2590 driver"
	default n

config SENSOR_SP5409
	tristate "use sp5409 driver"
	default n

config SENSOR_IMX214
	tristate "use imx214 driver"
	default n

config SENSOR_IMX219
	tristate "use imx219 driver"
	default n

config SENSOR_IMX274_SLVDS
	tristate "use imx274_slvds driver"
	default n

config SENSOR_IMX291_DVP
	tristate "use imx291_dvp driver"
	default n

config SENSOR_IMX291
	tristate "use imx291 driver"
	default n

config SENSOR_IMX317
	tristate "use imx317 driver"
	default n

config SENSOR_IMX335
	tristate "use imx335 driver"
	default n

config SENSOR_IMX326
	tristate "use imx326 driver"
	default n

config SENSOR_IMX477
	tristate "use imx477 driver"
	default n

config SENSOR_OV2710
	tristate "use ov2710 driver"
	default n

config SENSOR_OV2718
	tristate "use ov2718 driver"
	default n

config SENSOR_AR0238
	tristate "use ar0238 driver"
	default n

config SENSOR_OV7251
	tristate "use ov7251 driver"
	default n

config SENSOR_OV8856
	tristate "use ov8856 driver"
	default n

config SENSOR_OV8858_R2A_4LANE
	tristate "use ov8858_r2a_4lane driver"
	default n

config SENSOR_OV2680
	tristate "use ov2680 driver"
	default n

config SENSOR_S5K3H5XA
	tristate "use s5k3h5xa driver"
	default n

config SENSOR_AR0238_HISPI
	tristate "use ar0238_hispi driver"
	default n

config SENSOR_NVP6134
	tristate "use nvp6134 driver"
	default n

config SENSOR_NVP6324
	tristate "use nvp6324 driver"
	default n

config SENSOR_TP9950
	tristate "use tp9950 driver"
	default n

config SENSOR_SC2232
	tristate "use sc2232 driver"
	default n

config SENSOR_SC035HGS
	tristate "use sc035hgs driver"
	default n

config SENSOR_GC02M2
	tristate "use gc02m2 driver"
	default n

config SENSOR_C2390A
	tristate "use c2390a driver"
	default n

config SENSOR_C2398
	tristate "use c2398 driver"
	default n

config SENSOR_C2399
	tristate "use c2399 driver"
	default n

config SENSOR_IMX319
	tristate "use imx319 driver"
	default n

config SENSOR_S5K5E8
	tristate "use s5k5e8 driver"
	default n

config SENSOR_TP9930
	tristate "use tp9930 driver"
	default n

config SENSOR_TP2815
	tristate "use tp2815 driver"
	default n

config SENSOR_LT7911D
	tristate "use lt7911d driver"

config SENSOR_OV13850
	tristate "use ov13850 driver"
	default n

config SENSOR_LT6911C
	tristate "use lt6911c driver"
	default n

config SENSOR_TC358743XBG
	tristate "use tc358743xbg driver"
	default n

config SENSOR_RM84_SERDES
	tristate "use rm84 serdes driver"
	default n

config SENSOR_THINE244_SERDES
	tristate "use thine244 serdes driver"
	default n

config SENSOR_MAX96724_SERDES
	tristate "use max96724 serdes driver"
	default n

config SENSOR_TD104
	tristate "use td104 sensor driver"
	default n

config SENSOR_RK628F
	tristate "use rk628f driver"
	default n

config SENSOR_PTN
	tristate "use ptn driver"
	default n

endmenu
```

## bsp/drivers/vin/vin-cci/Kconfig
```kconfig
# SPDX-License-Identifier: GPL-2.0-or-later
# Makefile for the video capture/playback device drivers.
# Copyright 2010 Steven King <sfking@fdwdc.com>
#Copyright(c) 2022-2027 Allwinnertech Co., Ltd
# Each configuration option enables a list of files.
choice
	depends on CSI_CCI
	prompt "select cci or cci to twi"
	default CCI

config CCI
	bool "use internal cci"

config CCI_TO_TWI
	bool "chenge cci to twi"

endchoice
```

## bsp/drivers/watchdog/Kconfig
```kconfig
# SPDX-License-Identifier: GPL-2.0-only

menu "Watchdog Drivers"
	depends on AW_BSP

config AW_WATCHDOG
	tristate "Watchdog Support for Allwinner SoCs"
	select WATCHDOG
	select WATCHDOG_CORE
	help
	  Say Y here to support the watchdog timer in Allwinner SoCs.

endmenu
```

## bsp/drivers/wiegand/Kconfig
```kconfig
# SPDX-License-Identifier: GPL-2.0-only
#
# WIEGAND drivers configuration
#
menu "Wiegand Drivers"
	depends on AW_BSP

config SUNXI_WIEGAND
	tristate "allwinnertech Wiegand driver"
	select INPUT_EVDEV
	default n
	help
	  Choose Y to enable wiegand driver

endmenu
```

## bsp/modules/gpu/Kconfig
```kconfig
menu "GPU Drivers"
	depends on AW_BSP

config AW_GPU_TYPE
	string "The GPU Type"
	default "None"
	help
	  The GPU type used on the platform.

endmenu
```

## bsp/modules/nand/Kconfig
```kconfig
menu "NAND Drivers"
	depends on AW_BSP

config AW_NAND
	tristate  "The sunxi nand driver"
	default n
	depends on (AW_SID)
	help
	  The nand used on the platform. it's nftl nand driver.

	  If unsure, say m.
source "bsp/modules/nand/common1/Kconfig"

endmenu
```

## bsp/modules/nand/common1/Kconfig
```kconfig
config AW_RAWNAND
	default y
	depends on (AW_NAND)
	tristate "sunxi raw nand driver"


config AW_RAWNAND_CD
	tristate "sunxi rawnand exteral module detect unclean poweroff"
	depends on AW_RAWNAND
	help
	exteral module detect unclean poweroff(e.g. powerdown),then it send a
	signal to gpio,gpio generate signal to stop ndfc work.
	this should be support by hardware circuit.

	if you enable it, and you should configure property cd-debounce-delay-ms and
	pwroff-gpios in dts

	  WARNING: the gpio can't be used by other
```

## bsp/platform/Kconfig
```kconfig
# SPDX-License-Identifier: GPL-2.0-only

source "bsp/platform/Kconfig.common"

menu "Platform Information"

config AW_BSP
	bool "Allwinner Platform"
	select ARCH_SUNXI
	select ARCH_HAS_RESET_CONTROLLER
	select GENERIC_IRQ_CHIP
	select PINCTRL
	select RESET_CONTROLLER
	help
	  This enables support for Allwinner sunxi based SoCs like the A64.

choice
	prompt "Kernel Type"
	depends on AW_BSP
	default AW_KERNEL_AOSP
	help
	  Select the type/source of kernel you are using.

config AW_KERNEL_AOSP
	bool "AOSP"
	depends on AW_BSP
	help
	  AOSP linux kernel from Google

config AW_KERNEL_ORIGIN
	bool "Origin"
	depends on AW_BSP
	help
	  Origin linux kernel from mainline/LTS.
endchoice  # Kernel Type

choice
	prompt "SoC Family"
	default ARCH_SUN8I  if ARM
	default ARCH_SUN50I if ARM64
	default ARCH_SUN20I if RISCV
	depends on AW_BSP
	help
	  Select the Family for SoC

config ARCH_SUN8I
	bool "SUN8I"
	depends on AW_BSP && ARM
	help
	  Allwinner SUN8I SoC Family

config ARCH_SUN50I
	bool "SUN50I"
	depends on AW_BSP
	#select xxx if ARM
	#select xxx64 if ARM64
	help
	  Allwinner SUN50I SoC Family

config ARCH_SUN55I
	bool "SUN55I"
	depends on AW_BSP
	help
	  Allwinner SUN55I SoC Family

config ARCH_SUN60I
	bool "SUN60I"
	depends on AW_BSP && ARM64
	help
	  Allwinner SUN60I SoC Family

config ARCH_SUN65I
	bool "SUN65I"
	depends on AW_BSP && ARM64
	help
	  Allwinner SUN65I SoC Family

config ARCH_SUN20I
	bool "SUN20I"
	depends on AW_BSP && RISCV
	help
	  Allwinner SUN20I SoC Family

endchoice  # SoC Family

choice
	prompt "SoC Wafer"
	default ARCH_SUN50IW10
	depends on AW_BSP
	help
	  Select the wafer

config ARCH_SUN60IW1
	bool "SUN60IW1"
	depends on ARCH_SUN60I
	help
	  Support for Allwinner SUN60IW1 SoC

config ARCH_SUN60IW2
	bool "SUN60IW2"
	depends on ARCH_SUN60I
	help
	  Support for Allwinner SUN60IW2 SoC

config ARCH_SUN65IW1
	bool "SUN65IW1"
	depends on ARCH_SUN65I
	help
	  Support for Allwinner SUN60IW3 SoC

config ARCH_SUN55IW3
	bool "SUN55IW3"
	depends on ARCH_SUN55I
	help
	  Support for Allwinner SUN55IW3 SoC

config ARCH_SUN55IW5
	bool "SUN55IW5"
	depends on ARCH_SUN55I
	help
	  Support for Allwinner SUN55IW5 SoC

config ARCH_SUN55IW6
	bool "SUN55IW6"
	depends on ARCH_SUN55I
	help
	  Support for Allwinner SUN55IW6 SoC

config ARCH_SUN50IW9
	bool "SUN50IW9"
	depends on ARCH_SUN50I
	help
	  Support for Allwinner SUN50IW9 SoC

config ARCH_SUN50IW10
	bool "SUN50IW10"
	depends on ARCH_SUN50I
	help
	  Support for Allwinner SUN50IW10 SoC

config ARCH_SUN50IW12
	bool "SUN50IW12"
	depends on ARCH_SUN50I
	help
	  Support for Allwinner SUN50IW12 SoC

config ARCH_SUN8IW11
	bool "SUN8IW11"
	depends on ARCH_SUN8I
	help
	  Support for Allwinner SUN8IW11 SoC

config ARCH_SUN8IW18
	bool "SUN8IW18"
	depends on ARCH_SUN8I
	help
	  Support for Allwinner SUN8IW18 SoC

config ARCH_SUN8IW20
	bool "SUN8IW20"
	depends on ARCH_SUN8I
	help
	  Support for Allwinner SUN8IW20 SoC

config ARCH_SUN8IW21
	bool "SUN8IW21"
	depends on ARCH_SUN8I
	help
	  Support for Allwinner SUN8IW21 SoC

config ARCH_SUN20IW5
	bool "SUN20IW5"
	depends on ARCH_SUN20I
	help
	  Support for Allwinner SUN20IW5 SoC
endchoice  # SoC Wafer

choice
	prompt "SoC Package"
	depends on AW_BSP
	help
	  Select the SoC

config ARCH_SUN60IW1P1
	depends on ARCH_SUN60IW1
	bool "Allwinner SUN60IW1P1"

config ARCH_SUN60IW2P1
	depends on ARCH_SUN60IW2
	bool "Allwinner SUN60IW2P1"

config ARCH_SUN65IW1P1
	depends on ARCH_SUN65IW1
	bool "Allwinner SUN65IW1P1"

config ARCH_SUN50IW10P1
	depends on ARCH_SUN50IW10
	bool "Allwinner SUN50IW10P1"
endchoice  # SoC Package

choice
	prompt "Board Type"
	depends on AW_BSP
	default AW_FPGA_S4

config AW_FPGA_S4
	bool "FPGA S4 Board"
	help
	  Support for Allwinner FPGA S4 board

config AW_FPGA_V7
	bool "FPGA V7 Board"
	help
	  Support for Allwinner FPGA V7 board

config AW_IC_BOARD
	bool "IC Board"
	depends on AW_BSP
	help
	  Support for Allwinner IC board
endchoice  # Board Type

config AW_SOC_NAME
	string "SoC Name"
	default ""
	depends on AW_BSP
	help
	  Used by sysfs: /sys/.../sysinfo

endmenu  # Platform Information
```

## bsp/platform/Kconfig.debug
```kconfig
# SPDX-License-Identifier: GPL-2.0-only
menu "Allwinner's Debugging Options"
	depends on AW_BSP

config AW_DEBUG_LOCK
	bool "One-key LOCK DEBUG"
	select DETECT_HUNG_TASK
	select DEBUG_RT_MUTEXES
	select DEBUG_MUTEXES
	select DEBUG_WW_MUTEX_SLOWPATH
	select DEBUG_SPINLOCK
	select DEBUG_LOCK_ALLOC
	select PROVE_LOCKING
	select LOCKDEP
	select LOCK_STAT
	select DEBUG_LOCKDEP
	select DEBUG_ATOMIC_SLEEP
	select DEBUG_PREEMPT
	select AW_DEBUG_SPINLOCK
	help
	  Support one-key lock debug.
	  Say Y here, you can enable the lock debug functions at one time.

config AW_DEBUG_SPINLOCK
	bool "Spinlock Debug Tools by Allwinner"
	help
	  Support spin_lock debug.
	  Say Y here, you can enable the lock debug functions.

config AW_DEBUG_MEM
	bool "One-key MEMORY DEBUG"
	select DEBUG_PAGEALLOC
	select DEBUG_PAGEALLOC_ENABLE_DEFAULT
	select PAGE_OWNER
	select PAGE_POISONING
	select DEBUG_WX
	select SLUB_DEBUG_ON
	select SLUB_STATS
	select DEBUG_KMEMLEAK
	select SCHED_STACK_END_CHECK
	select DEBUG_VM
	help
	  Support one-key memory debug.
	  Say Y here, you can enable the memory debug functions at one time.

config AW_DEBUG_FTRACE
	bool "One-key FTRACE"
	select BOOTTIME_TRACING
	select FUNCTION_TRACER
	select FUNCTION_PROFILER
	select FTRACE_SYSCALLS
	help
	  Support one-key ftrace.
	  Say Y here, you can enable the ftrace functions at one time.

config AW_REG_VERIFY
	bool "Enable Write-And-Verify When Accessing Registers"
	default n
	help
	  Enable Write-And-Verify operation when accessing registers.
	  This is useful when debugging on unstable prototype platforms such as FPGA.

config AW_LOG_VERBOSE
	bool "Verbose AW log"
	help
	  Enable verbose logging mode for the Allwinner log system.
endmenu
```
