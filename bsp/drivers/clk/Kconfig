## bsp/drivers/g2d/Kconfig
```kconfig
# SPDX-License-Identifier: GPL-2.0

menu "G2D Drivers"
	depends on AW_BSP

config AW_G2D
	tristate "G2D Support for Allwinner SoCs"
	default n
	help
	  Enable sunxi platform 2D Graphics engine

choice
	prompt "G2D driver version"
	depends on AW_G2D

config G2D_LEGACY
	depends on AW_G2D
	bool "legacy version"

config G2D_RCQ
	depends on AW_G2D
	bool "RCQ version"

config G2D200
	depends on AW_G2D
	bool "sunxi g2d200 version"

endchoice

config G2D_MIXER
	depends on G2D_RCQ || G2D200
	bool "sunxi g2d mixer module"
	default y
	help
	  Choose Y to enable mixer module of g2d

config G2D_ROTATE
	depends on G2D_RCQ || G2D200
	bool "sunxi g2d rotate module"
	default y
	help
	  Choose Y to enable rotate module of g2d

config G2D_SYNCFENCE
	depends on AW_G2D
	select SYNC_FILE
	bool "sunxi sync fence implement for rotate jobs synchronous"
	default n
	help
	  Choose Y to enable sync fence implement for sunxi G2D

config G2D_USE_HWSPINLOCK
	depends on AW_G2D && AW_RPROC_FAST_BOOT
	bool "sunxi g2d use hwspinlock"
	default n
	help
	  Choose Y to use hwspinlock by sunxi G2D

config G2D_BUF_CACHED
	depends on G2D_RCQ || G2D200
	bool "Caching dma-buf mapping with LRU cache algorithm"
	default n
	help
	  Choose Y to enable LRU cache for dma-buf mapping

endmenu
```

## bsp/drivers/gmac/Kconfig
```kconfig
# SPDX-License-Identifier: GPL-2.0-only
menu "Gmac Drivers"
	depends on AW_BSP

config AW_GMAC
	tristate "Allwinner GMAC support"
	depends on OF
	select AW_GMAC_MDIO
	select CRC32
	help
	  Support for Allwinner Gigabit ethernet driver.

	  To compile this driver as a module, choose M here.  The module
	  will be called sunxi-gmac.ko.

config AW_GMAC_MDIO
	tristate "Allwinner GMAC MDIO support"
	select MDIO_BUS
	select MDIO_DEVICE
	select NETDEVICES
	select PHYLIB
	select MII
	help
	  This driver supports the GMAC MDIO interface in the network

config AW_GMAC_METADATA
	bool "Allwinner GMAC metadata support"
	depends on AW_GMAC
	help
	  Support Allwinner GMAC to transmit and receive metadata

config AW_EPHY
	tristate "Drivers for Allwinnertech EPHY"
	depends on AW_GMAC
	help
	  Support Allwinner EPHY

endmenu
```

## bsp/drivers/gpadc/Kconfig
```kconfig
# SPDX-License-Identifier: GPL-2.0-only
#
# GPADC drivers configuration
#

menu "General Purpose ADC Drivers"
	depends on AW_BSP

config AW_GPADC
        tristate "GPADC Support for Allwinner SoCs"
	select INPUT
	select INPUT_EVDEV
        default n
        help
          If you say Y here, you'll get support for the GPADC
	  (General Purpose ADC) on Allwinner SoCs.

config AW_GPADC_DYNAMIC_DEBUG
        bool "Enable gpadc dynamic debug"
        depends on AW_GPADC
        default y
        help
          Enable gpadc dynamic debug
endmenu
```

## bsp/drivers/gpu/Kconfig
```kconfig
# SPDX-License-Identifier: GPL-2.0

menu "Open Source GPU Drivers"
	depends on DRM
config AW_DRM_PANFROST
	tristate "Panfrost (AW DRM support for ARM Mali Midgard/Bifrost GPUs)"
	depends on DRM
	depends on ARM || ARM64 || COMPILE_TEST
	depends on !GENERIC_ATOMIC64    # for IOMMU_IO_PGTABLE_LPAE
	depends on MMU
	select DRM_SCHED
	select IOMMU_SUPPORT
	select IOMMU_IO_PGTABLE_LPAE
	select DRM_GEM_SHMEM_HELPER
	select PM_DEVFREQ
	select DEVFREQ_GOV_SIMPLE_ONDEMAND
	help
	  DRM driver for ARM Mali Midgard (T6xx, T7xx, T8xx),
	  Bifrost (G3x, G5x, G7x) and ARM Mali Valhall (G57) GPUs.

config AW_DRM_LIMA
	tristate "LIMA (AW DRM support for ARM Mali 400/450 GPU)"
	depends on DRM
	depends on ARM || ARM64 || COMPILE_TEST
	depends on MMU
	depends on COMMON_CLK
	depends on OF
	select DRM_SCHED
	select DRM_GEM_SHMEM_HELPER
	select PM_DEVFREQ
	select DEVFREQ_GOV_SIMPLE_ONDEMAND
	help
	 DRM driver for ARM Mali 400/450 GPUs.

endmenu
```
