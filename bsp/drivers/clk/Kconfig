## bsp/drivers/clk/Kconfig
```kconfig
# SPDX-License-Identifier: GPL-2.0-only

menu "Clock Drivers"
	depends on AW_BSP

source "bsp/drivers/clk/sunxi/Kconfig"
source "bsp/drivers/clk/sunxi-ng/Kconfig"

config AW_CCU_DEBUG
	tristate "DebugFS representation of clock tree"
	default AW_CCU || AW_CCU_LEGACY
	depends on DEBUG_FS

config AW_CCMU_DYNAMIC_DEBUG
	bool "Enable ccmu dynamic debug"
	default AW_CCU
	default y
	help
	  Enable ccmu dynamic debug

endmenu
```

## bsp/drivers/clk/sunxi-ng/Kconfig
```kconfig
# SPDX-License-Identifier: GPL-2.0-only
config AW_CCU
	tristate "Clock Support for Allwinner SoCs"
	depends on AW_BSP
	default y
	select RESET_CONTROLLER
	select AW_RTC_CCU

config AW_STANDARD_CCU
	tristate "Standard clock Support for Allwinner SoCs"
	depends on AW_CCU
	default n

config AW_DDR_CCU
	tristate "DDR_CCU"
	default AW_CCU
	depends on AW_CCU

config AW_SUN8IW11_CCU
	tristate "SUN8IW11 CCU"
	default ARCH_SUN8IW11
	depends on AW_CCU

config AW_SUN8IW18_CCU
	tristate "SUN8IW18 CCU"
	default ARCH_SUN8IW18
	depends on AW_CCU

config AW_SUN8IW20_CCU
	tristate "SUN8IW20 CCU"
	default ARCH_SUN8IW20
	depends on AW_CCU

config AW_SUN8IW20_R_CCU
	tristate "SUN8IW20 PRCM CCU"
	default ARCH_SUN8IW20
	depends on AW_CCU

config AW_SUN8IW20_TEST
	tristate "SUN8IW20 TEST CCU"
	default n
	depends on AW_CCU

config AW_SUN50IW12_CCU
	tristate "SUN50IW12 CCU"
	default ARCH_SUN50IW12
	depends on AW_CCU

config AW_SUN50IW12_R_CCU
	tristate "SUN50IW12 PRCM CCU"
	default ARCH_SUN50IW12
	depends on AW_CCU

config AW_SUN50IW10_CCU
	tristate "SUN50IW10 CCU"
	default ARCH_SUN50IW10
	depends on AW_CCU

config AW_SUN50IW10_R_CCU
	tristate "SUN50IW10 PRCM CCU"
	default ARCH_SUN50IW10
	depends on AW_CCU

config AW_SUN50IW10_DISPLL
	tristate "Support for the Allwinner SUN50IW10 DISPLL"
	default ARCH_SUN50IW10
	depends on AW_CCU

config AW_SUN50IW9_CCU
	tristate "SUN50IW9 CCU"
	default ARCH_SUN50IW9
	depends on AW_CCU

config AW_SUN50IW9_R_CCU
	tristate "SUN50IW9 PRCM CCU"
	default ARCH_SUN50IW9
	depends on AW_CCU

config AW_SUN55IW3_CCU
	tristate "SUN55IW3 CCU"
	default ARCH_SUN55IW3
	depends on AW_CCU

config AW_SUN55IW3_R_CCU
	tristate "SUN55IW3 PRCM CCU"
	default ARCH_SUN55IW3
	depends on AW_CCU

config AW_SUN55IW3_MCU_CCU
	tristate "SUN55IW3_MCU_CCU"
	default ARCH_SUN55IW3
	depends on AW_CCU

config AW_SUN55IW3_TEST
	tristate "SUN55IW3 TEST CCU"
	default n
	depends on AW_CCU

config AW_SUN60IW1_CCU
	tristate "SUN60IW1 CCU"
	default ARCH_SUN60IW1
	depends on AW_CCU

config AW_SUN60IW1_DSP_CCU
	tristate "SUN60IW1_DSP_CCU"
	default ARCH_SUN60IW1
	depends on AW_CCU

config AW_SUN60IW1_R_CCU
	tristate "SUN60IW1 PRCM CCU"
	default ARCH_SUN60IW1
	depends on AW_CCU

config AW_SUN60IW2_CCU
	tristate "SUN60IW2 CCU"
	default ARCH_SUN60IW2
	depends on AW_CCU
	select AW_STANDARD_CCU

config AW_SUN60IW2_R_CCU
	tristate "SUN60IW2 PRCM CCU"
	default ARCH_SUN60IW2
	depends on AW_CCU

config AW_SUN55IW5_CCU
	tristate "SUN55IW5 CCU"
	default ARCH_SUN55IW5
	depends on AW_CCU

config AW_SUN55IW5_R_CCU
	tristate "SUN55IW5 PRCM CCU"
	default ARCH_SUN55IW5
	depends on AW_CCU

config AW_SUN55IW6_CCU
	tristate "SUN55IW6 CCU"
	default ARCH_SUN55IW6
	depends on AW_CCU

config AW_SUN55IW6_R_CCU
	tristate "SUN55IW6 PRCM CCU"
	default ARCH_SUN55IW6
	depends on AW_CCU

config AW_SUN8IW21_CCU
	tristate "SUN8IW21 CCU"
	default ARCH_SUN8IW21
	depends on AW_CCU

config AW_SUN8IW21_R_CCU
	tristate "SUN8IW21 PRCM CCU"
	default ARCH_SUN8IW21
	depends on AW_CCU

config AW_SUN20IW5_AON_CCU
	tristate "SUN55IW5 AON CCU"
	default ARCH_SUN20IW5
	depends on AW_CCU
	help
	  This enables support for clock about system on Allwinner SoCs

config AW_SUN20IW5_APP_CCU
	tristate "SUN55IW6 APP CCU"
	default ARCH_SUN20IW5
	depends on AW_CCU
	help
	  This enables support clock about module on Allwinner SoCs

config AW_SUN65IW1_CCU
	tristate "SUN65IW1 CCU"
	default ARCH_SUN65IW1
	depends on AW_CCU
	help
	  This enables support clock about module on Allwinner SoCs

config AW_SUN65IW1_R_CCU
	tristate "SUN65IW1 PRCM CCU"
	default ARCH_SUN65IW1
	depends on AW_CCU

config AW_RTC_CCU
	tristate "RTC domain clocks"
	default y
	help
	  sunxi clock provider in RTC domain, which provides clocks such as
	  dcxo24M-out, iosc, osc32k, osc32k-out and rtc-1k. This module is
	  mandatory for sunxi SoCs. Say 'Y' here.
```

## bsp/drivers/clk/sunxi/Kconfig
```kconfig
# SPDX-License-Identifier: GPL-2.0-only
config AW_CCU_LEGACY
	tristate "Legacy Clock Support for Allwinner SoCs"
	depends on AW_BSP
	default n
	select RESET_CONTROLLER

config AW_SUN8IW21_CCU_LEGACY
	tristate "SUN8IW21 LEGACY CCU"
	default ARCH_SUN8IW21
	depends on AW_CCU_LEGACY
```

## bsp/drivers/cpufreq/Kconfig
```kconfig
# SPDX-License-Identifier: GPL-2.0-only

source "bsp/drivers/cpufreq/cpufreq-linux-$(VERSION).$(PATCHLEVEL)/Kconfig"
```

## bsp/drivers/cpufreq/cpufreq-linux-5.10/Kconfig.arm
```kconfig
menu "sunxi cpufreq Drivers"
	depends on AW_BSP

config ARM_AW_SUN50I_CPUFREQ_NVMEM
	tristate "Allwinner nvmem based SUN50I CPUFreq driver"
	depends on AW_BSP
	depends on NVMEM_AW_SID
	select PM_OPP
	help
	  This adds the nvmem based CPUFreq driver for Allwinner
	  h6 SoC.

	  To compile this driver as a module, choose M here: the
	  module will be called sun50i-cpufreq-nvmem.

endmenu
```

## bsp/drivers/cpufreq/cpufreq-linux-6.1/Kconfig
```kconfig
# SPDX-License-Identifier: GPL-2.0-only
menu "CPU Frequency Drivers"

config AW_CPUFREQ_DT
	tristate "Generic DT based cpufreq driver"
	depends on HAVE_CLK && OF
	select AW_CPUFREQ_DT_PLATDEV
	select PM_OPP
	help
	  This adds a generic DT based cpufreq driver for frequency management.
	  It supports both uniprocessor (UP) and symmetric multiprocessor (SMP)
	  systems.

	  If in doubt, say N.

config AW_CPUFREQ_DT_PLATDEV
	tristate
	help
	  This adds a generic DT based cpufreq platdev driver for frequency
	  management.  This creates a 'cpufreq-dt' platform device, on the
	  supported platforms.

	  If in doubt, say N.

config AW_CPUFREQ_TEST
	tristate "Generic test for cpufreq driver"
	help
	  This adds a generic DT based cpufreq driver for frequency management.
	  It supports both uniprocessor (UP) and symmetric multiprocessor (SMP)
	  systems.

	  If in doubt, say N.

if ARM || ARM64
source "bsp/drivers/cpufreq/cpufreq-linux-5.15/Kconfig.arm"
endif

endmenu
```

## bsp/drivers/crashdump/Kconfig
```kconfig
# SPDX-License-Identifier: GPL-2.0-only

menu "CRASHDUMP Drivers"

menuconfig AW_CRASHDUMP
	tristate "Allwinner Crash Dump Support"
	depends on ARCH_SUN8I || ARCH_SUN50I || ARCH_SUN55I || ARCH_SUN60I || ARCH_SUN65I
	depends on AW_BSP
	default n
	help
	  Say Y here to enable the sunxi crash dump support.
	  sunxi dump help to dump all dram area for crash tool.

if AW_CRASHDUMP
config PANIC_DEBUG
	tristate "Allwinner Panic Debug Support"
	depends on AW_CRASHDUMP
	default n
	help
	  Say Y here to enable the sunxi panic debug support.
	  If unsure, say N.

config AW_CRASHDUMP_KEY
	bool "Allwinner Crash Dump Key Support"
	depends on AW_CRASHDUMP && AW_LRADC && AW_INPUT_AXP2101_PEK
	default y
	help
	  Say Y here to enable the sunxi panic debug support.
	  If unsure, say N.

endif

endmenu
```

## bsp/drivers/debug/Kconfig
```kconfig
# SPDX-License-Identifier: GPL-2.0-only
#
# LEDC drivers configuration
#

menu "AW Debugging Extensions"
	depends on AW_BSP

config AW_SYSCALL_PRINTK
        bool "Support Syscall printk()"
	depends on ARM64
	default n
	help
	  This enables support for a new syscall `sys_printk`, which allows user space to call printk() directly.
	  This could be used for userspace debugging when console is not available.
	  Only ARM64 is supported so far.

endmenu
```

## bsp/drivers/devfreq/Kconfig
```kconfig
# SPDX-License-Identifier: GPL-2.0-only
#
# Devfreq device configuration
#

menu "Devfreq Device Drivers"
	depends on AW_BSP

config AW_DMC_DEVFREQ
	tristate "SUNXI DEVFREQ Driver"
	select DEVFREQ_GOV_SIMPLE_ONDEMAND
	select DEVFREQ_GOV_USERSPACE
	select DEVFREQ_GOV_PERFORMANCE
	select PM_DEVFREQ_EVENT
	select PM_OPP

	help
          This adds the DEVFREQ driver for the A100 DMC(Dynamic Memory Controller).
          It sets the frequency for the memory controller and reads the usage counts
          from hardware.

	  If in doubt, say N.

source "bsp/drivers/devfreq/event/Kconfig"

endmenu
```

## bsp/drivers/devfreq/event/Kconfig
```kconfig
# SPDX-License-Identifier: GPL-2.0-only
#
# Devfreq device configuration
#

menu "Devfreq Device Event Drivers"
	depends on AW_BSP

config AW_EVENT_DFI
	tristate "ALLWINNER DFI DEVFREQ event Driver"
	default ARCH_SUN50IW10
	help
	  This add the devfreq-event driver for Allwinner SoC. It provides DFI
	  (DDR Monitor Module) driver to count ddr load.

config AW_EVENT_DDR
	tristate "ALLWINNER DDR DEVFREQ event Driver"
	default ARCH_SUN55IW3
	help
	  This add the devfreq-event driver for Allwinner SoC. It provides DDR
	  (DDR Monitor Module) driver to count ddr load.

endmenu
```

## bsp/drivers/di/Kconfig
```kconfig
# SPDX-License-Identifier: GPL-2.0
menu "DI_Drivers"
	depends on AW_BSP

config AW_DI
	tristate "DI Support for Allwinner SoCs"
	default n
	help
	  Enable sunxi platform De-Interlace engine

config SUNXI_DI_V1XX
	bool "Support DI V110/120"
	depends on (AW_DI)
	default n
	help
	 Say Y here if you want to use DI110/120.
	 Say N here if you do NOT want to use DI110/120.
	 If unsure, say N.

config SUNXI_DI_V2X
	bool "Support DI V200"
	depends on (AW_DI)
	default n
	help
	 Say Y here if you want to use DI200.
	 Say N here if you do NOT want to use DI200.
	 If unsure, say N.

config SUNXI_DI_V3X
	bool "Support DI V300"
	depends on (AW_DI) && (PM) && (PM_SLEEP)
	default n
	help
	 Say Y here if you want to use DI300.
	 Say N here if you do NOT want to use DI300.
	 If unsure, say N.

config SUNXI_DI_SINGEL_FILE
	bool "Support Single File"
	depends on (SUNXI_DI_V3X)
	default n
	help
	 Say Y here if you want to use Single File.
	 Say N here if you do NOT want to use Single File.
	 If unsure, say N.

config SUNXI_DI_AMP_SERVER
	bool "Open amp server"
	depends on (SUNXI_DI_V3X)
	select RPMSG
	default n
	help
	 Say Y here if you want to open amp server in DI.
	 Say N here if you do NOT want to open amp server in DI.
	 If unsure, say N.

endmenu
```

## bsp/drivers/dma/Kconfig
```kconfig
# SPDX-License-Identifier: GPL-2.0-only

menu "DMA Drivers"
	depends on AW_BSP

config AW_DMA
	tristate "DMA Support for Allwinner SoCs"
	select DMADEVICES
	select DMA_ENGINE
	select DMA_VIRTUAL_CHANNELS
	help
	  Support for the DMA Controller for Allwinner SoCs.

endmenu
```

## bsp/drivers/dram_info/Kconfig
```kconfig
# SPDX-License-Identifier: GPL-2.0-only
#
# dram_info drivers configuration
#

menu "Dram_info Drivers"
	depends on AW_BSP

config SUNXI_DRAM_INFO
	tristate "dram_info Support for Allwinner SoCs"
	depends on AW_BSP
	default n
	help
	  This enables support for Dram_info Allwinner SoCs.

endmenu
```

## bsp/drivers/drm/panel/Kconfig
```kconfig
# SPDX-License-Identifier: GPL-2.0-or-later

config PANEL_DSI_GENERAL
	tristate "dsi general panel"
	depends on (AW_DRM)
	select VIDEOMODE_HELPERS
	select BACKLIGHT_CLASS_DEVICE
	select BACKLIGHT_PWM
	select DRM_DISPLAY_DP_HELPER
	select DRM_DISPLAY_HELPER
	default n
	help
		If you want to support general dsi panel, select it.

config PANEL_LVDS_GENERAL
	tristate "lvds general panel"
	depends on (AW_DRM)
	select VIDEOMODE_HELPERS
	select BACKLIGHT_CLASS_DEVICE
	select BACKLIGHT_PWM
	default n
	help
		If you want to support general lvds panel, select it.

config PANEL_RGB_GENERAL
	tristate "rgb general panel"
	depends on (AW_DRM)
	select VIDEOMODE_HELPERS
	select BACKLIGHT_CLASS_DEVICE
	select BACKLIGHT_PWM
	default n
	help
		If you want to support general rgb panel, select it.

config PANEL_EDP_GENERAL
    tristate "eDP general drm panel"
	depends on (AW_DRM)
	select VIDEOMODE_HELPERS
	select BACKLIGHT_CLASS_DEVICE
	select BACKLIGHT_PWM
    default n
    help
        If you want to support general edp panel, select it.
```

## bsp/drivers/drm/phy/Kconfig
```kconfig
# SPDX-License-Identifier: GPL-2.0-or-later

menuconfig AW_DRM_PHY
	tristate "Support disp phy for sunxi drm"
	depends on AW_DRM
	default n
	help
		If you want use phy for disp interface, select it.

config AW_DRM_DSI_COMBOPHY
	bool "LVDS and MIPI DSI Combophy"
	depends on (AW_DRM_PHY)
	default n
	help
		If you want to support lvds dsi combophy, select it.
```

## bsp/drivers/drm_heap/Kconfig
```kconfig
# SPDX-License-Identifier: GPL-2.0-only
# Generic Trusted Execution Environment Configuration

menu "DRM HEAP Drivers"
	depends on AW_BSP
config AW_DRM_HEAP
	tristate "Allwinner drm heap Allwinner"
	default n
	select TEE
	help
	  This implements a interface for sunxi drm management

endmenu
```

## bsp/drivers/dsufreq/Kconfig
```kconfig
# SPDX-License-Identifier: GPL-2.0-only

menu "sunxi dsufreq Drivers"
	depends on AW_BSP

config AW_SUNXI_DSUFREQ
	tristate "Allwinner dsufreq based sunxi cpufreq driver"
	depends on AW_CPUFREQ_DT
	help
	  This adds the dsufreq based CPUFreq driver for Allwinner SoC.

	  To compile this driver as a module, choose M here: the
	  module will be called sunxi-dsufreq.

config AW_SUNXI_DSUFREQ_TEST
        tristate "Generic test for dsufreq test driver"
        help
          This adds a dsu driver for frequency management.

          If in doubt, say N.

config AW_SUNXI_DSUFREQ_ADJUST
	bool "trigger dsu frequency scaling"
	default n
	help
	  perform a cpu frequency adjustment.

endmenu
```

## bsp/drivers/dumpreg/Kconfig
```kconfig
# SPDX-License-Identifier: GPL-2.0-only

menu "Dump-Reg Drivers"
	depends on AW_BSP

config AW_DUMP_REG
	tristate "Dump-Reg Support for Allwinner SoCs"
	depends on AW_BSP
	default y
	help
	  Say y here if you want to support sunxi dump-reg module.
	  The dump-reg module is used to dump registers of any device.
	  When in doubt, say "Y".

endmenu
```

## bsp/drivers/emac/Kconfig
```kconfig
# SPDX-License-Identifier: GPL-2.0-only
menu "Emac Drivers"
	depends on AW_BSP

config AW_EMAC
	tristate "Allwinner EMAC support"
	depends on OF
	select AW_EMAC_MDIO
	select CRC32
	help
	  Support for Allwinner Fast ethernet driver.

	  To compile this driver as a module, choose M here.  The module
	  will be called sunxi-emac.ko.

config AW_EMAC_MDIO
	tristate "Allwinner EMAC mdio support"
	select MDIO_BUS
	select MDIO_DEVICE
	select NETDEVICES
	select PHYLIB
	select MII
	help
	  Support for Allwinner EMAC mdio driver

endmenu
```

## bsp/drivers/fs/Kconfig
```kconfig
# SPDX-License-Identifier: GPL-2.0-only


#depends on !FAT_FS && AW_BSP && LINUX_VERSION_CODE >= KERNEL_VERSION(5, 15, 0) && LINUX_VERSION_CODE < KERNEL_VERSION(5, 16, 0)
# SPDX-License-Identifier: GPL-2.0
#menu "AW fs version select"
#endmenu

menuconfig AW_FS_5_15
	tristate "aw fs modify for linux(5.15)"
	depends on !FAT_FS && AW_BSP && $(VERSION) = 5 && $(PATCHLEVEL) = 15
	default n
	help
	  aw fs modify for linux 5.15,such as fat

if AW_FS_5_15
source "bsp/drivers/fs/linux-5.15/Kconfig"
endif

#menu "select fs driver for linux 6.1"
#	depends on !FAT_FS && AW_BSP && $(VERSION) = 6 && $(PATCHLEVEL) = 1

#source "bsp/drivers/fs/linux-$(VERSION).$(PATCHLEVEL)/Kconfig"
#endmenu
```

## bsp/drivers/fs/linux-5.15/Kconfig
```kconfig
# SPDX-License-Identifier: GPL-2.0-only

source "bsp/drivers/fs/linux-5.15/fs/Kconfig"
```
