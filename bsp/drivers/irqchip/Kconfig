## bsp/drivers/irqchip/Kconfig
```kconfig
# SPDX-License-Identifier: GPL-2.0
#
# For a description of the syntax of this configuration file,
# see Documentation/kbuild/kconfig-language.rst.

menu "IRQ-Chip Drivers"
	depends on AW_BSP

config AW_WAKEUPGEN
	tristate "sunxi wakeup irq chip"
	depends on AW_BSP
	select IRQCHIP
	select IRQ_DOMAIN_HIERARCHY
	help
	   This enables support for sunxi wakeupgen irq domain.

	   If you don't know what to do here, say Y.

config AW_SUN8I_NMI
	tristate "sun8i nmi irq chip"
	depends on AW_BSP
	select IRQCHIP
	select IRQ_DOMAIN_HIERARCHY
	help
	   This enables support for sun8i nmi irq domain.

	   If you don't know what to do here, say Y.

endmenu
```

## bsp/drivers/jtag/Kconfig
```kconfig
# SPDX-License-Identifier: GPL-2.0-only
menu "JTAG Drivers"
	depends on AW_BSP

config AW_SOFT_JTAG_MASTER
	tristate "Allwinner Soft JTAG Master Drivers"
	help
	  Support for Allwinner Soft JTAG Master driver.

	  To compile this driver as a module, choose M here. The module
	  will be called sunxi-soft-jtag.ko.

config AW_JTAG_MASTER
	tristate "Allwinner JTAG Master Drivers"
	help
	  Support for Allwinner JTAG Master driver.

	  To compile this driver as a module, choose M here. The module
	  will be called sunxi-jtag.ko.
endmenu
```

## bsp/drivers/ledc/Kconfig
```kconfig
# SPDX-License-Identifier: GPL-2.0-only
#
# LEDC drivers configuration
#

menu "LED Drivers"
	depends on AW_BSP

config AW_LEDC
        tristate "LEDC Support for Allwinner SoCs"
	depends on AW_DMA
	select NEW_LEDS
	select LEDS_CLASS
	select LEDS_TRIGGERS
	select LEDS_TRIGGER_TIMER
	help
	  This enables support for LED Controller on Allwinner SoCs.

endmenu
```

## bsp/drivers/lradc/Kconfig
```kconfig
# SPDX-License-Identifier: GPL-2.0-only
#
# LRADC drivers configuration
#

menu "Low Rate ADC Drivers"
	depends on AW_BSP


config AW_LRADC
	tristate "Keyboard Support for Allwinner SoCs"
	select INPUT_EVDEV
	help
	  Say Y here to enable the ADC keyboard, support 7 keys at most.

endmenu
```

## bsp/drivers/mbus/Kconfig
```kconfig
# SPDX-License-Identifier: GPL-2.0-only

menu "MBUS Drivers"
	depends on AW_BSP

config AW_MBUS_SUN50IW9
	tristate "Mbus Support for Allwinner SoCs SUN50IW9"
	depends on ARCH_SUN50IW9
	select HWMON
	help
	  Driver supporting the mbus for sunxi platforms of sun50iw9.

config AW_MBUS_SUN8IW11
	tristate "Mbus Support for Allwinner SoCs SUN8IW11"
	depends on ARCH_SUN8IW11
	select HWMON
	help
	  Driver supporting the mbus for sunxi platforms of sun8iw11.

config AW_MBUS_SUN8IW18
	tristate "Mbus Support for Allwinner SoCs SUN8IW18"
	depends on ARCH_SUN8IW18
	select HWMON
	help
	  Driver supporting the mbus for sunxi platforms of sun8iw18.

config AW_MBUS_SUN8IW20
	tristate "Mbus Support for Allwinner SoCs SUN8IW20"
	depends on ARCH_SUN8IW20
	select HWMON
	help
	  Driver supporting the mbus for sunxi platforms of sun8iw20.

config AW_MBUS_SUN8IW21
	tristate "Mbus Support for Allwinner SoCs SUN8IW21"
	depends on ARCH_SUN8IW21
	select HWMON
	help
	  Driver supporting the mbus for sunxi platforms of sun8iw21.

menuconfig AW_MBUS_GENERIC
	bool "Mbus Support for Allwinner SoCs"
	default n

if AW_MBUS_GENERIC

config AW_MBUS_PRI_IN_ACPR_CFG
	bool "master priority by ACPR reg"
	default n
	help
	  Some platform implement master access priority
	  in register MBUS_MAST_CFG0_REG(n)
	  register: Master Access Priority, 0:low, 1:high

endif

endmenu
```

## bsp/drivers/misc/Kconfig
```kconfig
# SPDX-License-Identifier: GPL-2.0

menu "Misc Devices Drivers"

config SUNXI_DIRECT_GPIO
	tristate "Sunxi direct gpio support"
	help
	  This driver provides a set of interfaces for direct control of gpio,
	  including setting input/output, pull-up/pull-down, drive capability and
	  other interfaces (mainly used for control of box lights, buzzers, etc.)

source "bsp/drivers/misc/sunxi-rf/Kconfig"
source "bsp/drivers/misc/sunxi-addr/Kconfig"
source "bsp/drivers/misc/sunxi-bootevent/Kconfig"
source "bsp/drivers/misc/sunxi-tvutils/Kconfig"
source "bsp/drivers/misc/leds/Kconfig"

endmenu
```

## bsp/drivers/misc/leds/Kconfig
```kconfig
#
# sunxi system information driver.
#
#
config SUNXI_LED_BCT
	bool "enable sunxi led bct driver"
	default n
	help
	  Choose Y to enable sunxi tv subsystem utils driver

config SUNXI_LED_DM
	bool "enable sunxi led baffle"
	depends on SUNXI_LED_BCT
	default n
```

## bsp/drivers/misc/sunxi-addr/Kconfig
```kconfig
# SPDX-License-Identifier: GPL-2.0

config AW_MACADDR_MGT
  tristate "Allwinner Network MAC Addess Manager"
  depends on AW_RFKILL || BT || ETHERNET
  help
    allwinner network mac address management
```

## bsp/drivers/misc/sunxi-bootevent/Kconfig
```kconfig
#
# Copyright(c) 2017-2018 Allwinnertech Co., Ltd.
#
# This program is free software; you can redistribute it and/or modify
# it under the terms of the GNU General Public License as published by
# the Free Software Foundation; either version 2 of the License, or
# (at your option) any later version.
#
# This program is distributed in the hope that it will be useful,
# but WITHOUT ANY WARRANTY; without even the implied warranty of
# MERCHANTABILITY or FITNESS FOR A PARTICULAR PURPOSE.  See the
# GNU General Public License for more details.
#

#
# sunxi bootevent debugger driver.
#
config AW_BOOTEVENT
  tristate "Enable aw bootevent debugger tool"
  default n
  help
    AW_BOOTEVENT is used to debug bootting time,If you are not sure
	about whether to enable it or not, please set n.
```

## bsp/drivers/misc/sunxi-rf/Kconfig
```kconfig
# SPDX-License-Identifier: GPL-2.0
#
# Allwinner rfkill driver.
#
config AW_RFKILL
  tristate "Allwinner rfkill driver"
  depends on WIRELESS || RFKILL
  help
    allwinner rfkill driver
```

## bsp/drivers/misc/sunxi-tvutils/Kconfig
```kconfig
#
# sunxi system information driver.
#
#
config SUNXI_TVUTILS_SCRIPTS
	bool "enable sunxi tv subsystem utils driver"
	default n
	help
	  Choose Y to enable sunxi tv subsystem utils driver

config SUNXI_AFBD_WORKAROUND
	bool "workaround for afbd register read error"
	depends on (ARCH_SUNXI)
	default n
	help
	  Choose Y to enable workaround for sunxi afbd bug
```

## bsp/drivers/mmc/Kconfig
```kconfig
# SPDX-License-Identifier: GPL-2.0-only
#
# MMC/SD host controller drivers
#

menu "SD/MMC Drivers"
	depends on AW_BSP

config AW_MMC_HSQ
	tristate "Allwinner SD/MMC SoftQueue Support"
	depends on MMC
	depends on !MMC_HSQ
	help
	  This selects inplace SoftQueue Support

config AW_MMC
	tristate "Allwinner SD/MMC Host Controller Support"
	depends on MMC
	depends on MMC_HSQ || AW_MMC_HSQ

	help
	  This selects support for the SD/MMC Host Controller on
	  Allwinner SoCs.

config AW_MMC_V4P1X
	bool "V4P1X SD/MMC Host Controller Support"
	depends on AW_MMC
	default y
	help
	  V4P1X SD/MMC Host Contrller support.

config AW_MMC_V4P00X
	bool "V4P00X SD/MMC Host Controller Support"
	depends on AW_MMC
	default y
	help
	  V4P00X SD/MMC Host Contrller support.

config AW_MMC_V4P10X
	bool "V4P10X SD/MMC Host Controller Support"
	depends on AW_MMC
	default n
	help
	  V4P10X SD/MMC Host Contrller support.

config AW_MMC_V4P5X
	bool "V4P5X SD/MMC Host Controller Support"
	depends on AW_MMC
	default y
	help
	  V4P5X SD/MMC Host Contrller support.

config AW_MMC_V5P3X
	bool "V5P3X SD/MMC Host Controller Support"
	depends on AW_MMC
	default y
	help
	  V5P3X SD/MMC Host Contrller support.

config AW_MMC_DEBUG
	bool "SD/MMC Host Controller debug support"
	depends on AW_MMC
	default n
	help
	  AW SD/MMC Host Contrller debug support.

config AW_MMC_PRE_DBGLVL
        int "Pre-defined debug level for AW MMC driver"
	depends on AW_MMC && AW_MMC_DEBUG
	default 3

config AW_MMC_CQHCI
	tristate "Allwinner Command Queue Host Controller Interface support"
	depends on AW_MMC
	depends on HAS_DMA
	help
	  This selects the Command Queue Host Controller Interface (CQHCI)
	  support present in host controllers of Qualcomm Technologies, Inc
	  amongst others.
	  This controller supports eMMC devices with command queue support.
	  If you have a controller with this interface, say Y or M here.
	  If unsure, say N.

config AW_MMC_PSTORE_PANIC
    tristate "MMC Pstore block-backend Support Panic Write"
    depends on AW_MMC
	depends on AW_PSTORE_BLK
    default n
    help
	  The selects for pstore block-backend to write frontend message in panic context

	  If unsure, say N.
endmenu
```

## bsp/drivers/msgbox/Kconfig
```kconfig
# SPDX-License-Identifier: GPL-2.0-only

menu "MSGBOX Drivers"
	depends on AW_BSP

config AW_MSGBOX
	tristate "Msgbox support for Allwinner SoCs"
	depends on AW_BSP
	select  MAILBOX
	help
	  Say y here to support Allwinner SOC processors via the
	  msgbox framework.

config AW_MAILBOX_SUPPORT_TXDONE_IRQ
	bool "Allwinner mailbox support txdone irq"
	depends on AW_MSGBOX
	help
	  Say y here to support Allwinner SOC processors msgbox txdone irq.

endmenu
```

## bsp/drivers/mtd/Kconfig
```kconfig
menuconfig AW_MTD
	tristate "Memory Technology Device (AW_MTD) support"
	depends on AW_BSP
	imply NVMEM
	help
	  Memory Technology Devices are flash, RAM and similar chips, often
	  used for solid state file systems on embedded devices. This option
	  will provide the generic support for MTD drivers to register
	  themselves with the kernel and for potential users of MTD devices
	  to enumerate the devices which are present and obtain a handle on
	  them. It will also allow you to select individual drivers for
	  particular hardware and users of MTD devices. If unsure, say N.

if AW_MTD

config AW_MTD_PSTORE
	tristate "Log panic/oops to an MTD buffer based on pstore"
	depends on PSTORE
	select PSTORE_ZONE
	help
	  This enables panic and oops messages to be logged to a circular
	  buffer in a flash partition where it can be read back as files after
	  mounting pstore filesystem.

	  If unsure, say N.

if AW_MTD_PSTORE
config AW_MTD_PSTORE_MTDDEV
	string "mtd device identifier"
	depends on AW_MTD_PSTORE
	default ""
	help
	  Which mtd device should be used for pstore/sunxi_mtdpstore.

	  <device name> MTD device name. "pstore" is recommended.

config AW_MTD_PSTORE_KMSG_SIZE
	int "Size in Kbytes of kmsg dump log to store"
	depends on AW_MTD_PSTORE
	default 64
	help
	  This just sets size of kmsg dump (oops, panic, etc) log for
	  pstore/sunxi_mtdpstore. The size is in KB and must be a multiple of 4.

	  NOTE that, both Kconfig and module parameters can configure
	  pstore/sunxi_mtdpstore, but module parameters have priority over Kconfig.

config AW_MTD_PSTORE_MAX_REASON
	int "Maximum kmsg dump reason to store"
	depends on AW_MTD_PSTORE
	default 2
	help
	  The maximum reason for kmsg dumps to store. The default is
	  2 (KMSG_DUMP_OOPS), see include/linux/kmsg_dump.h's
	  enum kmsg_dump_reason for more details.

	  NOTE that, both Kconfig and module parameters can configure
	  pstore/sunxi_mtdpstore, but module parameters have priority over Kconfig.

config AW_MTD_PSTORE_PMSG_SIZE
	int "Size in Kbytes of pmsg to store"
	depends on AW_MTD_PSTORE
	depends on PSTORE_PMSG
	default 0
	help
	  This just sets size of pmsg (pmsg_size) for pstore/sunxi_mtdpstore. The size is
	  in KB and must be a multiple of 4.

	  NOTE that, both Kconfig and module parameters can configure
	  pstore/sunxi_mtdpstore, but module parameters have priority over Kconfig.
	  now don't recommend to use it.

config AW_MTD_PSTORE_CONSOLE_SIZE
	int "Size in Kbytes of console log to store"
	depends on AW_MTD_PSTORE
	depends on PSTORE_CONSOLE
	default 0
	help
	  This just sets size of console log (console_size) to store via
	  pstore/sunxi_mtdpstore. The size is in KB and must be a multiple of 4.

	  NOTE that, both Kconfig and module parameters can configure
	  pstore/sunxi_mtdpstore, but module parameters have priority over Kconfig.
	  now don't recommend to use it.

config AW_MTD_PSTORE_FTRACE_SIZE
	int "Size in Kbytes of ftrace log to store"
	depends on AW_MTD_PSTORE
	depends on PSTORE_FTRACE
	default 0
	help
	  This just sets size of ftrace log (ftrace_size) for pstore/blk. The
	  size is in KB and must be a multiple of 4.

	  NOTE that, both Kconfig and module parameters can configure
	  pstore/sunxi_mtdpstore, but module parameters have priority over Kconfig.
	  now don't recommend to use it.
endif

menu "Partition parsers"
source "bsp/drivers/mtd/parsers/Kconfig"
endmenu

choice
	prompt "SPI NOR Driver Select"
        optional

	config AW_MTD_SPI_NOR_5_15
		tristate "SPI NOR device support(5.15)"
		depends on AW_MTD && SPI_MASTER
		select SPI_MEM
		help
		  This is the framework for the SPI NOR which can be used by the SPI
		  device drivers and the SPI NOR device driver.

	config AW_MTD_SPI_NOR_6_1
		tristate "SPI NOR device support(6.1)"
		depends on AW_MTD && SPI_MASTER
		select SPI_MEM
		help
		  This is the framework for the SPI NOR which can be used by the SPI
		  device drivers and the SPI NOR device driver.
endchoice

source "bsp/drivers/mtd/spi-nor-5.15/Kconfig"

source "bsp/drivers/mtd/spi-nor-6.1/Kconfig"

source "bsp/drivers/mtd/awnand/Kconfig"

endif # AW_MTD
```

## bsp/drivers/mtd/awnand/Kconfig
```kconfig
menu "AW_MTD_NAND"

config RAW_KERNEL
	bool "Kernel images are stored on physical partitions"
	help
	  Enables support kernel images are stored on physical partitions.

config KERNEL_SIZE_BYTE
	int "Kernel image size(Byte)"
	depends on RAW_KERNEL
	default 0
	help
	  To accurately read the complete kernel image, you need to set
	  the kernel image size (in bytes) when using the RAW-boot function.

config SIMULATE_MULTIPLANE
	bool "enable simulate multiplane"
	default n
	help
	  spinand do not support multiplane. In order to adapt to aw nand
	  we simulate multiplane. If set, the common physical layer should
	  merge two continuous physical block to 'super block' for logical
	  layer.

	  Merge pages in two adjacent blocks with the same page num to super
	  page. Merge adjacent blocks to super block.

	  *   phy-block0   phy-block1    = super block 0
	  * |------------|------------|
	  * | phy-page 0 | phy-page 0 |  = super page 0 on super block 0
	  * | phy-page 1 | phy-page 1 |  = super page 1 on super block 0
	  * |     ...    |     ...    |
	  * |------------|------------|

	  If unsure, say Y.

source "bsp/drivers/mtd/awnand/spinand/Kconfig"
source "bsp/drivers/mtd/awnand/rawnand/Kconfig"

endmenu
```
