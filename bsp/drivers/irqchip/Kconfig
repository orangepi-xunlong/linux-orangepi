## bsp/drivers/mtd/awnand/rawnand/Kconfig
```kconfig
#
# SPDX-License-Identifier: GPL-2.0+
# (C) Copyright 2020 - 2021
# Allwinner Technology Co., Ltd. <www.allwinnertech.com>
# cuizhikui <cuizhikui@allwinnertech.com>

menuconfig AW_MTD_RAWNAND
	tristate "Allwinner MTD RAWNAND Device Support"
	depends on AW_MTD
	depends on ARCH_SUNXI
	depends on !SUNXI_NAND
	select AW_RAWNAND_SECURE_STORAGE
	select MTD
	select MTD_UBI
	help
	  Enables support for RAWNAND Flash chips on Allwinner SoCs.
	  It's different with Allwinner's privately nand driver that it use
	  ubi system rather than Allwinner's NFTL.

if AW_MTD_RAWNAND

config AW_RAWNAND_PSTORE_MTD_PART
	bool "create pstore mtd partition for aw ubi rawnand"
	depends on AW_MTD_RAWNAND
	select MTD_PSTORE
	help
	  Whether create pstore mtd partition, which is need by pstroe-blk.
	  If you want linux kernel dump log to spinand when oops/panic, you
	  should create pstreo mtd partition by this configure.

	  If unsure, say no.

config AW_RAWNAND_SIMULATE_MULTIPLANE
	bool "enable simulate multiplane"
	default y
	help
	  spinand do not support multiplane. In order to adapt to aw nand
	  we simulate multiplane. If set, the common physical layer should
	  merge two continuous physical block to 'super block' for logical
	  layer.

	  Merge pages in two adjacent blocks with the same page num to super
	  page. Merge adjacent blocks to super block.

	  *   phy-block0   phy-block1    = super block 0
	  * |------------|------------|
	  * | phy-page 0 | phy-page 0 |  = super page 0 on super block 0
	  * | phy-page 1 | phy-page 1 |  = super page 1 on super block 0
	  * |     ...    |     ...    |
	  * |------------|------------|

	  If unsure, say Y.

config AW_RAWNAND_BURN_CHECK_BOOT0
	bool "upload boot0 to check after download boot0 img"
	depends on AW_MTD_RAWNAND

config AW_RAWNAND_BURN_CHECK_UBOOT
	bool "upload uboot to check after download uboot img"
	depends on AW_MTD_RAWNAND

endif
```

## bsp/drivers/mtd/awnand/spinand/Kconfig
```kconfig
menuconfig AW_MTD_SPINAND
	tristate "Allwinner MTD SPINAND Device Support"
	depends on AW_MTD
	depends on ARCH_SUNXI
	select AW_SPINAND_PHYSICAL_LAYER
	select AW_SPINAND_SECURE_STORAGE
	select MTD
	select MTD_UBI
	select AW_SID
	help
	  Enables support for SPINAND Flash chips on Allwinner SoCs.
	  It's different with Allwinner's privately nand driver that it use
	  ubi system rather than Allwinner's NFTL.

if AW_MTD_SPINAND

config AW_SPINAND_PHYSICAL_LAYER
	bool
	help
	  Enable support for Allwinner's physical layer for spinand.
	  It's a command physical layer, used by both AW-nand with nftl and
	  MTD-nand with ubi.

config AW_SPINAND_SECURE_STORAGE
	bool
	help
	  Enable secure storage for Allwinner's spinand.

	  If unsure, say no.

config AW_SPINAND_PSTORE_MTD_PART
	bool "create pstore mtd partition for aw ubi spinand"
	depends on AW_MTD_SPINAND
	select AW_MTD_PSTORE
	help
	  Whether create pstore mtd partition, which is need by pstroe-blk.
	  If you want linux kernel dump log to spinand when oops/panic, you
	  should create pstreo mtd partition by this configure.

	  If unsure, say no.

config AW_SPINAND_PSTORE_PANIC_WRITE
	bool "support pstore panic write message"
	depends on AW_SPINAND_PSTORE_MTD_PART
	select SPI_SUNXI_ATOMIC_XFER
	help
	  In order to ensure that the data is written down in panic context when
	  use mtdpstore. This need spi controller driver support by select
	  SPI_SUNXI_ATOMIC_XFER.

	  If unsure, say Y.

config AW_SPINAND_ENABLE_PHY_CRC16
	bool "check crc16 for each page on spinand physical layer"
	depends on AW_SPINAND_PHYSICAL_LAYER
	help
	  It is experimental.
	  To check crc16 for each page on spinand physical layer.

	  If unsure, say no.

config AW_SPINAND_SIMULATE_MULTIPLANE
	bool "enable simulate multiplane"
	depends on AW_SPINAND_PHYSICAL_LAYER
	default y
	help
	  spinand do not support multiplane. In order to adapt to aw nand
	  we simulate multiplane. If set, the common physical layer should
	  merge two continuous physical block to 'super block' for logical
	  layer.

	  Merge pages in two adjacent blocks with the same page num to super
	  page. Merge adjacent blocks to super block.

	  *   phy-block0   phy-block1    = super block 0
	  * |------------|------------|
	  * | phy-page 0 | phy-page 0 |  = super page 0 on super block 0
	  * | phy-page 1 | phy-page 1 |  = super page 1 on super block 0
	  * |     ...    |     ...    |
	  * |------------|------------|

	  If unsure, say Y.

config AW_MTD_SPINAND_OOB_RAW_SPARE
	bool "support mtd read oob raw spare data"
	depends on AW_MTD_SPINAND
	default n
	help
		aw spinand do not support read raw spare data by default, say yes to
		support mtd read oob raw spare data.

		if enable AW_MTD_SPINAND_OOB_RAW_SPARE, the oob is equivalent to spare area,
		otherwise oob is the user data spare area in ecc protected.

config AW_MTD_SPINAND_FASTBOOT
	bool "support fastboot"
	depends on AW_MTD_SPINAND
	default n
	help
		boot0 to load kernel and jump kernel

config BIMAGE_SIZE
	int "bimage size"
	depends on AW_MTD_SPINAND_FASTBOOT
	default 20
	help
		unit is MiByte, it serves as the size of the boot partition
endif
```

## bsp/drivers/mtd/parsers/Kconfig
```kconfig
# SPDX-License-Identifier: GPL-2.0-only
config AW_MTD_SUNXI_PARTS
	tristate "SUNXI partitioning support"
	help
	  This provides partitions parser for devices based on SUNXI
	  boards.
```

## bsp/drivers/mtd/spi-nor-5.15/Kconfig
```kconfig
# SPDX-License-Identifier: GPL-2.0-only

if AW_MTD_SPI_NOR_5_15

config AW_MTD_SPI_NOR_USE_4K_SECTORS
	bool "Use small 4096 B erase sectors"
	default y
	help
	  Many flash memories support erasing small (4096 B) sectors. Depending
	  on the usage this feature may provide performance gain in comparison
	  to erasing whole blocks (32/64 KiB).
	  Changing a small part of the flash's contents is usually faster with
	  small sectors. On the other hand erasing should be faster when using
	  64 KiB block instead of 16 * 4 KiB sectors.

	  Please note that some tools/drivers/filesystems may not work with
	  4096 B erase size (e.g. UBIFS requires 15 KiB as a minimum).

source "bsp/drivers/mtd/spi-nor-5.15/controllers/Kconfig"

endif # AW_MTD_SPI_NOR
```

## bsp/drivers/mtd/spi-nor-6.1/controllers/Kconfig
```kconfig
# SPDX-License-Identifier: GPL-2.0-only
config SPIF_SUNXI
	tristate "SUNXI SPIF Controller"
	depends on AW_BSP && OF
	help
	  Allwinner SOC SPIF controller, present on SUNXI chips.
```

## bsp/drivers/net/Kconfig
```kconfig
# SPDX-License-Identifier: GPL-2.0

menu "Network Device Drivers"
	depends on NET

if NETDEVICES

source "bsp/drivers/net/wireless/Kconfig"

endif

endmenu
```

## bsp/drivers/net/wireless/Kconfig
```kconfig
menu "Wireless LAN"
	depends on !S390
	depends on NET

if WLAN

source "bsp/drivers/net/wireless/bcmdhd/Kconfig"
source "bsp/drivers/net/wireless/rtl8188fu/Kconfig"
source "bsp/drivers/net/wireless/rtl8723cs/Kconfig"
source "bsp/drivers/net/wireless/rtl8723ds/Kconfig"
source "bsp/drivers/net/wireless/rtl8723du/Kconfig"
source "bsp/drivers/net/wireless/rtl8822bs/Kconfig"
source "bsp/drivers/net/wireless/rtl8822cu/Kconfig"
source "bsp/drivers/net/wireless/rtl8852bs/Kconfig"
source "bsp/drivers/net/wireless/xr819/Kconfig"
source "bsp/drivers/net/wireless/xr829/Kconfig"
source "bsp/drivers/net/wireless/uwe5622/Kconfig"
source "bsp/drivers/net/wireless/aic8800/Kconfig"
source "bsp/drivers/net/wireless/atbm6023is/Kconfig"
source "bsp/drivers/net/wireless/ssv6158/Kconfig"
endif

endmenu
```

## bsp/drivers/net/wireless/aic8800/aic8800_btusb/Kconfig
```kconfig
config AIC8800_BTUSB_SUPPORT
	tristate "AIC8800 bluetooth Support (USB)"
	help
	  This is support for aic usb bluetooh driver.
```

## bsp/drivers/net/wireless/rtl8723du/Kconfig
```kconfig
config RTL8723DU
	tristate "Realtek 8723D USB WiFi"
	default n
	help
	  Help message of RTL8723DU
```

## bsp/drivers/net/wireless/rtl8852bs/Kconfig
```kconfig
config RTL8852BS
	tristate "Realtek 8852B SDIO WiFi"
	help
	  Help message of RTL8852BS
```
