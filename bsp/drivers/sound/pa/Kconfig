## bsp/drivers/sound/pa/Kconfig
```kconfig
# SPDX-License-Identifier: GPL-2.0-or-later
#
# Allwinner audio pa driver Kconfig
#
# Copyright(c) 2022-2027 Allwinnertech Co., Ltd.

menu "PA drivers"

config SND_SOC_AW87XXX
	tristate "SoC Audio for awinic AW87XXX Smart K PA"
	depends on I2C
	help
	  This option enables support for AW87XXX Smart K PA.

config SND_SOC_AD8XXXX
	tristate "SoC Audio for ESMT AD8XXXX series"
	depends on I2C
	help
		This option enables support for ESMT AD8XXXX series PA.

config SND_SMARTPA_AW882XX
	tristate "SoC Audio for awinic aw882xx series"
	depends on I2C
	help
		This option enables support for aw882xx series Smart PA.
endmenu
```

## bsp/drivers/sound/platform/Kconfig
```kconfig
# SPDX-License-Identifier: GPL-2.0-or-later
#
# Allwinner audio platform driver Kconfig
#
# Copyright(c) 2022-2027 Allwinnertech Co., Ltd.

# common
config SND_SOC_SUNXI_PCM
	tristate

config SND_SOC_SUNXI_MACH
	tristate

config SND_SOC_SUNXI_COMMON
	tristate

# ahub dam
config SND_SOC_SUNXI_AHUB_DAM
	tristate

# codec
config SND_SOC_SUNXI_SUNXI_DUMMYCODEC
	tristate

config SND_SOC_SUNXI_INTERNALCODEC
	tristate

config SND_SOC_SUNXI_SUN50IW10_CODEC
	tristate

config SND_SOC_SUNXI_SUN50IW9_CODEC
	tristate

config SND_SOC_SUNXI_SUN8IW11_CODEC
	tristate

config SND_SOC_SUNXI_SUN8IW18_CODEC
	tristate

config SND_SOC_SUNXI_SUN8IW20_CODEC
	tristate

config SND_SOC_SUNXI_SUN8IW21_CODEC
	tristate

config SND_SOC_SUNXI_SUN20IW1_CODEC
	tristate

config SND_SOC_SUNXI_SUN55IW3_CODEC
	tristate

config SND_SOC_SUNXI_SUN55IW6_CODEC
	tristate

config SND_SOC_SUNXI_SUN251IW1_CODEC
	tristate

config SND_SOC_SUNXI_SUN300IW1_CODEC
	tristate

config SND_SOC_SUNXI_SUN65IW1_CODEC
	tristate

# menu select
menu "Platform drivers"

# aaudio
config SND_SOC_SUNXI_AAUDIO
	tristate "Allwinner AAUDIO support"
	select REGMAP_MMIO
	select SND_SOC_GENERIC_DMAENGINE_PCM
	select SND_SOC_SUNXI_PCM
	select SND_SOC_SUNXI_MACH
	select SND_SOC_SUNXI_INTERNALCODEC
	select SND_SOC_SUNXI_COMMON
	select SND_SOC_SUNXI_SUN50IW10_CODEC if ARCH_SUN50IW10
	select SND_SOC_SUNXI_SUN50IW9_CODEC if ARCH_SUN50IW9
	select SND_SOC_SUNXI_SUN8IW11_CODEC if ARCH_SUN8IW11
	select SND_SOC_SUNXI_SUN8IW18_CODEC if ARCH_SUN8IW18
	select SND_SOC_SUNXI_SUN8IW20_CODEC if ARCH_SUN8IW20
	select SND_SOC_SUNXI_SUN8IW21_CODEC if ARCH_SUN8IW21
	select SND_SOC_SUNXI_SUN20IW1_CODEC if ARCH_SUN20IW1
	select SND_SOC_SUNXI_SUN55IW3_CODEC if ARCH_SUN55IW3
	select SND_SOC_SUNXI_SUN55IW6_CODEC if ARCH_SUN55IW6
	select SND_SOC_SUNXI_SUN251IW1_CODEC if ARCH_SUN251IW1
	select SND_SOC_SUNXI_SUN300IW1_CODEC if ARCH_SUN300IW1
	select SND_SOC_SUNXI_SUN65IW1_CODEC if ARCH_SUN65IW1
	depends on ARCH_SUN50IW10 \
		|| ARCH_SUN50IW9  \
		|| ARCH_SUN8IW11  \
		|| ARCH_SUN8IW18  \
		|| ARCH_SUN8IW20  \
		|| ARCH_SUN8IW21  \
		|| ARCH_SUN20IW1  \
		|| ARCH_SUN55IW3  \
		|| ARCH_SUN55IW6  \
		|| ARCH_SUN251IW1  \
                || ARCH_SUN300IW1  \
		|| ARCH_SUN65IW1
	help
	  Select Y or M to support analog-audio Module in the Allwinner SoCs.

# owa
config SND_SOC_SUNXI_OWA
	tristate "Allwinner OWA support"
	select REGMAP_MMIO
	select SND_SOC_GENERIC_DMAENGINE_PCM
	select SND_SOC_SUNXI_PCM
	select SND_SOC_SUNXI_MACH
	select SND_SOC_SUNXI_COMMON
	depends on ARCH_SUN50IW10 \
		|| ARCH_SUN50IW9  \
		|| ARCH_SUN8IW11  \
		|| ARCH_SUN8IW20  \
		|| ARCH_SUN20IW1  \
		|| ARCH_SUN55IW3  \
		|| ARCH_SUN8IW18  \
		|| ARCH_SUN55IW6  \
		|| ARCH_SUN65IW1  \
		|| ARCH_SUN251IW1 \
		|| ARCH_SUN60IW2
	help
	  Select Y or M to support OWA Module in Allwinner SoCs.

# owa for RX IEC61937
config SND_SOC_SUNXI_OWA_RXIEC61937
	tristate "Allwinner OWA RX IEC61937 support"
	default y
	depends on SND_SOC_SUNXI_OWA
	depends on !ARCH_SUN50IW10 && !ARCH_SUN50IW9
	help
	  Select Y or M to support OWA RX IEC61937 in Allwinner SoCs.

# dmic
config SND_SOC_SUNXI_DMIC
	tristate "Allwinner DMIC support"
	select REGMAP_MMIO
	select SND_SOC_GENERIC_DMAENGINE_PCM
	select SND_SOC_SUNXI_PCM
	select SND_SOC_SUNXI_MACH
	select SND_SOC_SUNXI_COMMON
	depends on ARCH_SUN50IW10 \
		|| ARCH_SUN50IW9  \
		|| ARCH_SUN55IW3  \
		|| ARCH_SUN8IW18  \
		|| ARCH_SUN8IW20  \
		|| ARCH_SUN8IW21  \
		|| ARCH_SUN20IW1  \
		|| ARCH_SUN55IW6  \
		|| ARCH_SUN65IW1 \
		|| ARCH_SUN251IW1 \
		|| ARCH_SUN60IW2
	help
	  Select Y or M to support DMIC Module in Allwinner SoCs.

# i2s
config SND_SOC_SUNXI_I2S
	tristate "Allwinner I2S support"
	select REGMAP_MMIO
	select SND_SOC_GENERIC_DMAENGINE_PCM
	select SND_SOC_SUNXI_PCM
	select SND_SOC_SUNXI_MACH
	select SND_SOC_SUNXI_COMMON
	depends on ARCH_SUN50IW10 \
		|| ARCH_SUN8IW11  \
		|| ARCH_SUN55IW3  \
		|| ARCH_SUN8IW18  \
		|| ARCH_SUN8IW17  \
		|| ARCH_SUN8IW20  \
		|| ARCH_SUN8IW21  \
		|| ARCH_SUN20IW1  \
		|| ARCH_SUN55IW6  \
		|| ARCH_SUN251IW1  \
                || ARCH_SUN300IW1  \
		|| ARCH_SUN65IW1 \
		|| ARCH_SUN60IW2
	help
	  Select Y or M to support I2S/PCM/TDM Module in Allwinner SoCs.

if SND_SOC_SUNXI_I2S
# HDMIAUDIO
config SND_SOC_SUNXI_CODEC_HDMI
	tristate "Allwinner HDMIAUDIO support"
	depends on ARCH_SUN55IW3 \
		|| ARCH_SUN8IW11 \
		|| ARCH_SUN8IW20  \
		|| ARCH_SUN20IW1  \
		|| ARCH_SUN65IW1 \
		|| ARCH_SUN60IW2
	help
	  Select Y or M to support hdmi audio in Allwinner SoCs.
#EDPAUDIO
config SND_SOC_SUNXI_CODEC_EDP
	tristate "Allwinner EDPAUDIO support"
	depends on ARCH_SUN55IW3 \
		|| ARCH_SUN65IW1
	help
	  Select Y or M to support edp audio in Allwinner SoCs.
#AVAUDIO
config SND_SOC_SUNXI_CODEC_AV
	tristate "Allwinner AVAUDIO support"
	depends on ARCH_SUN60IW2
	help
	  Select Y or M to support av audio in Allwinner SoCs.
endif

# ahub
config SND_SOC_SUNXI_AHUB
	tristate "Allwinner AHUB support"
	select REGMAP_MMIO
	select SND_SOC_GENERIC_DMAENGINE_PCM
	select SND_SOC_SUNXI_PCM
	select SND_SOC_SUNXI_MACH
	select SND_SOC_SUNXI_AHUB_DAM
	select SND_SOC_SUNXI_COMMON
	depends on ARCH_SUN50IW9
	help
	  Select Y or M to support audio-hub Module in Allwinner SoCs.

# HDMIAUDIO
if SND_SOC_SUNXI_AHUB
config SND_SOC_SUNXI_CODEC_HDMI
	tristate "Allwinner HDMIAUDIO support"
	depends on ARCH_SUN50IW9
	help
	  Select Y or M to support hdmi audio in Allwinner SoCs.
endif

# Components for all
config SND_SOC_SUNXI_COMPONENTS
	tristate "Allwinner function components"
	depends on ARCH_SUN50IW10 \
		|| ARCH_SUN50IW9  \
		|| ARCH_SUN8IW11  \
		|| ARCH_SUN55IW3  \
		|| ARCH_SUN55IW6  \
		|| ARCH_SUN8IW18  \
		|| ARCH_SUN8IW20  \
		|| ARCH_SUN8IW21  \
		|| ARCH_SUN20IW1  \
		|| ARCH_SUN251IW1  \
                || ARCH_SUN300IW1  \
		|| ARCH_SUN65IW1 \
		|| ARCH_SUN60IW2
	help
	  Select Y or M to support function components.

config SND_SOC_SUNXI_SFX
	tristate "Components SFX"
	depends on SND_SOC_SUNXI_COMPONENTS
	depends on ARCH_SUN50IW10 \
		|| ARCH_SUN55IW3 \
                || ARCH_SUN300IW1  \
		|| ARCH_SUN65IW1 \
		|| ARCH_SUN251IW1
	help
	  Select Y or M to support sfx components.

config SND_SOC_SUNXI_DEBUG
	tristate "Components debug"
	depends on SND_SOC_SUNXI_COMPONENTS
	help
	  Select Y or M to support debug components.

config SND_SOC_SUNXI_DYNAMIC_DEBUG
	bool "Enable audio dynamic debug"
	default y
	help
	  Enable audio dynamic debug

config SND_SOC_SUNXI_PULSEAUDIO
	bool "Enable pulseaudio dedicated pins"
	depends on SND_SOC_SUNXI_COMPONENTS
	help
	  Enable pulseaudio Headphone Jack and Headset Mic Jack.

endmenu
```

## bsp/drivers/spi-ng/Kconfig
```kconfig
# SPDX-License-Identifier: GPL-2.0-or-later

menu "SPI NG Drivers"
	depends on AW_BSP

config AW_SPI_NG
	tristate "SPI NG Driver Support for Allwinner SoCs"
	depends on OF && (ARCH_SUNXI || ARCH_RV32I || COMPILE_TEST)
	default n
	select SPI
	help
	  Enable SPI Next Generation Driver Support for Allwinner SoCs.

config AW_SPI_NG_BIT
	bool "Support driver bit-aligned feature"
	depends on AW_SPI_NG
	default y

config AW_SPI_NG_DBI
	bool "Support driver dbi feature"
	depends on AW_SPI_NG
	default y

config AW_SPI_NG_CAMERA
	bool "Support driver camera feature"
	depends on AW_SPI_NG
	default y

config AW_SPI_NG_ATOMIC_XFER
	bool "Support atomic xfer function"
	depends on AW_SPI_NG
	default n
	help
	  Enable SPI controller atomic xfer function, support transfer under
	  no-irq/no-dma/no-schedule/no-suspend-resume env. (Such as kernel panic)

if AW_SPI_NG
config AW_SPI_SLAVETEST
	tristate "SPI Slave Test Driver"
	default n
	select SPI_SLAVE
	help
	  Enable SPI Slave Test Driver.

config AW_SPI_CAMERATEST
	tristate "SPI Camera Test Driver"
	depends on AW_SPI_NG_CAMERA
	default n
	select SPI_SLAVE
	help
	  Enable SPI Camera Test Driver.
endif

endmenu
```

## bsp/drivers/spi/Kconfig
```kconfig
# SPDX-License-Identifier: GPL-2.0-only

menu "SPI Drivers"
	depends on AW_BSP

config AW_SPI
	tristate "SPI Support for Allwinner SoCs"
	depends on AW_BSP && OF
	default n
	select SPI
	help
	  Enable SPI controllers on Allwinner SoCs.

config AW_SPI_ATOMIC_XFER
	bool "Support atomic xfer function"
	depends on AW_SPI
	default n
	help
	  Enable SPI controller atomic xfer function, support transfer under
	  no-irq/no-dma/no-schedule/no-suspend-resume env. (Such as kernel panic)

endmenu
```

## bsp/drivers/standby/Kconfig
```kconfig
#
# sunxi standby debug config.
# SPDX-License-Identifier: GPL-2.0-only
menu "Standby Debugging Drivers"
	depends on AW_BSP

config AW_STANDBY_DEBUG
	tristate "Allwinner Standby Debugging Driver"
	depends on AW_BSP && PM && (ARM || ARM64)
	default y
	help
	  Say y here if you want to support standby debug module.
	  The standby debug module is used to debug system suspend.
	  When in doubt, say "Y".

endmenu
```

## bsp/drivers/stmmac/Kconfig
```kconfig
# SPDX-License-Identifier: GPL-2.0-only
menu "Stmmac Drivers"
	depends on AW_BSP

config AW_STMMAC_ETH
	tristate "Allwinner STMMAC driver"
	depends on OF && (ARCH_SUNXI || COMPILE_TEST)
	select NETDEVICES
	select STMMAC_ETH
	select STMMAC_PLATFORM
	select AW_DWMAC_SUNXI

	help
	  Support for Allwinner GMAC-200/GMAC-300 ethernet controllers.

	  This selects Allwinner SoC glue layer support for the
	  stmmac device driver. This driver is used for
	  GMAC-200/GMAC-300 ethernet controller.

if AW_STMMAC_ETH
config AW_DWMAC_SUNXI
	tristate "Allwinner STMMAC DWMAC support"
	depends on OF && (ARCH_SUNXI || COMPILE_TEST)
	help
	  Support stmmac device driver for Allwinner GMAC-200/GMAC-300.

config AW_STMMAC_SELFTESTS
	bool "Support for STMMAC Selftests"
	depends on AW_STMMAC_ETH
	select STMMAC_SELFTESTS
	default n
	help
	  This adds support for STMMAC Selftests using ethtool. Enable this
	  feature if you are facing problems with your HW and submit the test
	  results to the netdev Mailing List.

config AW_STMMAC_UIO
	tristate "STMMAC UIO ethernet controller"
	default n
	select UIO
	help
	  Say M here if you want to use the sunxi-uio.ko for DPDK.

endif

endmenu
```

## bsp/drivers/thermal/Kconfig
```kconfig
# SPDX-License-Identifier: GPL-2.0-only
menu "Thermal Drivers"
	depends on AW_BSP

config AW_THERMAL
	tristate "Allwinner Thermal Driver"
	depends on AW_BSP
	depends on HAS_IOMEM
	depends on NVMEM
	depends on OF
	select THERMAL
	help
	  Support for the sunxi thermal sensor driver into the Linux thermal
	  framework.

	  To compile this driver as a module, choose M here: the
	  module will be called sunxi-thermal.

config AW_CPUFREQ_CLAMP
	tristate "Allwinner Cpufreq Clamp Driver"
	depends on AW_THERMAL
	depends on ARM_AW_SUN50I_CPUFREQ_NVMEM
	help
	  Support for the sunxi cpufreq clamp driver.

	  If in doubt, say N.

config AW_THERMAL_CRITICAL_HANDLER
	bool "suspend to handle critical temperature"
	default n
	depends on AW_THERMAL
	depends on PM_SLEEP
	help
	  Support critical callback for the thermal zone device ops.
	  Trigger suspend when the temperature reachs the critical trip.

config AW_THERMAL_REWRITE_CRITICAL_OPS
	bool "rewrite critical ops"
	default n
	depends on AW_THERMAL_CRITICAL_HANDLER
	help
	  Say Y here to rewrite the critical member of thermal_zon_device_ops struct.

	  This option is used because the origin kernel does not allow interfaces in thermal_of.c to rewrite critical callback.

endmenu
```

## bsp/drivers/timer/Kconfig
```kconfig
# SPDX-License-Identifier: GPL-2.0-only
menu "Timer Drivers"
	depends on GENERIC_CLOCKEVENTS
	depends on AW_BSP

config AW_TIMER
	tristate "Timer support for Allwinner SoCs"
	depends on HAS_IOMEM
	select CLKSRC_MMIO
	select TIMER_OF
	help
	  Enables support for the Sun4i timer.

config AW_TIMER_SUN50I
	tristate "Timer support for Allwinner Sun50i SoCs"
	depends on HAS_IOMEM
	select CLKSRC_MMIO
	select TIMER_OF
	help
	  Enables support for the Sun50i timer.

config AW_TIMER_DYNAMIC_DEBUG
	bool "Enable timer dynamic debug"
	depends on AW_TIMER || AW_TIMER_SUN50I
	default y
	help
	  Enable timer dynamic debug

endmenu
```

## bsp/drivers/tvd/Kconfig
```kconfig
# SPDX-License-Identifier: GPL-2.0-only
menu "TVD (cvbs in) Drivers"
    depends on AW_BSP

config AW_VIDEO_SUNXI_TVD
    tristate "sunxi tvd driver"
    depends on ARCH_SUN8IW11 || ARCH_SUN8IW17
    select MEDIA_SUPPORT
    select VIDEOBUF2_DMA_CONTIG
    default n

endmenu
```

## bsp/drivers/twi/Kconfig
```kconfig
# SPDX-License-Identifier: GPL-2.0-only
#
# TWI drivers configuration
#
menu "TWI Drivers"
	depends on AW_BSP

config AW_TWI
	tristate "I2C Support for Allwinner SoCs"
	depends on AW_DMA
	select HAS_IOMEM
	select I2C
	select I2C_CHARDEV
	help
	  If you say yes to this option, support will be included for the
	  TWI interface from Allwinner SoCs.

config AW_TWI_DELAYINIT
	bool "SUNXI TWI hardware init delay"
	depends on AW_TWI
	help
	  If you need to use twi in the heterogeneous core first and then
	  notify twi in linux to obtain hardware resources, you can say yes
	  to this option, twi hardware resource init will be delayed.

config AW_TWI_DYNAMIC_DEBUG
	bool "SUNXI TWI DYNAMIC DEBUG"
	depends on AW_TWI
	help
	  If you need to print twi information, you can say yes to this option.
endmenu
```

## bsp/drivers/uart/Kconfig
```kconfig
# SPDX-License-Identifier: GPL-2.0
#
# Serial device configuration
#

menu "UART Drivers"
	depends on TTY
	depends on HAS_IOMEM
	depends on AW_BSP

config AW_UART
	tristate "UART Support for Allwinner SoCs"
	depends on AW_BSP
	select SERIAL_CORE
	default y
	help
	  Enable the UART (Serial Ports) of the SoC

config AW_UART_NG
	tristate "UART NG Support for Allwinner SoCs"
	depends on AW_BSP
	select SERIAL_CORE
	default n
	help
	  Enable the UART NG (Serial Ports) of the SoC

config AW_SERIAL_DMA
	bool "Enable DMA for UART"
	depends on AW_UART
	depends on AW_DMA
	depends on OF
	default n
	help
	  Allow DMA to be used for UART transmission.

config AW_SERIAL_CONSOLE
	bool "Enable Console on UART"
	select SERIAL_CORE_CONSOLE
	depends on AW_UART || AW_UART_NG
	default AW_UART
	help
	  Allow an UART port to be used as the system console.

config AW_SERIAL_EARLYCON
	bool "Enable Earlycon"
	depends on SERIAL_EARLYCON
	depends on AW_UART || AW_UART_NG
	default n
	help
	  Enable earlycon during boot stage.
	  If This is enabled, kernel cmdline (earlycon=uart0,<addr>) must be specified.

config AW_EARLY_PRINTK
	bool "Enable Early-Printk"
	depends on AW_BSP
	default y
	help
	  Enabled Early-Printk for debugging

config AW_IOSERIAL
	bool "Enable GPIO based Serial"
	depends on AW_PINCTRL
	default n
	help
	  Enabled GPIO based Serial for debugging

config AW_UART_DYNAMIC_DEBUG
	bool "Enable uart dynamic debug"
	depends on AW_UART || AW_UART_NG
	default y
	help
	  Enable uart dynamic debug

source "bsp/drivers/uart/sunxi-soft-uart/Kconfig"

endmenu
```

## bsp/drivers/uart/sunxi-soft-uart/Kconfig
```kconfig
# SPDX-License-Identifier: GPL-3.0

config AW_SOFT_UART
	tristate "Enable Soft-Uart"
	depends on AW_BSP
	default n
	help
	  Enabled Soft-Uart(UART based on GPIO)
```

## bsp/drivers/ufs/Kconfig
```kconfig
# SPDX-License-Identifier: GPL-2.0-only
#
# ufs host controller drivers
#

menu "SUNXI UFS Drivers"
	depends on AW_BSP

config AW_UFS
	tristate "Allwinner UFS Support"
	depends on SCSI_UFSHCD_PLATFORM
	help
	  This selects allwinner ufs drivers

endmenu
```
