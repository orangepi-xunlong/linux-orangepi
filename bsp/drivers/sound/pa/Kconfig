## bsp/drivers/usb/Kconfig
```kconfig
# SPDX-License-Identifier: GPL-2.0
#
# USB configuration
#

menu "USB Drivers"
	depends on AW_BSP

if AW_BSP && USB_SUPPORT

source "bsp/drivers/usb/dwc3/Kconfig"

if USB

source "bsp/drivers/usb/host/Kconfig"

endif # USB

source "bsp/drivers/usb/sunxi_usb/Kconfig"

source "bsp/drivers/usb/typec/Kconfig"

source "bsp/drivers/usb/gadget/Kconfig"

source "bsp/drivers/usb/extcon/Kconfig"

source "bsp/drivers/usb/phy/Kconfig"

endif # USB_SUPPORT

endmenu
```

## bsp/drivers/usb/dwc3/Kconfig
```kconfig
# SPDX-License-Identifier: GPL-2.0-only

menu "USB DWC3 Drivers"
	depends on AW_BSP

config USB_SUNXI_DWC3
	tristate "Allwinner USB3.0 Dual Role Controller support"
	depends on AW_BSP
	help
	  Allwinner USB3.0 Dual Role Controller

	  This option is of interest only to developers who need to
	  develop on AllWinner SoC.

	  If unsure, say N.

config PHY_SUNXI_PLAT
	tristate "Allwinner SoC USB PHY driver"
	depends on USB_SUNXI_DWC3
	depends on ARCH_SUNXI || COMPILE_TEST
	depends on HAS_IOMEM && OF
	depends on RESET_CONTROLLER
	select GENERIC_PHY
	help
	  Enable this to support the USB3.0-capable transceiver that is
	  part of Allwinner Platforms SoC.

	  This driver controls each individual USB 2+3 PHY combo.

config DWC3_SUNXI_PLAT
	tristate "Allwinner DWC3 Platforms"
	depends on USB_SUNXI_DWC3
	depends on OF && COMMON_CLK
	default USB_DWC3
	help
	  Support DWC3 of USB2/3 functionality in Allwinner platforms.
	  say 'Y' or 'M' if you have one such device.

endmenu
```

## bsp/drivers/usb/extcon/Kconfig
```kconfig
# SPDX-License-Identifier: GPL-2.0-only

menu "USB EXTCON Support"
	depends on AW_BSP

config USB_SUNXI_EXTCON
	tristate "Allwinner USB External Connector support"
	depends on AW_BSP
	help
	  Allwinner USB External Connector.

	  This option is of interest only to developers who need to
	  develop on AllWinner SoC.

	  If unsure, say N.

config EXTCON_SUNXI_PLAT
	tristate "Allwinner EXTCON Platforms"
	depends on USB_SUNXI_EXTCON
	depends on USB_SUNXI_HCD
	depends on OF && COMMON_CLK
	help
	  Support EXTCON of USB2.0 HOST functionality in Allwinner platforms.
	  say 'Y' or 'M' if you have one such device.

config EXTCON_SUNXI_USB_GPIO
	tristate "Allwinner USB GPIO extcon support"
	depends on USB_SUNXI_EXTCON
	depends on GPIOLIB || COMPILE_TEST
	select EXTCON
	help
	  Say Y here to enable GPIO based USB cable detection extcon support.
	  Used typically if GPIO is used for USB ID pin detection.

endmenu
```

## bsp/drivers/usb/gadget/Kconfig
```kconfig
# SPDX-License-Identifier: GPL-2.0

menu "USB Gadget Drivers"
	depends on AW_BSP

#
# USB Gadget Drivers
#

if USB_GADGET

menuconfig USB_SUNXI_GADGET
	tristate "Allwinner USB Gadget support"
	depends on AW_BSP
	help
          Allwinner USB Gadget Drivers.

	  This option is of interest only to developers who need to
	  develop on AllWinner SoC.

	  If unsure, say N.

source "bsp/drivers/usb/gadget/function/Kconfig"

source "bsp/drivers/usb/gadget/legacy/Kconfig"

endif # USB_GADGET

endmenu
```

## bsp/drivers/usb/gadget/function/Kconfig
```kconfig
# SPDX-License-Identifier: GPL-2.0-only

if USB_GADGET

config USB_SUNXI_CONFIGFS_F_HID
	tristate "Allwinner HID function"
        depends on USB_SUNXI_GADGET
	depends on USB_CONFIGFS
	select USB_F_HID
	help
	  The HID function driver provides generic emulation of USB
	  Human Interface Devices (HID).

	  For more information, see Documentation/usb/gadget_hid.rst.

config USB_SUNXI_F_UVC
	tristate

config USB_SUNXI_CONFIGFS_F_UVC
	tristate "Allwinner USB Webcam function"
	depends on USB_SUNXI_GADGET
	depends on USB_CONFIGFS
	depends on VIDEO_V4L2
	depends on VIDEO_DEV
	select VIDEOBUF2_VMALLOC
	select USB_SUNXI_F_UVC
	help
	  The Webcam function acts as a composite USB Audio and Video Class
	  device. It provides a userspace API to process UVC control requests
	  and stream video data to the host.

config USB_SUNXI_F_UAC1
	tristate

config USB_SUNXI_CONFIGFS_F_UAC1
	tristate "Allwinner Audio Class 1.0"
	depends on USB_SUNXI_GADGET
	depends on USB_CONFIGFS
	depends on SND
	select USB_LIBCOMPOSITE
	select SND_PCM
	select USB_SUNXI_F_UAC1
	help
	  This Audio function implements 1 AudioControl interface,
	  1 AudioStreaming Interface each for USB-OUT and USB-IN.
	  This driver doesn't expect any real Audio codec to be present
	  on the device - the audio streams are simply sinked to and
	  sourced from a virtual ALSA sound card created. The user-space
	  application may choose to do whatever it wants with the data
	  received from the USB Host and choose to provide whatever it
	  wants as audio data to the USB Host.

endif # USB_GADGET
```

## bsp/drivers/usb/gadget/legacy/Kconfig
```kconfig
# SPDX-License-Identifier: GPL-2.0-only

if USB_GADGET

# put drivers that need isochronous transfer support (for audio
# or video class gadget drivers), or specific hardware, here.
config USB_SUNXI_G_WEBCAM_LEGACY
	tristate "Allwinner USB Webcam Gadget Legacy"
	depends on USB_SUNXI_GADGET
	depends on VIDEO_V4L2
	select USB_LIBCOMPOSITE
	select VIDEOBUF2_VMALLOC
	select USB_SUNXI_F_UVC
	help
	  The Webcam Gadget acts as a composite USB Audio and Video Class
	  device. It provides a userspace API to process UVC control requests
	  and stream video data to the host.

	  Say "y" to link the driver statically, or "m" to build a
	  dynamically linked module called "g_webcam".

endif # USB_GADGET
```

## bsp/drivers/usb/host/Kconfig
```kconfig
# SPDX-License-Identifier: GPL-2.0-only
#
# USB host drivers configuration
#

menu "USB Host Controller Drivers"

config USB_EHCI_HCD_SUNXI
       tristate "Allwinner EHCI HCD"
       help
         This driver enables support for the internal USB Host Controllers
         found in Allwinner SoCs. The controllers are EHCI compliant.

config USB_OHCI_HCD_SUNXI
       tristate "Allwinner OHCI HCD"
       help
         This driver enables support for the internal USB Host Controllers
         found in Allwinner SoCs. The controllers are OHCI compliant.

config USB_SUNXI_HCD
    tristate "Allwinner USB Host Controller"
	depends on USB
	help
	  Allwinner USB2.0 Host Controller support.

	  This option is of interest only to developers who need to
	  develop on AllWinner SoC.

	  If unsure, say N.

config USB_SUNXI_HCD0
    tristate "Allwinner USB Host Controller0"
        depends on USB_SUNXI_HCD && ARCH_SUN8IW6
        help
          Allwinner USB2.0 Host Controller0.
	  Enable this option if your board has this chip, and you want
	  to use it as a host controller.

	  If unsure, say N.

config USB_SUNXI_HCI
    tristate "Allwinner USB HCI"
	depends on USB_SUNXI_HCD
	help
	  Allwinner USB HCI.

	  This option is of interest only to developers who need to
	  develop on AllWinner SoC.

	  If unsure, say N.

config USB_SUNXI_EHCI0
    tristate "Allwinner USB EHCI0"
	depends on USB_SUNXI_HCI
	help
	  Allwinner USB EHCI0.

	  This option is of interest only to developers who need to
	  develop on AllWinner SoC.

	  If unsure, say N.

config USB_SUNXI_EHCI1
    tristate "Allwinner USB EHCI1"
	depends on USB_SUNXI_HCI && !ARCH_SUN50IW6 && !ARCH_SUN8IW5 \
			&& !ARCH_SUN8IW18
	help
	  Allwinner USB EHCI1.

	  This option is of interest only to developers who need to
	  develop on AllWinner SoC.

	  If unsure, say N.

config USB_SUNXI_EHCI2
    tristate "Allwinner USB EHCI2"
	depends on USB_SUNXI_HCI && (ARCH_SUN8IW11 || ARCH_SUN50IW2 \
			|| ARCH_SUN8IW7 || ARCH_SUN8IW17 || ARCH_SUN50IW9)
	help
	  Allwinner USB EHCI2.

	  This option is of interest only to developers who need to
	  develop on AllWinner SoC.

	  If unsure, say N.

config USB_SUNXI_EHCI3
    tristate "Allwinner USB EHCI3"
	depends on USB_SUNXI_HCI && (ARCH_SUN50IW2 || ARCH_SUN8IW7 \
			|| ARCH_SUN50IW6 || ARCH_SUN8IW17 || ARCH_SUN50IW9)
	help
	  Allwinner USB EHCI3.

	  This option is of interest only to developers who need to
	  develop on AllWinner SoC.

	  If unsure, say N.

config USB_SUNXI_OHCI0
    tristate "Allwinner USB OHCI0"
	depends on USB_SUNXI_HCI
	help
	  Allwinner USB OHCI0.

	  This option is of interest only to developers who need to
	  develop on AllWinner SoC.

	  If unsure, say N.

config USB_SUNXI_OHCI1
    tristate "Allwinner USB OHCI1"
	depends on USB_SUNXI_HCI && !ARCH_SUN8IW6 && !ARCH_SUN50IW6 \
			&& !ARCH_SUN8IW5 && !ARCH_SUN8IW18
	help
	  Allwinner USB OHCI1.

	  This option is of interest only to developers who need to
	  develop on AllWinner SoC.

	  If unsure, say N.

config USB_SUNXI_OHCI2
    tristate "Allwinner USB OHCI2"
	depends on USB_SUNXI_HCI && (ARCH_SUN8IW11 || ARCH_SUN50IW2 \
			|| ARCH_SUN8IW7 || ARCH_SUN8IW17 || ARCH_SUN50IW9)
	help
	  Allwinner USB OHCI2.

	  This option is of interest only to developers who need to
	  develop on AllWinner SoC.

	  If unsure, say N.

config USB_SUNXI_OHCI3
    tristate "Allwinner USB OHCI3"
	depends on USB_SUNXI_HCI && (ARCH_SUN50IW2 || ARCH_SUN8IW7 \
			|| ARCH_SUN50IW6 || ARCH_SUN8IW17 || ARCH_SUN50IW9)
	help
	  Allwinner USB OHCI3.

	  This option is of interest only to developers who need to
	  develop on AllWinner SoC.

	  If unsure, say N.

config USB_SUNXI_XHCI
	tristate "Allwinner USB XHCI"
	depends on USB_SUNXI_HCI && ARCH_SUN50IW6
	select USB_XHCI_PLATFORM if USB_SUPPORT && USB_XHCI_HCD
	help
	  The Renesas USBSS is a XHCI controller.
	  Enable this option if your board has this chip, and you want
	  to use it as a host controller.

	  If unsure, say N.

endmenu
```

## bsp/drivers/usb/phy/Kconfig
```kconfig
# SPDX-License-Identifier: GPL-2.0-only
#
# Phy drivers for SUNXI platforms
#

menu "USB PHY Support"
	depends on AW_BSP

config USB_SUNXI_PHY
	tristate "Allwinner USB2.0/3.0 PHY support"
	depends on AW_BSP
	help
	  Allwinner USB PHY Driver.

	  This option is of interest only to developers who need to
	  develop on AllWinner SoC.

	  If unsure, say N.

config USB_SUNXI_AWPHY
	tristate "Allwinner USB2.0 AW PHY Driver"
	depends on AW_BSP && OF
	depends on USB_SUNXI_PHY
	select GENERIC_PHY
	help
	  Enable this to support the Allwinner USB2.0 AW PHY
	  with UTMI + Level3 Interface.

endmenu
```

## bsp/drivers/usb/sunxi_usb/Kconfig
```kconfig
#
# Allwinner USB2.0 Dual Role Controller Driver.
#

#---------------------------------------------
#-
#- config USB2.0 Dual Role Controller.
#-
#---------------------------------------------
menu "USB Device Drivers"
	depends on AW_BSP

menuconfig USB_SUNXI_USB
    tristate "Allwinner USB2.0 Dual Role Controller support"
    depends on AW_BSP
    help
      Allwinner USB2.0 Dual Role Controller

      This option is of interest only to developers who need to
      develop on AllWinner SoC.

      If unsure, say N.

config USB_SUNXI_USB_MANAGER
    tristate "Allwinner USB2.0 Manager"
    depends on USB_SUNXI_USB && USB_SUNXI_UDC0 && USB_SUNXI_HCI
    help
      manager all usb controller.

      This option is of interest only to developers who need to
      develop on AllWinner SoC.

      If unsure, say N.

config USB_SUNXI_USB_DEBUG
    tristate "Allwinner USB driver debug message"
    depends on USB_SUNXI_USB
    help
      Allwinner USB driver debug message.

      This option is of interest only to developers who need to
      develop on AllWinner SoC.

      If unsure, say N.

config USB_SUNXI_USB_ADB
    tristate "Allwinner USB driver use adb source"
    depends on USB_SUNXI_USB
    help
      Allwinner USB driver debug message.

      This option is of interest only to developers who need to
      develop on AllWinner SoC.

      If unsure, say N.

config USB_SUNXI_UDC0
	tristate "Allwinner USB Peripheral Controller"
	depends on USB_GADGET
	select USB_GADGET_DUALSPEED
	select USB_GADGET_SELECTED
	help
	  Allwinner USB Device Controller.

	  This option is of interest only to developers who need to
	  develop on AllWinner SoC.

	  If unsure, say N.

endmenu
```

## bsp/drivers/usb/typec/Kconfig
```kconfig
# SPDX-License-Identifier: GPL-2.0
menu "USB Type-C Support"
	depends on AW_BSP

config USB_SUNXI_TYPEC
	tristate "Allwinner USB Type-C support"
	depends on AW_BSP
	help
          Allwinner USB Type-C Port Controller Drivers.

	  This option is of interest only to developers who need to
	  develop on AllWinner SoC.

	  If unsure, say N.

if TYPEC

source "bsp/drivers/usb/typec/tcpm/Kconfig"

source "bsp/drivers/usb/typec/mux/Kconfig"

endif # TYPEC

endmenu
```

## bsp/drivers/usb/typec/mux/Kconfig
```kconfig
# SPDX-License-Identifier: GPL-2.0

menu "USB Type-C Multiplexer/DeMultiplexer Switch support"

config TYPEC_MUX_PS8743
	tristate "Parade PS8743 Type-C cross switch driver"
	depends on USB_SUNXI_TYPEC
	depends on I2C
	help
	  Say Y or M if your system has a Parade PS8743 Type-C cross
	  switch / mux chip found on some devices with a Type-C port.

          If unsure, say N.

config TYPEC_MUX_FSA4480
	tristate "ON Semi FSA4480 Analog Audio Switch driver"
	depends on USB_SUNXI_TYPEC
	depends on I2C
	select REGMAP_I2C
	help
	  Driver for the ON Semiconductor FSA4480 Analog Audio Switch, which
	  provides support for muxing analog audio and sideband signals on a
	  common USB Type-C connector.
	  If compiled as a module, the module will be named fsa4480.

config TYPEC_MUX_GPIO_GMA340
	tristate "GPIO GMA340 mux for USB Type-C applications"
	help
	  Say Y or M if your system uses a GPIO GMA340 mux for managing the
	  connected state and the swapping of the tx rx lines in a Type-C port.

		  If unsure, say N.

config TYPEC_MUX_SUNXI_PHY_SWITCHER
	tristate "Allwinner Mux/Switcher based on external PHY"
	help
	  Say Y or M if switch / mux baed on external PHY for hardware design is need,
	  to manager orientation or mux state for some devices with a Type-C port.

		  If unsure, say N.

endmenu
```

## bsp/drivers/usb/typec/tcpm/Kconfig
```kconfig
# SPDX-License-Identifier: GPL-2.0-only

if TYPEC_TCPM

if TYPEC_TCPCI

config TYPEC_HUSB311
	tristate "Hynetek HUSB311 Type-C chip driver"
	depends on USB_SUNXI_TYPEC
	depends on I2C
	help
	  Hynetek HUSB311 Type-C chip driver that works with
	  Type-C Port Controller Manager to provide USB PD and USB
	  Type-C functionalities.

	  If unsure, say N.

endif # TYPEC_TCPCI

endif # TYPEC_TCPM
```
