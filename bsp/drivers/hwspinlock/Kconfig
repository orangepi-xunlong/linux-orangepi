## bsp/drivers/hwspinlock/Kconfig
```kconfig
# SPDX-License-Identifier: GPL-2.0

menu "HWSPINLOCK Drivers"
	depends on AW_BSP

config AW_HWSPINLOCK
        tristate "Hwspinlock support for Allwinner SoCs"
        depends on AW_BSP
        select HWSPINLOCK
        help
          If you say y here, you will get support for the  to support
	  Hardware Spinlock found on Allwinner SoCs.

          If unsure, say N.
endmenu
```

## bsp/drivers/input/Kconfig
```kconfig
# SPDX-License-Identifier: GPL-2.0-only
#
# Input device configuration
#

menu "Input Device Drivers"
	depends on AW_BSP

config AW_INPUT_SENSORINIT
    tristate  "sunxi sensor init"
        depends on INPUT
        default m
        help
            init sunxi Sensors and CTP;
            If you say yes here you get support for Sensors and CTP init function;

source "bsp/drivers/input/ctp/Kconfig"
source "bsp/drivers/input/sensor/Kconfig"
source "bsp/drivers/input/misc/Kconfig"

endmenu # SUNXI_INPUT_DRIVER
```

## bsp/drivers/input/ctp/Kconfig
```kconfig
# SPDX-License-Identifier: GPL-2.0-only
#
# Touchscreen driver configuration
#

menuconfig AW_INPUT_CTP
	bool "Touchscreens input device support"
	help
	  Say Y here, and a list of supported touchscreens will be displayed.
	  This option doesn't affect the kernel.

	  If unsure, say Y.

if AW_INPUT_CTP

source "bsp/drivers/input/ctp/gt9xx_secondary//Kconfig"
source "bsp/drivers/input/ctp/gslx680new/Kconfig"
source "bsp/drivers/input/ctp/wacom_pen/Kconfig"
source "bsp/drivers/input/ctp/gt9xxnew/Kconfig"
source "bsp/drivers/input/ctp/gt9xx/Kconfig"
source "bsp/drivers/input/ctp/hynitron/Kconfig"
source "bsp/drivers/input/ctp/ilitek_tddi/Kconfig"
source "bsp/drivers/input/ctp/focaltech_touch/Kconfig"
source "bsp/drivers/input/ctp/tlsc6x/Kconfig"
source "bsp/drivers/input/ctp/gt82x/Kconfig"
source "bsp/drivers/input/ctp/nvt36xxx/Kconfig"

endif #touch input device support
```

## bsp/drivers/input/ctp/focaltech_touch/Kconfig
```kconfig
#
# Focaltech Touchscreen driver configuration
#

config TOUCHSCREEN_FTS
    tristate "Focaltech Touchscreen"
    default n
    help
      Say Y here if you have Focaltech touch panel.
      If unsure, say N.
```

## bsp/drivers/input/ctp/gt82x/Kconfig
```kconfig
#
# Goodix GT82x Touchscreen driver
#
config TOUCHSCREEN_GT82X
	tristate "gt82x touchscreen driver"
	default n
	depends on I2C
	select AW_INPUT_SENSORINIT
	help
	  gt813, gt827, gt828 touchscreen driver
	  Say Y here if you have a Goodix GT82x touchscreen
	  controller.

	  If build module, say M.
	  If unsure, say N.
```

## bsp/drivers/input/ctp/gt9xx/Kconfig
```kconfig
#
# Goodix GT9xx Touchscreen driver
#
config TOUCHSCREEN_GT9XX
	tristate "Goodix touchpanel GT9xx series"
	depends on I2C
	help
	  Say Y here if you have a Goodix GT9xx touchscreen
	  controller.

	  If build module, say M.
	  If unsure, say N.
```

## bsp/drivers/input/ctp/gt9xx_secondary/Kconfig
```kconfig
#
# Goodix GT9xx_SECONDARY Touchscreen driver
#
config TOUCHSCREEN_GT9XX_SECONDARY
	tristate "Goodix touchpanel GT9xx_SECONDARY series"
	depends on I2C
	help
	  Say Y here if you have a Goodix GT9xx_SECONDARY touchscreen
	  controller.

          If unsure, say N.

config TOUCHSCREEN_GT9XX_SECONDARY_UPDATE
	tristate "Goodix GT9xx_SECONDARY touch controller auto update support"
	depends on TOUCHSCREEN_GT9XX_SECONDARY
	default n
	help
	  Enable this for support firmware update.

	  Say Y here if you want update touch controller firmware.

	  If unsure, say N.

config TOUCHSCREEN_GT9XX_SECONDARY_TOOL
	tristate "Goodix GT9xx_SECONDARY Tools for debuging"
	depends on TOUCHSCREEN_GT9XX_SECONDARY
	default n
	help
	  This implement interface support for Goodix GT9xx_SECONDARY
	  touchscreen debug.

	  Say Y here if you want to have a Android app debug interface
	  to your system.

	  If unsure, say N.
```

## bsp/drivers/input/ctp/gt9xxnew/Kconfig
```kconfig
#
#  Touchscreen driver configuration
#
config  TOUCHSCREEN_GT9XXNEW_TS
       tristate  "gt9xxnew touchscreen driver"
       depends on INPUT && I2C
       default n
       help
         gt9xxnew touchscreen driver.
         The current driver version is very old and is no longer used.
         If you need to use gt9xx, please use the driver in the gt9xx folder.


config TOUCHSCREEN_GT9XXNEW_UPDATE
    tristate "Goodix GT9xxnew touch controller auto update support"
    depends on TOUCHSCREEN_GT9XXNEW_TS
    default n
    help
      Enable this for support firmware update.

      Say Y here if you want update touch controller firmware.

      If unsure, say N.

config TOUCHSCREEN_GT9XXNEW_TOOL
    tristate "Goodix GT9xxnew Tools for debuging"
    depends on TOUCHSCREEN_GT9XXNEW_TS
    default n
    help
      This implement interface support for Goodix GT9xx
      touchscreen debug.

      Say Y here if you want to have a Android app debug interface
      to your system.

      If unsure, say N.
```

## bsp/drivers/input/ctp/hynitron/Kconfig
```kconfig
#
# Touchscreen driver configuration
#
config TOUCHSCREEN_HYNITRON_TS
    tristate "hynitorn Ts for TOUCHSCREEN"
    depends on I2C
    select AW_INPUT_SENSORINIT
    default n
    help
      Say Y here if you have hynitorn touch panel.
      If unsure, say N.
```

## bsp/drivers/input/ctp/ilitek_tddi/Kconfig
```kconfig
#
#  Touchscreen driver configuration
#
config  TOUCHSCREEN_ILITEK_TDDI
	tristate  "ilitek touchscreen driver"
	help
	  ilitek incell touchscreen driver

if TOUCHSCREEN_ILITEK_TDDI

choice
	prompt "ilitek tddi transfer interface"
	default TOUCHSCREEN_ILITEK_TDDI_I2C_TRANSFER
	help
	  This option is used to select which transport interface to use.

config TOUCHSCREEN_ILITEK_TDDI_I2C_TRANSFER
	bool "i2c"
	help
	  Transfer using I2C

config TOUCHSCREEN_ILITEK_TDDI_SPI_TRANSFER
	bool "spi"
	help
	  Transfer using SPI

endchoice
endif
```

## bsp/drivers/input/ctp/tlsc6x/Kconfig
```kconfig
#
#  Touchscreen driver configuration
#
config  TOUCHSCREEN_TLSC6X_TS
       tristate  "tlsc6x touchscreen driver"
       default n
       help
         tlsc6x touchscreen driver
```

## bsp/drivers/input/misc/Kconfig
```kconfig
# SPDX-License-Identifier: GPL-2.0
#
# Makefile for the sensor drivers.
#
# Each configuration option enables a list of files.


menuconfig AW_INPUT_MISC
    bool "Misc Input Device Support"
    help
      Say Y here, and a list of supported sensor will be displayed.
      This option doesn't affect the kernel.

      If unsure, say Y.

if AW_INPUT_MISC

source "bsp/drivers/input/misc/hall_sensor/Kconfig"
source "bsp/drivers/input/misc/vibrator/Kconfig"

endif
```

## bsp/drivers/input/misc/hall_sensor/Kconfig
```kconfig
#
# Copyright(c) 2017-2018 Allwinnertech Co., Ltd.
#
# This program is free software; you can redistribute it and/or modify
# it under the terms of the GNU General Public License as published by
# the Free Software Foundation; either version 2 of the License, or
# (at your option) any later version.
#
# This program is distributed in the hope that it will be useful,
# but WITHOUT ANY WARRANTY; without even the implied warranty of
# MERCHANTABILITY or FITNESS FOR A PARTICULAR PURPOSE.  See the
# GNU General Public License for more details.
#

config AW_HALL_SENSOR
        tristate "hall sensor driver support"
        depends on AW_INPUT_MISC
        default n
        help
          This driver implements hall device driver.
```

## bsp/drivers/input/misc/vibrator/Kconfig
```kconfig
# SPDX-License-Identifier: GPL-2.0
#
# Makefile for the sensor drivers.
#
# Each configuration option enables a list of files.

config AW_VIBRATOR
        tristate "vibrator driver support"
        depends on AW_INPUT_MISC
        default n
        help
          This driver implements vibrator device driver.
```

## bsp/drivers/input/sensor/Kconfig
```kconfig
# SPDX-License-Identifier: GPL-2.0
#
# Makefile for the sensor drivers.
#
# Each configuration option enables a list of files.


menuconfig AW_INPUT_SENSOR
    bool "Sensor Input Device Support"
    help
      Say Y here, and a list of supported sensor will be displayed.
      This option doesn't affect the kernel.

      If unsure, say Y.

if AW_INPUT_SENSOR

source "bsp/drivers/input/sensor/sc7a20/Kconfig"
source "bsp/drivers/input/sensor/stk3x1x/Kconfig"
source "bsp/drivers/input/sensor/mir3da/Kconfig"
source "bsp/drivers/input/sensor/msa/Kconfig"
source "bsp/drivers/input/sensor/mmc5603/Kconfig"
source "bsp/drivers/input/sensor/bmi323/Kconfig"
source "bsp/drivers/input/sensor/qmi8658/Kconfig"

endif
```

## bsp/drivers/input/sensor/bmi323/Kconfig
```kconfig
#
# Makefile for Bosch sensors driver.
#
config SENSORS_BMI323
	tristate "Bosch Sensortec driver smart log function support"
	depends on (I2C || SPI_MASTER) && SYSFS
	help
	 If you say yes here, you get support for smart log function in Bosch Sensortec driver.
```

## bsp/drivers/input/sensor/mir3da/Kconfig
```kconfig
# SPDX-License-Identifier: GPL-2.0
#
# Makefile for Bosch sensor driver.
#
config SENSORS_MIR3DA
        tristate "mir3da 3-Axis Orientation/Motion Detection Sensor Support"
        select I2C
        depends on AW_INPUT_SENSOR
        default n
        help
          If you say yes here you get support for the mir3da 3-Axis
          Orientation/Motion Detection Sensor.
```

## bsp/drivers/input/sensor/mmc5603/Kconfig
```kconfig
# SPDX-License-Identifier: GPL-2.0
#
# Kconfig for the mmc5603 sensor drivers.

config SENSOR_MMC5603X
        tristate "MMC5603 Magnetometer Sensor Support"
        select I2C
        depends on AW_INPUT_SENSOR
        default n
        help
          If you say yes here you get support for the MMC5603 Magnetometer Sensor.
```

## bsp/drivers/input/sensor/msa/Kconfig
```kconfig
config SENSOR_MSA
        tristate "MSA 311 3-Axis Orientation/Motion Detection Sensor Support"
        select I2C
        depends on AW_INPUT_SENSOR
        default m
        help
          If you say yes here you get support for the Freescale 3-Axis
          Orientation/Motion Detection Sensor.
```

## bsp/drivers/input/sensor/qmi8658/Kconfig
```kconfig
# SPDX-License-Identifier: GPL-2.0
#
# Kconfig for QST sensor driver.
#

config SENSORS_QMI8658
        tristate "QMI8658 3-Axis Orientation/Motion Detection Sensor Support"
        select I2C
        depends on AW_INPUT_SENSOR
        default n
        help
          If you say yes here you get support for the Freescale 3-Axis
          Orientation/Motion Detection Sensor.
```

## bsp/drivers/input/sensor/sc7a20/Kconfig
```kconfig
config SENSOR_SC7A20
        tristate "SC7A20 3-Axis Orientation/Motion Detection Sensor Support"
        select I2C
        depends on AW_INPUT_SENSOR
        default n
        help
          If you say yes here you get support for the Freescale 3-Axis
          Orientation/Motion Detection Sensor.
```

## bsp/drivers/input/sensor/stk3x1x/Kconfig
```kconfig
config SENSOR_STK3X1X
    tristate "stl3x1x Light driver support"
    depends on I2C
    default n
    help
        This driver implements light device driver.
        It communicates with a back-end in another domain.
        To compile this driver as a module, choose M here: the
            module will be called xen-kbdfront.
```

## bsp/drivers/iommu/Kconfig
```kconfig
# SPDX-License-Identifier: GPL-2.0-only
menu "IOMMU Drivers"
	depends on AW_BSP

config AW_IOMMU
       tristate "Allwinner IOMMU Support"
       depends on AW_BSP
       select ARM_DMA_USE_IOMMU if ARM
       select IOMMU_SUPPORT
       select IOMMU_API
       select IOMMU_DMA
       help
         Support for the Allwinner IOMMU(System MMU) component. This
         enables H/W multimedia accellerators to see non-linear physical
         memory chunks as a linear memory in their address spaces.

         If unsure, say N here.


if AW_IOMMU
choice
       prompt "IOMMU verson"
       default AW_IOMMU_V1

config AW_IOMMU_V1
       bool "V1"

config AW_IOMMU_V2
       bool "V2"

config AW_IOMMU_V3
       bool "V3"
endchoice

config AW_IOMMU_DISTRIBUTE
       bool "IOMMU is distribute"
       default n
       default y if AW_IOMMU_V2
endif

config AW_IOMMU_IOVA_TRACE
       bool "Allwinner IOMMU IOVA TRACE"
       depends on AW_IOMMU && ANDROID_VENDOR_HOOKS && DEBUG_FS
       default n
       help
	 Support trace iova alloc/free by using vendor hooks mechanism.

config AW_IOMMU_DEBUG
       tristate "Allwinner IOMMU Profiling and Debugging"
       help
         Makes available some additional IOMMU profiling and debugging
         enables H/W multimedia accellerators to see non-linear physical
         memory chunks as a linear memory in their address spaces.

         Say Y here if you want to debug and trace iommu driver.
         If unsure, say N.

if AW_IOMMU_DEBUG

config AW_IOMMU_TESTS
       tristate "Allwinner Interactive IOMMU performance/functional tests"
       depends on AW_IOMMU_DEBUG
       select IOMMU_API
       help
         Enables a suite of IOMMU unit tests.  The tests are runnable
         through debugfs. The impact of enabling this option to overal
         system performance should be minimal.

endif # AW_IOMMU_DEBUG

endmenu
```

## bsp/drivers/ir-rx/Kconfig
```kconfig
# SPDX-License-Identifier: GPL-2.0-only
#
# IR-RX drivers configuration
#

menu "IR-RX Drivers"
	depends on AW_BSP

config AW_IR_RX
	tristate "IR-RX Support for Allwinner SoCs"
	select RC_CORE
	select RC_DECODERS
	select IR_NEC_DECODER
	select IR_RC5_DECODER
	select INPUT_EVDEV
	help
	  Say Y if you want to use the internal IR-RX Controller on Allwinner SoCs.

config AW_IR_GPIO_RX
	tristate "Allwinner GPIO IR remote control"
	select RC_CORE
	select RC_DECODERS
	select IR_NEC_DECODER
	select IR_RC5_DECODER
	select INPUT_EVDEV
	help
	  Say Y if you want to use Allwinner GPIO based IR Receiver.

endmenu
```

## bsp/drivers/ir-tx/Kconfig
```kconfig
# SPDX-License-Identifier: GPL-2.0-only
#
# IR-TX drivers configuration
#

menu "IR-TX Drivers"
	depends on AW_BSP

config AW_IR_TX
	tristate "IR-TX Support for Allwinner SoCs"
	select INPUT
	select RC_CORE
	select RC_DEVICES
	help
	  Say Y if you want to use sunxi internal IR TX Controller

	  To compile this driver as a module, choose M here: the module will
	  be called sunxi-ir-tx.

config AW_IRTX_DYNAMIC_DEBUG
        bool "Enable irtx dynamic debug"
        depends on AW_IR_TX
        default y
        help
          Enable irtx dynamic debug

endmenu
```
