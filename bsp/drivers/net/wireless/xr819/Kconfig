## bsp/drivers/power/Kconfig
```kconfig
# SPDX-License-Identifier: GPL-2.0-only
#
# PMIC drivers configuration
#

menu "PMIC Drivers"
	depends on AW_BSP

comment "Base Functions"

config AW_MFD_AXP2101
	tristate
	select MFD_CORE
	select REGMAP_IRQ
	select HAS_IOMEM

config AW_MFD_AXP2101_I2C
	tristate "X-POWERS AXP2101 PMICs with I2C"
	depends on AW_TWI
	select AW_MFD_AXP2101
	select REGMAP_I2C
	select I2C
	help
	  If you say Y here you get support for the X-Powers AXP2101 power
	  management ICs (PMICs) controlled with I2C.
	  This driver include only the core APIs. You have to select individual
	  components like regulators or the PEK (Power Enable Key) under the
	  corresponding menus.

config AW_MFD_SOC_PMU
	tristate
	select MFD_CORE
	select HAS_IOMEM

config AW_MFD_PMU_SOC_MMIO
	tristate
	select AW_MFD_SOC_PMU
	select REGMAP_MMIO

config AW_MFD_PMU_EXT
	tristate
	select MFD_CORE
	select REGMAP
	select REGMAP_IRQ

config AW_MFD_PMU_EXT_I2C
	tristate "PMU_EXT PMICs with I2C"
	depends on AW_TWI
	select AW_MFD_PMU_EXT
	select REGMAP_I2C
	select I2C
	help
	  If you say yes here you get support for the TCS4838 series of
	  PM chips with I2C interface.

config AW_MFD_BMU_EXT
	tristate
	select MFD_CORE
	select REGMAP
	select REGMAP_IRQ

config AW_REGULATOR_BMU_EXT
	tristate

config AW_MFD_BMU_EXT_I2C
	tristate "BMU_EXT PMICs with I2C"
	depends on AW_TWI
	select AW_MFD_BMU_EXT
	select AW_REGULATOR_BMU_EXT
	select REGMAP_I2C
	select I2C
	help
	  If you say yes here you get support for the TCS4838 series of
	  PM chips with I2C interface.

config AW_PMIC_VOLATILE_ENABLED
	bool "Select AW PMICs Volatile Enable"

config AW_POWER_DEBUG
	tristate "Allwinner Power DEBUG support"
	depends on AW_BSP
	help
	  Allwinner Power DEBUG.

	  This option is of interest only to developers who need to
	  develop on AllWinner SoC.

	  If unsure, say y.

comment "Regulator Drivers"

if AW_MFD_AXP2101

config AW_REGULATOR_AXP2101
	tristate "X-POWERS AXP2101 PMIC Regulators"
	depends on AW_MFD_AXP2101
	select REGULATOR
	select REGULATOR_VIRTUAL_CONSUMER
	help
	  This driver provides support for the voltage regulators on the
	  AXP2101 PMIC.
endif

if AW_MFD_PMU_EXT

config AW_REGULATOR_PMU_EXT
	tristate "PMU_EXT Power regulator"
	depends on AW_MFD_PMU_EXT
	select REGULATOR
	help
	  This driver provides support for the voltage regulators on the
	  PMU_EXT PMIC.

endif

config AW_REGULATOR_SOC_PMU
	tristate "SOC PMICs Power regulator"
	select AW_MFD_PMU_SOC_MMIO
	select REGULATOR
	help
	  This driver provides support for the voltage regulators on the
	  SOC PMICs.

config AW_REGULATOR_PWM
	tristate "SUNXI PWM voltage regulator"
	depends on PWM
	help
	  This driver supports PWM controlled voltage regulators. PWM
	  duty cycle can increase or decrease the voltage.

config AW_REGULATOR_VIRTUAL_CONSUMER
	tristate "SUNXI VIRTUAL_CONSUMER"
	help
	  This driver supports virtual consumer get the regualtor.

comment "Regulator Functions"

config AW_AXP1530_WORKAROUND_DVM
	bool "AXP1530 SW DVM"
	depends on AW_REGULATOR_PMU_EXT || AW_REGULATOR_AXP2101
	default n
	help
	  Say Y here if you want to enable axp1530 DVM function

comment "Powerkey Drivers"

if AW_MFD_AXP2101

config AW_INPUT_AXP2101_PEK
	tristate "X-POWERS AXP2101 Power Button Driver"
	depends on !UML
	depends on AW_MFD_AXP2101
	select INPUT
	help
	  Say Y here if you want to enable power key reporting via the
	  AXP20X PMIC.

	  To compile this driver as a module, choose M here. The module will
	  be called axp2101-pek.

endif

comment "Power Supply Drivers"

config AW_POWER_SUPPLY_CTRL
	tristate "Allwinner Power Supply Ctrl"
	depends on AW_BSP
	help
	  Allwinner Power Supply Ctrl.

	  This option is of interest only to developers who need to
	  develop on AllWinner SoC.

	  If unsure, say N.

config AW_USB_POWER_CTRL
	tristate "Allwinner Usb Power Ctrl support"
	select EXTCON
	select POWER_SUPPLY
	select AW_POWER_NOTIFIER
	select AW_POWER_SUPPLY_CTRL
	select AW_POWER_DEBUG
	help
	  Allwinner Usb Power Ctrl

	  This option is of interest only to developers who need to
	  develop on AllWinner SoC.

if AW_MFD_AXP2101

config AW_AXP803_POWER
	tristate "AXP803 Power Supply Driver"
	select POWER_SUPPLY
	select AW_POWER_TEMP_CTRL
	help
	  This driver provides support for the power supply features of
	  AXP803 PMIC.

config AW_AXP2202_POWER
	tristate "AXP2202 Power Supply Driver"
	select AW_POWER_TEMP_CTRL
	select AW_USB_POWER_CTRL
	select AW_POWER_DEBUG
	help
	  This driver provides support for the power supply features of
	  AXP2202 PMIC.

config AW_AXP2202_GPIO_POWER
	tristate "AXP2202 Power Virtual ACIN"
	depends on AW_AXP2202_POWER
	help
	  This driver provides support for ACIN function in
	  AXP2202 PMIC.

config AW_AXP22X_POWER
	tristate "AXP22X Power Supply Driver"
	select AW_POWER_TEMP_CTRL
	select POWER_SUPPLY
	help
	  This driver provides support for the power supply features of
	  AXP221/AXP223 PMIC.

config AW_AXP515_POWER
	tristate "AXP515 Power Supply Driver"
	select AW_POWER_TEMP_CTRL
	select AW_USB_POWER_CTRL
	select AW_POWER_DEBUG
	help
	  This driver provides support for the power supply features of
	  AXP515 PMIC.

config AW_AXP515_ACIN_POWER
	tristate "AXP515 Power Virtual ACIN"
	depends on AW_AXP515_POWER
	select POWER_SUPPLY
	help
	  This driver provides support for ACIN function in
	  AXP515 PMIC.

config AW_AXP2101_POWER
	tristate "AXP2101 Power Supply Driver"
	select AW_POWER_TEMP_CTRL
	select POWER_SUPPLY
	help
	  This driver provides support for the power supply features of
	  AXP2101 PMIC.

config AW_AXP517_POWER
	tristate "AXP517 Power Supply Driver"
	select AW_POWER_TEMP_CTRL
	select AW_USB_POWER_CTRL
	select AW_POWER_DEBUG
	help
	  This driver provides support for the power supply features of
	  AXP517 PMIC.

endif

if AW_MFD_BMU_EXT

config AW_ETA6973_POWER
	tristate "ETA6973 Power Supply Driver"
	select POWER_SUPPLY
	help
	  This driver provides support for the power supply features of
	  ETA6973 PMIC.

config AW_AXP519_POWER
	tristate "AXP519 Power Supply Driver"
	select POWER_SUPPLY
	help
	  This driver provides support for the power supply features of
	  AXP519 PMIC.

config AW_AXP2601_POWER
	tristate "AXP2601 Power Supply Driver"
	select AW_POWER_TEMP_CTRL
	select POWER_SUPPLY
	help
	  This driver provides support for the power supply features of
	  AXP2601 PMIC.

config AW_AXP2602_POWER
	tristate "AXP2602 Power Supply Driver"
	select AW_POWER_TEMP_CTRL
	select POWER_SUPPLY
	help
	  This driver provides support for the power supply features of
	  AXP2602 PMIC.

endif

config AW_MULTI_CHARGE_POWER
	tristate "sunxi multi charge Power Supply Driver"
	depends on AW_AXP517_POWER || AW_AXP515_POWER
	select AW_POWER_DEBUG
	help
	  This driver provides support for sunxi multi charge such as:
	  acin & double type-c.

comment "Power Notifier Drivers"

config AW_POWER_NOTIFIER
	tristate "Allwinner Power Notifier support"
	depends on AW_BSP
	help
	  Allwinner Power Notifier.

	  This option is of interest only to developers who need to
	  develop on AllWinner SoC.

	  If unsure, say N.

comment "Power Temp Ctrl Drivers"

config AW_POWER_TEMP_CTRL
	tristate "Allwinner Power Temp Ctrl support"
	depends on AW_BSP
	help
	  Allwinner Power Temp Ctrl.

	  This option is of interest only to developers who need to
	  develop on AllWinner SoC.

if AW_MFD_AXP2101

config AW_AXP8191_TEMP_CTRL
	tristate "AXP8191 Temp Ctrl Drivers"
	depends on AW_BSP
	help
	  This driver provides support for the temp ctrl features of
	  AXP8191 PMIC.

endif

comment "TYPE-C Ctrl Drivers"

config AW_TYPEC_HUSB311
	tristate "Hynetek HUSB311 Type-C chip driver"
	select I2C
	select TYPEC_TCPM
	select TYPEC_TCPCI
	select USB_SUNXI_TYPEC
	select AW_POWER_NOTIFIER
	help
	  Hynetek HUSB311 Type-C chip driver that works with
	  Type-C Port Controller Manager to provide USB PD and USB
	  Type-C functionalities.

	  If unsure, say N.

config AW_TYPEC_AXP517
	tristate "Allwinner AXP517 Type-C chip driver"
	depends on AW_MFD_AXP2101
	select TYPEC_TCPM
	select USB_SUNXI_TYPEC
	select AW_POWER_NOTIFIER
	help
	  Allwinner AXP517 Type-C chip driver that works with
	  Type-C Port Controller Manager to provide USB PD and USB
	  Type-C functionalities.

	  If unsure, say N.

config AW_TYPEC_CC_LOGIC
	tristate "Allwinner PMIC USB Type-C Port Manager Driver Support"
	depends on AW_MFD_AXP2101
	select AW_POWER_DEBUG
	help
	  Allwinner Type-C Port Manager Driver Based on PMIC.
	  This Driver Can Conform to the Requirements of USB Type-C Functional Test Specification,
	  And Test Platform is Teledyne LeCroy - Voyager M310e.

endmenu
```

## bsp/drivers/power/supply/Kconfig
```kconfig
# SPDX-License-Identifier: GPL-2.0-only
menu "Power Supply Drivers"
	depends on AW_BSP

config AW_AXP803_POWER
	tristate "AXP803 Power Supply Driver"
	depends on AW_MFD_AXP2101
	select POWER_SUPPLY
	help
	  This driver provides support for the power supply features of
	  AXP803 PMIC.

config AW_AXP2202_POWER
	tristate "AXP2202 Power Supply Driver"
	depends on AW_MFD_AXP2101
	select POWER_SUPPLY
	select EXTCON
	help
	  This driver provides support for the power supply features of
	  AXP2202 PMIC.

config AW_AXP2202_GPIO_POWER
	tristate "AXP2202 Power Virtual ACIN"
	depends on AW_MFD_AXP2101
	select POWER_SUPPLY
	help
	  This driver provides support for ACIN function in
	  AXP2202 PMIC.

config AW_AXP22X_POWER
	tristate "AXP221s/AXP223 Power Supply Driver"
	depends on AW_MFD_AXP2101
	select POWER_SUPPLY
	help
	  This driver provides support for the power supply features of
	  AXP221s/AXP223 PMIC.
endmenu
```

## bsp/drivers/pstore/Kconfig
```kconfig
# SPDX-License-Identifier: GPL-2.0-only
menuconfig AW_PSTORE_BLK
	tristate "Log panic/oops to a block device"
	depends on PSTORE
	depends on BLOCK
	select PSTORE_ZONE
	default n
	help
	  This enables panic and oops message to be logged to a block dev
	  where it can be read back at some later point.

	  For more information, see Documentation/admin-guide/pstore-blk.rst

	  If unsure, say N.

if AW_PSTORE_BLK
config AW_PSTORE_BLK_BLKDEV
	string "block device identifier"
	depends on AW_PSTORE_BLK
	default ""
	help
	  Which block device should be used for pstore/blk.

	  It accepts the following variants:
	  1) <hex_major><hex_minor> device number in hexadecimal representation,
	     with no leading 0x, for example b302.
	  2) /dev/<disk_name> represents the device name of disk
	  3) /dev/<disk_name><decimal> represents the device name and number
	     of partition - device number of disk plus the partition number
	  4) /dev/<disk_name>p<decimal> - same as the above, this form is
	     used when disk name of partitioned disk ends with a digit.
	  5) PARTUUID=00112233-4455-6677-8899-AABBCCDDEEFF representing the
	     unique id of a partition if the partition table provides it.
	     The UUID may be either an EFI/GPT UUID, or refer to an MSDOS
	     partition using the format SSSSSSSS-PP, where SSSSSSSS is a zero-
	     filled hex representation of the 32-bit "NT disk signature", and PP
	     is a zero-filled hex representation of the 1-based partition number.
	  6) PARTUUID=<UUID>/PARTNROFF=<int> to select a partition in relation
	     to a partition with a known unique id.
	  7) <major>:<minor> major and minor number of the device separated by
	     a colon.

	  NOTE that, both Kconfig and module parameters can configure
	  pstore/blk, but module parameters have priority over Kconfig.
config AW_PSTORE_BLK_KMSG_SIZE
	int "Size in Kbytes of kmsg dump log to store"
	depends on AW_PSTORE_BLK
	default 64
	help
	  This just sets size of kmsg dump (oops, panic, etc) log for
	  pstore/blk. The size is in KB and must be a multiple of 4.

	  NOTE that, both Kconfig and module parameters can configure
	  pstore/blk, but module parameters have priority over Kconfig.

config AW_PSTORE_BLK_MAX_REASON
	int "Maximum kmsg dump reason to store"
	depends on AW_PSTORE_BLK
	default 2
	help
	  The maximum reason for kmsg dumps to store. The default is
	  2 (KMSG_DUMP_OOPS), see include/linux/kmsg_dump.h's
	  enum kmsg_dump_reason for more details.

	  NOTE that, both Kconfig and module parameters can configure
	  pstore/blk, but module parameters have priority over Kconfig.

config AW_PSTORE_BLK_PMSG_SIZE
	int "Size in Kbytes of pmsg to store"
	depends on AW_PSTORE_BLK
	depends on PSTORE_PMSG
	default 64
	help
	  This just sets size of pmsg (pmsg_size) for pstore/blk. The size is
	  in KB and must be a multiple of 4.

	  NOTE that, both Kconfig and module parameters can configure
	  pstore/blk, but module parameters have priority over Kconfig.

config AW_PSTORE_BLK_CONSOLE_SIZE
	int "Size in Kbytes of console log to store"
	depends on AW_PSTORE_BLK
	depends on PSTORE_CONSOLE
	default 64
	help
	  This just sets size of console log (console_size) to store via
	  pstore/blk. The size is in KB and must be a multiple of 4.

	  NOTE that, both Kconfig and module parameters can configure
	  pstore/blk, but module parameters have priority over Kconfig.

config AW_PSTORE_BLK_FTRACE_SIZE
	int "Size in Kbytes of ftrace log to store"
	depends on AW_PSTORE_BLK
	depends on PSTORE_FTRACE
	default 64
	help
	  This just sets size of ftrace log (ftrace_size) for pstore/blk. The
	  size is in KB and must be a multiple of 4.

	  NOTE that, both Kconfig and module parameters can configure
	  pstore/blk, but module parameters have priority over Kconfig.
endif
```

## bsp/drivers/pwm/Kconfig
```kconfig
# SPDX-License-Identifier: GPL-2.0-only
#
# Touchscreen driver configuration
#
menu "PWM Drivers"
	depends on AW_BSP

config AW_PWM
	tristate "PWM Support for Allwinner SoCs"
	select PWM
	help
	  This enables suppport for Pulse-Width Modulation module on Allwinner SoCs.

config AW_SOFT_PWM
	tristate "Soft-PWM Support for Allwinner SoCs"
	help
	  Soft-PWM is a kind of PWM generated by software. The implementation
	  is based on GPIO and Timers. It's more flexible while providing less accuracy.

endmenu
```

## bsp/drivers/redeposit/Kconfig
```kconfig
# SPDX-License-Identifier: GPL-2.0-only
config SUNXI_REDEPOSIT
	tristate "Sunxi redeposit startup IO data"
	depends on BLOCK
	default n
	help
	  This is an option for use to redeposit startup io data.
```

## bsp/drivers/remoteproc/Kconfig
```kconfig
# SPDX-License-Identifier: GPL-2.0-only
#
# Allwinner remoteproc driver.
#
menu "Remoteproc drivers"
	depends on AW_BSP

config AW_REMOTEPROC
	tristate "Remoteproc Support for Allwinner SoCs"
	depends on AW_BSP
	select REMOTEPROC
	select MAILBOX
	help
	  allwinner

config AW_RPROC_FAST_BOOT
	bool "Allwinner remoteproc fast boot mode support"
	depends on AW_REMOTEPROC
	default n
	help
	  Say y here to support Allwinner remote processor
	  fast boot mode.
	  This mode can speed up init operation.

config AW_RPROC_ENHANCED_TRACE
	bool "Allwinner remoteproc enhanced trace"
	depends on AW_REMOTEPROC
	default y
	help
	  Say y here to support Allwinner remote processor
	  enhanced trace function.

config SUNXI_RPROC_SHARE_IRQ
	bool "SUNXI remote share irq support"
	depends on AW_REMOTEPROC
	default n
	help
	  Say y here to support SUNXI remote share irq driver.

config AW_REMOTEPROC_HIFI4_BOOT
	tristate "Allwinner remoteproc hifi4 boot"
	depends on AW_REMOTEPROC
	help
	  Say y here to support Allwinner SOC processors hifi4 via
	  remote processor framework.

config AW_REMOTEPROC_E906_BOOT
	tristate "Allwinner remoteproc e906 boot"
	depends on AW_REMOTEPROC
	help
	  Say y here to support Allwinner SOC processors e906 via
	  remote processor framework.

config AW_REMOTEPROC_E906_STANDBY
	bool "Allwinner remoteproc e906 standby"
	default n
	depends on AW_REMOTEPROC_E906_BOOT
	help
	  Say y here to support Allwinner SOC processors e906 standby

config AW_REMOTEPROC_E907_BOOT
	tristate "Allwinner remoteproc e907 boot"
	depends on AW_REMOTEPROC
	default n
	help
	  Say y here to support boot Allwinner SOC processors e907 via
	  remote processor framework.
endmenu
```
