## bsp/drivers/rpbuf/Kconfig
```kconfig
# SPDX-License-Identifier: GPL-2.0

menu "Rpbuf drivers"

config AW_RPBUF
	tristate
	help
	  The Rpbuf (Remote Processor Buffer) framework provides mechanisms to
	  allocate buffers and transmit/receive their references to/from remote
	  processor. This allows user to exchange large data with the remote
	  processor.

config AW_RPBUF_DEV
	tristate "Rpbuf device interface"
	select AW_RPBUF
	default n
	help
	  Say y here to export rpbuf buffers as device files, usually found in
	  /dev. They make it possible for user-space programs to use rpbuf
	  buffers.

comment "Service"

config AW_RPBUF_SERVICE_RPMSG
	tristate "Rpmsg-based Rpbuf service driver"
	select AW_RPBUF
	default n
	help
	  Say y here to enable support for the Rpmsg-based Rpbuf service driver.
	  This is one kind of Rpbuf service backend implemented with Rpmsg.

comment "Controller"

config AW_RPBUF_CONTROLLER_SUNXI
	tristate "Allwinner Rpbuf controller driver"
	select AW_RPBUF
	select AW_RPBUF_DEV
	default n
	help
	  Say y here to enable support for the Allwinner Rpbuf controller driver.

comment "Sample"

config AW_RPBUF_SAMPLE_SUNXI
	tristate "Allwinner Rpbuf sample driver"
	select AW_RPBUF
	default n
	help
	  Say y here to enable support for the Allwinner Rpbuf sample driver.
	  This is a sample driver to introduce how to use Rpbuf framework.

endmenu
```

## bsp/drivers/rpmsg/Kconfig
```kconfig
# SPDX-License-Identifier: GPL-2.0-only
#
# Allwinner rpmsg driver.
#
menu "Rpmsg drivers"
	depends on AW_BSP

config AW_RPMSG_CTRL
	tristate "Allwinner rpmsg ctrl driver"
	depends on AW_BSP
	select RPMSG_VIRTIO if !AW_RPMSG_VIRTIO
	default n
	help
	  Say Y here to export rpmsg ctrl device files, usually found in /dev.
	  They make it possible for user-space programs to create rpmsg
	  endpoints device, it can be found in /dev/rpmsg-%rproc-name.

config AW_RPMSG_CLASS
	bool "Allwinner rpmsg class"
	depends on AW_RPMSG_CTRL
	default y if AW_KERNEL_ORIGIN
	default n if AW_KERNEL_AOSP

config AW_RPMSG_NOTIFY
	tristate "Allwinner rpmsg notify driver"
	default n
	select RPMSG_VIRTIO if !AW_RPMSG_VIRTIO
	help
	  Say Y here to enable rpmsg notify driver. It provides notification
	  mechanism base on rpmsg.

config AW_RPMSG_HEARTBEAT
	tristate "Allwinner RPMSG heartbeat driver"
	default n
	select RPMSG_VIRTIO if !AW_RPMSG_VIRTIO
	help
	  Say y here to enable support for the rpmsg heartbeat.

config AW_RPMSG_VIRTIO
	tristate "Allwinner Virtio RPMSG bus driver"
	depends on HAS_DMA
	select RPMSG
	select RPMSG_NS
	select VIRTIO

config AW_RPMSG_PERF_TRACE
	bool "Rpmsg performance trace"
	default n
	depends on AW_RPMSG_VIRTIO
	select AW_AMP_TIMESTAMP
	  help
	  It will take up part of buffer to record timestamp when send and receive.

if AW_RPMSG_PERF_TRACE
config RPMSG_AMP_TS_DEV_ID
	int "AMP timestamp device ID for rpmsg performance trace"
	default 0

config AW_RPMSG_PERF_DATA_AUTO_DUMP
	bool "Dump rpmsg performance data automatically after each transmit"
	default n

endif
endmenu
```

## bsp/drivers/rt-media/Kconfig
```kconfig
menu "rt-media"

config VIDEO_RT_MEDIA
	tristate "sunxi rt-media support"
    select DMA_SHARED_BUFFER
	default n
	help
	  This is the driver for sunxi video decoder, including h264/
	  mpeg4/mpeg2/vc1/rmvb.
	  To compile this driver as a module, choose M here: the
	  module will be called cedar_dev.
config RT_MEDIA_DUAL_SENSOR
	bool "sunxi rt dual sensor"
	depends on (VIDEO_RT_MEDIA)
	default n
	help
	  enable dual sensor Convenient RT_media to distinguish between
	  singel and dual sensor.

config RT_MEDIA_CDC_LOG_LEVEL
	int "set cdc log level, 2:verbose 3:debug 4:info 5:warn 6:err"
	depends on (VIDEO_RT_MEDIA)
	default 3
	help
	  set cdc log level, 2:verbose 3:debug 4:info 5:warn 6:err

config RT_MEDIA_SETUP_RECORDER_IN_KERNEL
	bool "setup recorder in kernel"
	depends on (VIDEO_RT_MEDIA)
	default n
	help
	  y is enable encoder start in kernel poweron state.

endmenu
```

## bsp/drivers/rtc/Kconfig
```kconfig
# SPDX-License-Identifier: GPL-2.0-only

menu "RTC Drivers"
	depends on AW_BSP

config AW_RTC
	tristate "RTC Support for Allwinner SoCs"
	depends on AW_BSP
	select RTC_CLASS
	help
	  If you say Y here, you will get support for the RTC found on
	  Allwinner SoCs.

config AW_RTC_REBOOT_FLAG
	depends on AW_RTC
	bool "Enable RTC General Registers for Reboot Flag"
	help
	  Allow reboot app in userspace (such as Android reboot) to save
	  a flag in the RTC General Purpose Register. The flag could be read
	  by u-boot, kernel or user app after rebooting.

config AW_RTC_POWEROFF_ALARM
	depends on AW_RTC
	bool "Enable RTC Alarm in Power-Off State"
	help
	  Support RTC alarm when the system is Powered-Off.

config AW_TIMER_ALARM
	tristate "Allwinner timer alarm"
	help
	  Use timer1 as an alarm which could wake up CPU from sleeping.
	  The alarm interval can be set via /sys/class/timer_alarm/interval.
	  This is useful on the Socs which does not have an RTC alarm.

config RTC_DRV_SD2059
	tristate "RTC driver for External Chip SD2059"
	depends on AW_I2C
	help
	  If you say yes here you get support for the ZXW Shenzhen whwave SD2059.

	  This driver can also be built as a module. If so, the module
	  will be called rtc-sd2059

config AW_FAKE_POWEROFF
	bool "support fake poweroff"
	depends on AW_RTC && AW_RTC_REBOOT_FLAG
	default n
	help
	  If you say Y here ,the system support entering the fake poweroff state.
	  all operations will eventually be replaced with the "restart" command and enter
	  the poweroff process

config RTC_DRV_JXR160
	tristate "RTC driver for External Chip JXR160"
	depends on AW_I2C
	help
	   If you say yes here you get support for the XJ Beijing juxuan JXR160.

	   This driver can also be built as a module. If so, the module
	   will be called rtc-jxr160

endmenu
```

## bsp/drivers/rtp/Kconfig
```kconfig
# SPDX-License-Identifier: GPL-2.0-only
#
# resistive touch panel driver configuration
#
menu "Resistive Touch Panel Drivers"
	depends on AW_BSP

config AW_RTP
	tristate "Resistive Touch Panel Support for Allwinner SoCs"
	select INPUT_EVDEV
        default n
	help
	  This enables the resistive touch panel controller(TPADC)
	  on Allwinner SoCs.

endmenu
```

## bsp/drivers/secure_storage/Kconfig
```kconfig
# SPDX-License-Identifier: GPL-2.0-only

menu "SECURE STORAGE Drivers"
	depends on AW_BSP

config AW_SECURE_STORAGE
	tristate "secure storage"
	default n
	help
	  say Y here to support secure storage node for used by user

	  To compile this driver as a module, choose M here: the
	  module will be called sunxi_storage.

config AW_SECURE_STORAGE_BY_CHAR_DEVICE
	tristate "secure storage by char device"
	default n
	depends on AW_SECURE_STORAGE
	help
	  say Y here to support secure storage write/read by char device
endmenu
```

## bsp/drivers/sid/Kconfig
```kconfig
# SPDX-License-Identifier: GPL-2.0-only

menu "SID Drivers"
	depends on AW_BSP

config AW_SID
	tristate "Allwinner SID Support"
	default n
	help
	 Say Y here to enable the sunxi SID support.

config AW_SET_EFUSE_POWER
	tristate "Allwinner Set Efuse Power"
	default n
	help
	 Say Y here to enable efuse power before burn efuse.

endmenu
```

## bsp/drivers/smartcard/Kconfig
```kconfig
# SPDX-License-Identifier: GPL-2.0-only
#
# Smart Card Reader(SCR) drivers configuration
#
menu "Smart Card Reader Drivers"
	depends on AW_BSP

config AW_SCR
	tristate "SCR Support for Allwinner SoCs"
	default n
	help
	  Say Y here to enable the Smart Card Reader driver

endmenu
```

## bsp/drivers/smc/Kconfig
```kconfig
# SPDX-License-Identifier: GPL-2.0-only

menu "SMC Drivers"
	depends on AW_BSP
config AW_SYS_INFO
	tristate "Allwinner System Info Driver"
	default n
	help
	  This driver is used for query system information.
	  If you don't know whether need it, please select y.

config AW_SMC
	tristate "Allwinner SMC Interfaces"
	default n
	help
	  This driver support smc call interfaces depended on
	  monitor/aft/SecureOs. If you don't know whether need
	  it, please select y.
endmenu
```

## bsp/drivers/sound/misc/Kconfig
```kconfig
# SPDX-License-Identifier: GPL-2.0-or-later
#
# Allwinner audio misc driver Kconfig
#
# Copyright(c) 2022-2027 Allwinnertech Co., Ltd.

# menu select
menu "Misc drivers"

# TEST CLK
config SND_SOC_SUNXI_TEST_CLK
	tristate "Allwinner test CLK support"
	help
	  Select Y or M to support test clk.

# LOOPBACK
config SND_SOC_SUNXI_LOOPBACK
	tristate "Allwinner loopback support"
	help
	  Select Y or M to support loopback.

endmenu
```
