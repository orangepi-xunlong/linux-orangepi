## bsp/drivers/net/wireless/xr819/Kconfig
```kconfig
config XR819_WLAN
	tristate "XR819/XR819S WLAN support"
	default n
	depends on CFG80211
	depends on CRYPTO
	help
	  To compile this code as a module, choose M here.
```

## bsp/drivers/net/wireless/xr829/Kconfig
```kconfig
config XR829_WLAN
	tristate "XR829 WLAN support"
	default n
	depends on CFG80211
	depends on CRYPTO
	help
	  To compile this code as a module, choose M here.
config XR829_SUSPEND_POWER_OFF
	bool "XR829 SUSPEND POWER OFF"
	depends on XR829_WLAN
	default n
	help
	  if susspend power off, choose y here.
```

## bsp/drivers/npu/Kconfig
```kconfig
# SPDX-License-Identifier: GPL-2.0

menu "NPU Drivers"

source "bsp/drivers/npu/aw_nna_vip/Kconfig"
source "bsp/drivers/npu/aw_nna_galcore/Kconfig"

endmenu
```

## bsp/drivers/npu/aw_nna_galcore/Kconfig
```kconfig
# SPDX-License-Identifier: GPL-2.0

config AW_NNA_GALCORE
	depends on (ARCH_SUNXI)
	select SYNC_FILE
	tristate "aw nna galcore driver"
	default n
	help
	 Choose Y to enable aw nna galcore driver
```

## bsp/drivers/nvmem/Kconfig
```kconfig
# SPDX-License-Identifier: GPL-2.0-only
menu "NVMEM Drivers"
	depends on AW_BSP

config NVMEM_AW_SID
	tristate "SID Support for Allwinner SoCs"
	depends on AW_BSP
	select NVMEM
	help
	  This is a driver for the 'security ID' available on various Allwinner
	  devices.

	  This driver can also be built as a module. If so, the module
	  will be called nvmem_sunxi_sid.

endmenu
```

## bsp/drivers/pcie/Kconfig
```kconfig
# SPDX-License-Identifier: GPL-2.0-only

menu "PCIe Drivers"
	depends on AW_BSP

choice
	prompt "Allwinner PCIe controller"
	default  AW_PCIE_NONE

config AW_PCIE_RC
	tristate "RC controller - Host mode"
	select PCI
	depends on AW_BSP
	help
	  Enables support for the PCIe RC controller in the Allwinner SoC.

config AW_PCIE_EP
	tristate "EP controller - Endpoint mode"
	select PCI_ENDPOINT
	depends on AW_BSP
	help
	  Enables support for the PCIe EP controller in the Allwinner SoC.

config AW_PCIE_NONE
	tristate "None"
	depends on AW_BSP
	help
	  Disable support for the PCIe controller in the Allwinner SoC.

endchoice

endmenu
```

## bsp/drivers/phy/Kconfig
```kconfig
# SPDX-License-Identifier: GPL-2.0-only
#
# Phy drivers for SUNXI platforms
#
menu "PHY Drivers"
	depends on AW_BSP

config AW_INNO_COMBOPHY
	tristate "Allwinner INNO COMBO PHY Driver"
	depends on AW_BSP && OF
	select GENERIC_PHY
	help
	  Enable this to support the Allwinner PCIe/USB3.0 combo PHY
	  with INNOSILICON IP block.

config AW_CADENCE_COMBOPHY
	tristate "Allwinner CADENCE COMBO PHY Driver"
	depends on AW_BSP && OF
	select GENERIC_PHY
	select EXTCON
	help
	  Enable this to support the Allwinner PCIe/USB3.0/DisplayPort combo PHY
	  with CADENCE IP block.

config AW_SYNOPSYS_COMBOPHY
	tristate "Allwinner SYNOPSYS COMBO PHY Driver"
	depends on AW_BSP && OF
	select GENERIC_PHY
	help
	  Enable this to support the Allwinner PCIe/USB3.0 combo PHY
	  with SYNOPSYS IP block.

endmenu
```

## bsp/drivers/pinctrl/Kconfig
```kconfig
# SPDX-License-Identifier: GPL-2.0-only
menu "Pinctrl Drivers"
	depends on AW_BSP

config AW_PINCTRL
	tristate "Pinctrl Support for Allwinner SoCs"
	depends on AW_BSP
	select PINMUX
	select GENERIC_PINCONF
	select IRQ_DOMAIN_HIERARCHY
	select GPIOLIB
	default y

config AW_PINCTRL_DEBUGFS
	tristate "Pinctrl Debugfs Driver"
	depends on AW_PINCTRL && DEBUG_FS
	default n

config AW_PINCTRL_SUN8IW11
	tristate "SUN8IW11 PIO"
	depends on AW_PINCTRL
	default ARCH_SUN8IW11

config AW_PINCTRL_SUN8IW18
	tristate "SUN8IW18 PIO"
	depends on AW_PINCTRL
	default ARCH_SUN8IW18

config AW_PINCTRL_SUN8IW15P1
	tristate "SUN8IW15P1 PIO"
	depends on AW_PINCTRL
	default ARCH_SUN8IW15

config AW_PINCTRL_SUN8IW15P1_R
	tristate "SUN8IW15P1 R_PIO"
	depends on AW_PINCTRL
	default ARCH_SUN8IW15

config AW_PINCTRL_SUN8IW20
	tristate "SUN8IW20 PIO"
	depends on AW_PINCTRL
	default ARCH_SUN8IW20 || ARCH_SUN20IW1

config AW_PINCTRL_SUN8IW21
	tristate "SUN8IW21 PIO"
	depends on AW_PINCTRL
	default ARCH_SUN8IW21

config AW_PINCTRL_SUN50IW9
	tristate "SUN50IW9 PIO"
	depends on AW_PINCTRL
	default ARCH_SUN50IW9

config AW_PINCTRL_SUN50IW9_R
	tristate "SUN50IW9 R_PIO"
	depends on AW_PINCTRL
	default ARCH_SUN50IW9

config AW_PINCTRL_SUN50IW10P1
	tristate "SUN50IW10P1 PIO"
	depends on AW_PINCTRL
	default ARCH_SUN50IW10

config AW_PINCTRL_SUN50IW10P1_R
	tristate "SUN50IW10P1 R_PIO"
	depends on AW_PINCTRL
	default ARCH_SUN50IW10

config AW_PINCTRL_SUN50IW12
	tristate "SUN50IW12 PIO"
	depends on AW_PINCTRL
	default ARCH_SUN50IW12

config AW_PINCTRL_SUN50IW12_R
	tristate "SUN50IW12 R_PIO"
	depends on AW_PINCTRL
	default ARCH_SUN50IW12

config AW_PINCTRL_SUN55IW3
	tristate "SUN55IW3 PIO"
	depends on AW_PINCTRL
	default ARCH_SUN55IW3

config AW_PINCTRL_SUN55IW3_R
	tristate "SUN55IW3 R_PIO"
	depends on AW_PINCTRL
	default ARCH_SUN55IW3

config AW_PINCTRL_SUN55IW5
	tristate "SUN55IW5 PIO"
	depends on AW_PINCTRL
	default ARCH_SUN55IW5

config AW_PINCTRL_SUN55IW6
	tristate "SUN55IW6 PIO"
	depends on AW_PINCTRL
	default ARCH_SUN55IW6

config AW_PINCTRL_SUN60IW1
	tristate "SUN60IW1 PIO"
	depends on AW_PINCTRL
	default ARCH_SUN60IW1

config AW_PINCTRL_SUN60IW2
	tristate "SUN60IW2 PIO"
	depends on AW_PINCTRL
	default ARCH_SUN60IW2

config AW_PINCTRL_SUN60IW2_R
	tristate "SUN60IW2 R_PIO"
	depends on AW_PINCTRL
	default ARCH_SUN60IW2

config AW_PINCTRL_SUN20IW5
	tristate "SUN20IW5 PIO"
	depends on AW_PINCTRL
	default ARCH_SUN20IW5

config AW_PINCTRL_SUN65IW1
	tristate "SUN65IW1 PIO"
	depends on AW_PINCTRL
	default ARCH_SUN65IW1

config AW_PINCTRL_AXP22X
	tristate "X-Powers AXP221s/223 PMIC pinctrl and GPIO Support"
	depends on AW_PINCTRL
	depends on AW_MFD_AXP2101
	help
	  AXP PMICs provides multiple GPIOs that can be muxed for different
	  functions. This driver bundles a pinctrl driver to select the function
	  muxing and a GPIO driver to handle the GPIO when the GPIO function is
	  selected.
	  Say yes to enable pinctrl and GPIO support for the AXP221s/223 PMIC

config AW_PINCTRL_LEDS
        tristate "Support GPIO leds for sunxi socs"
	help
	  This enables support for GPIO LEDs on Allwinner SoCs.

config AW_PINCTRL_DYNAMIC_DEBUG
	bool "Enable pinctrl dynamic debug"
	depends on AW_PINCTRL
	default y
	help
	  Enable pinctrl dynamic debug

endmenu
```

## bsp/drivers/pm_domain/Kconfig
```kconfig
# SPDX-License-Identifier: GPL-2.0-only
#
# Allwinner sunXi SoC drivers
#
menu "Power Domain Drivers"
	depends on AW_BSP

config AW_GPU_PM_DOMAINS
	tristate "Allwinner GPU Power Domain"
	depends on PM
	select PM_GENERIC_DOMAINS
	select PM_GENERIC_DOMAINS_OF
	help
	 Say y here to enable power domain support.
	 In order to meet high performance and low power requirements, a power
	 management unit is designed or saving power when gpu in low power
	 mode. The PPU is dedicated for managing the power of the GPU.

	 If unsure, say N.

config AW_PM_DOMAINS
	tristate "Allwinner power domain"
	depends on PM
	select PM_GENERIC_DOMAINS
	select PM_GENERIC_DOMAINS_OF
	select MFD_SYSCON
	help
	 Say y here to enable power domain support.
	 In order to meet high performance and low power requirements, a power
	 management unit is designed or saving power when domain in low power
	 mode. The PPU is dedicated for managing the power of the domain.

	 If unsure, say N.

config AW_PCK600_DOMAINS
	tristate "Allwinner pck-600 domain"
	depends on PM
	select PM_GENERIC_DOMAINS
	select PM_GENERIC_DOMAINS_OF
	select MFD_SYSCON
	help
	 Say y here to enable pck-600 power domain support.
	 In order to meet high performance and low power requirements, a power
	 management unit is designed or saving power when domain in low power
	 mode. The pck-600 is dedicated for managing the power of the domain.

	 If unsure, say N.

config AW_POWER_DOMAIN_TEST
	tristate "Allwinner power domain test"
	depends on PM
	help
	 Say y here to enable power domain test driver.

endmenu
```
