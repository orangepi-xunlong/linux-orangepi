## security/fivm/Kconfig
```kconfig
config FILE_INTEGRITY
	tristate "File Integrity Check"
	depends on SECURITYFS
	default n
	help
	  This selects off-line file integrity module , which help to verify
	  the system file integrity on run-time
```

## security/te_driver/Kconfig
```kconfig
config TRUSTED_LITTLE_KERNEL
	tristate "Enable Open Trusted Execution driver"
	default n
	help
	  This option adds kernel support for communication with the
	  Trusted secure OS monitor/runtime support.
	  If you are unsure how to answer this question, answer N.


config TRUSTED_LITTLE_KERNEL_DEBUG
	tristate "Support TRUSTED LITTLE KERNEL DEBUG"
	depends on TRUSTED_LITTLE_KERNEL
	default n
```

## security/te_sec_storage/Kconfig
```kconfig
#
# sunxi secure storage for sensitive data
#
#
config TE_SST
	tristate "sunxi platform secure storage"
	depends on TRUSTED_LITTLE_KERNEL
	default n
	help
	  This module applies the way to store sentive data
	  by sunxi platform secure storage policy
```

## security/te_test/Kconfig
```kconfig
config TE_TEST
	tristate "sunxi tee test driver"
	depends on TRUSTED_LITTLE_KERNEL
	default n
	help
	  This option adds kernel support for test TEE.
	  If you are unsure how to answer this question, answer N.
```

## sound/soc/cix/Kconfig
```kconfig
# SPDX-License-Identifier: GPL-2.0-only
menu "ASoC support for Cixtech"

comment "ASoC options for Cixtech CPUs:"

config SND_SOC_CIX
	tristate "CIX ASoC"
	imply SND_SOC_RT5682S
	default n
	help
	  Select Y or M to add support for CIX sound card


config SND_SOC_CDNS_I2S_SC
	tristate "Cadence I2S-SC Controller Driver"
	select SND_SOC_GENERIC_DMAENGINE_PCM
	help
	  Say Y or M if you want to add driver support for Cadence
	  I2S-SC (SingleChannel) controller.

config SND_SOC_CDNS_I2S_MC
	tristate "Cadence I2S-MC Controller Driver"
	select SND_SOC_GENERIC_DMAENGINE_PCM
	help
	  Say Y or M if you want to add driver support for Cadence
	  I2S-MC (MultiChannel) controller.
endmenu
```

## sound/soc/sof/cix/Kconfig
```kconfig
# SPDX-License-Identifier: (GPL-2.0-only OR BSD-3-Clause)

config SND_SOC_SOF_CIX_TOPLEVEL
	bool "SOF support for CIX audio DSPs"
	depends on ARM64 || SOC_CIX
	depends on SND_SOC_SOF_OF
	help
	  This adds support for Sound Open Firmware for CIX platforms.
	  Say Y if you have such a device.
	  If unsure select "N".

if SND_SOC_SOF_CIX_TOPLEVEL

config SND_SOC_SOF_CIX_COMMON
	tristate
	select SND_SOC_SOF_OF_DEV
	select SND_SOC_SOF
	select SND_SOC_SOF_IPC3
	select SND_SOC_SOF_XTENSA
	select SND_SOC_SOF_COMPRESS
	help
	  This option is not user-selectable but automagically handled by
	  'select' statements at a higher level.

config SND_SOC_SOF_CIX_SKY1
	tristate "SOF support for CIX SKY1"
	depends on CIX_DSP
	select SND_SOC_SOF_CIX_COMMON
	help
	  This adds support for Sound Open Firmware for CIX SKY1 platforms.
	  Say Y if you have such a device.
	  If unsure select "N".

endif ## SND_SOC_SOF_CIX_TOPLEVEL
```

## sound/soc/sunxi/Kconfig
```kconfig
# SPDX-License-Identifier: GPL-2.0-only
# Embedded Codec and Affiliated

# SUNXI Platform DMA
config SND_SUNXI_SOC
	depends on ARCH_SUNXI
	tristate

# Dummy CPU DAI module
config SND_SUNXI_SOC_CPUDAI
	depends on ARCH_SUNXI
	tristate

# SUNXI Codec Embedded
config SND_SUN50IW10_CODEC
	tristate

menu "Allwinner SoC Audio support"
	depends on ARCH_SUNXI || COMPILE_TEST

config SND_SUN4I_CODEC
	tristate "Allwinner A10 Codec Support"
	depends on ARCH_SUN4IW1
	select SND_SOC_GENERIC_DMAENGINE_PCM
	select REGMAP_MMIO
	help
	  Select Y or M to add support for the Codec embedded in the Allwinner
	  A10 and affiliated SoCs.

config SND_SUN8I_CODEC
	tristate "Allwinner SUN8I audio codec"
	depends on OF
	depends on ARCH_SUN8IW1
	depends on MACH_SUN8I || (ARM64 && ARCH_SUNXI) || COMPILE_TEST
	select REGMAP_MMIO
	help
	  This option enables the digital part of the internal audio codec for
	  Allwinner sun8i SoC (and particularly A33).

	  Say Y or M if you want to add sun8i digital audio codec support.

config SND_SUN8I_CODEC_ANALOG
	tristate "Allwinner sun8i Codec Analog Controls Support"
	depends on MACH_SUN8I || (ARM64 && ARCH_SUNXI) || COMPILE_TEST
	depends on ARCH_SUN8IW1
	select SND_SUN8I_ADDA_PR_REGMAP
	help
	  Say Y or M if you want to add support for the analog controls for
	  the codec embedded in newer Allwinner SoCs.

config SND_SUN50I_CODEC_ANALOG
	tristate "Allwinner sun50i Codec Analog Controls Support"
	depends on (ARM64 && ARCH_SUNXI) || COMPILE_TEST
	depends on ARCH_SUN50IW1
	select SND_SUN8I_ADDA_PR_REGMAP
	help
	  Say Y or M if you want to add support for the analog controls for
	  the codec embedded in Allwinner A64 SoC.

config SND_SUN4I_I2S
	tristate "Allwinner A10 I2S Support"
	depends on ARCH_SUN4IW1
	select SND_SOC_GENERIC_DMAENGINE_PCM
	select REGMAP_MMIO
	help
	  Say Y or M if you want to add support for codecs attached to
	  the Allwinner A10 I2S. You will also need to select the
	  individual machine drivers to support below.

config SND_SUN4I_SPDIF
	tristate "Allwinner A10 SPDIF Support"
	depends on OF
	depends on ARCH_SUN4IW1
	select SND_SOC_GENERIC_DMAENGINE_PCM
	select REGMAP_MMIO
	help
	  Say Y or M to add support for the S/PDIF audio block in the Allwinner
	  A10 and affiliated SoCs.

config SND_SUN8I_ADDA_PR_REGMAP
	tristate
	depends on ARCH_SUN8IW1
	select REGMAP

# SUNXI CODEC Machine Select
config SND_SUNXI_SOC_SUN50IW10_CODEC
	tristate "Allwinner Sun50iw10 Codec Support"
	select SND_SUNXI_SOC
	select SND_SOC_GENERIC_DMAENGINE_PCM
	select REGMAP_MMIO
	select SND_SUN50IW10_CODEC
	select SND_SUNXI_SOC_CPUDAI
	depends on ARCH_SUN50IW10
   help
	Select Y or M to add support for the Codec embedded in the Allwinner
	SUN50IW10 and affiliated SoCs.

#SUNXI MACHINE Select
config SND_SUNXI_SOC_SIMPLE_CARD
	tristate "Allwinner Audio Simple Card"
	depends on OF
	select SND_SIMPLE_CARD_UTILS
	help
	  Select Y to enable debug information of allwinner audio driver
	  If you not sure, Just not select it.

# SUNXI DAUDIO Select
config SND_SUNXI_SOC_DAUDIO
	tristate "Allwinner Digital Audio Support"
	select SND_SUNXI_SOC
	select SND_SOC_GENERIC_DMAENGINE_PCM
	select REGMAP_MMIO
	depends on OF
	depends on SND_SUNXI_SOC_SIMPLE_CARD
   help
	Select Y or M to add support for I2S/PCM/TDM Module in the
	Allwinner SoCs.

# SUNXI DAUDIO ASRC Select
config SND_SUNXI_SOC_DAUDIO_ASRC
	tristate "Allwinner Digital Audio ASRC Support"
	depends on SND_SUNXI_SOC_DAUDIO
   help
	Select Y or M to add support for the ASRC Func of the
	I2S/PCM/TDM Module in the Allwinner SoCs.

# SUNXI HDMIAUDIO Select
config SND_SUNXI_SOC_SUNXI_HDMIAUDIO
	tristate "Allwinner HDMI Audio Support"
	depends on SND_SUNXI_SOC_DAUDIO
    help
	Select Y or M to add support for the HDMI Audio Module in the Allwinner
	SoCs.

# SUNXI SPDIF Select
config SND_SUNXI_SOC_SPDIF
	tristate "Allwinner SPDIF Support"
	select SND_SUNXI_SOC
	select SND_SOC_GENERIC_DMAENGINE_PCM
	select REGMAP_MMIO
	depends on OF
	depends on SND_SUNXI_SOC_SIMPLE_CARD
    help
	Select Y or M to add support SPDIF Module in Allwinner
	SoCs.

# SUNXI SPDIF RX Select
config SND_SUNXI_SOC_SPDIF_RX_IEC61937
	tristate "Allwinner SPDIF RX IEC61937 Support"
	depends on SND_SUNXI_SOC_SPDIF
    help
	Select Y or M to add support SPDIF RX IEC-61937 in Allwinner
	SoCs.

# SUNXI DMIC Select
config SND_SUNXI_SOC_DMIC
	tristate "Allwinner DMIC Support"
	select SND_SUNXI_SOC
	select SND_SOC_GENERIC_DMAENGINE_PCM
	select REGMAP_MMIO
	select SND_SOC_DMIC
	depends on OF
	depends on SND_SUNXI_SOC_SIMPLE_CARD
    help
	Select Y or M to add support DMIC Module in Allwinner
	SoCs.

config SUNXI_AUDIO_DEBUG
	bool "Allwinner Audio Debug Support"
	depends on SND_SUNXI_SOC
	help
	  Select Y to enable debug information of allwinner audio driver
	  If you not sure, Just not select it.

endmenu
```

## sound/soc/sunxi/audiocodec/Kconfig
```kconfig
config SND_SUNXI_SOC_AUDIOCODEC
	tristate "Audiocodec for the SUNXI chips"
	depends on  ARCH_SUN8IW1 || ARCH_SUN8IW3 || ARCH_SUN8IW5 || ARCH_SUN8IW7 || ARCH_SUN8IW8 || ARCH_SUN8IW9
	select SND_SOC_DMAENGINE_PCM
	default n
	help
	  Say Y or M if you want to add support for audiocodec

config SND_SUNXI_SOC_SUN8IW9_MACHINE
	tristate "Audiocodec Machine for sun8iw9 chips"
	depends on ARCH_SUN8IW9
	default n
	help
	  Say Y or M if you want to add sun8iw9 audiocodec support
config SND_SUNXI_SOC_PUBLUC_MACHINE
	tristate "Audiocodec Machine for codec chips"
	depends on  ARCH_SUN8IW1 || ARCH_SUN8IW3 || ARCH_SUN8IW5 || ARCH_SUN8IW7 || ARCH_SUN8IW8
	default n
	help
	  Say Y or M if you want to add audiocodec machine support
config SND_SUN8IW1_SNDCODEC
	tristate "Audiocodec for the SUN8IW1 chips"
	depends on ARCH_SUN8IW1
	default n
	help
	  Say Y or M if you want to add sun8iw1 audiocodec support
config SND_SUN8IW3_SNDCODEC
	tristate "Audiocodec for the SUN8IW3 chips"
	depends on ARCH_SUN8IW3
	default n
config SND_SUN8IW5_SNDCODEC
       tristate "Audiocodec for the SUN8IW5 chips"
       depends on ARCH_SUN8IW5
       default n
       help
         Say Y or M if you want to add sun8iwX audiocodec support
config SND_SUN8IW7_SNDCODEC
       tristate "Audiocodec for the SUN8IW7 chips"
       depends on ARCH_SUN8IW7
       default n
       help
         Say Y or M if you want to add sun8iw7 audiocodec support
config SND_SUN8IW8_SNDCODEC
       tristate "Audiocodec for the SUN8IW8 chips"
       depends on ARCH_SUN8IW8
       default n
       help
         Say Y or M if you want to add sun8iw8 audiocodec support
config SND_SUN8IW9_SNDCODEC
       tristate "Audiocodec for the SUN8IW9 chips"
       depends on ARCH_SUN8IW9
       default n
       help
         Say Y or M if you want to add sun8iw9 audiocodec support

config SND_SUNXI_SWITCH
       tristate "headset for the SUN8IWx chips"
       depends on ARCH_SUN8IW5 || ARCH_SUN8IW8
       default n
	help
         Say Y or M if you want to add sun8iwX headset support
```

## sound/soc/sunxi/audiohub/Kconfig
```kconfig
config SND_SUNXI_SOC_AUDIOHUB_INTERFACE
	tristate "SoC audiohub interface for the allwinnertech SUNXI chips"
	depends on  ARCH_SUN8IW6 || ARCH_SUN8IW7
	select SND_SOC_DMAENGINE_PCM
	default n
	help
	  Say Y or M if you want to add support for codecs attached to
	  the SUNXI AUDIOHUB interface. You will also need
	  to select the audio interfaces to support below.
config SND_SUN8IW6_AUDIOHUB
	tristate "AUDIOHUB for the SUN8IW6 chips"
	depends on ARCH_SUN8IW6
	default n
	help
	  Say Y or M if you want to add sun8iw6 audiohub support
config SND_SUN8IW7_AUDIOHUB
	tristate "AUDIOHUB for the SUN8IW7 chips"
	depends on ARCH_SUN8IW7
	default n
	help
	  Say Y or M if you want to add sun8iw7 audiohub support
```

## sound/soc/sunxi/daudio0/Kconfig
```kconfig
config SND_SUNXI_SOC_DAUDIO0_INTERFACE
	tristate "SoC daudio0 tdm interface for SUNXI chips"
	depends on ARCH_SUN9IW1 || ARCH_SUN8IW6|| ARCH_SUN8IW7 || ARCH_SUN8IW8
	select SND_SOC_DMAENGINE_PCM
	default n
	help
	  Say Y or M if you want to add support for codecs attached to
	  the SUNXI DAUDIO TDM interface. You will also need
	  to select the audio interfaces to support below.

config SND_SUNXI_SOC_DAUDIO0_PUBLIC_MACHINE
	tristate "Daudio0 Public Machine for SUNXI chips"
	depends on ARCH_SUN9IW1 || ARCH_SUN8IW8 || (ARCH_SUN8IW7  && SND_SOC_RT3261 = n && MFD_ACX00 = n)
	default n
	help
	  Say Y or M if you want to add audiocodec support

config SND_SUNXI_SOC_DAUDIO0_KARAOKE_MACHINE
	tristate "Daudio0 KARAOKE Machine for SUN8IW7 chips"
	depends on (ARCH_SUN8IW7) && SND_SOC_RT3261 = n && MFD_ACX00 = y
	default n
	help
	  Say Y or M if you want to add audiocodec support
	 
config SND_SUNXI_SOC_SUN8IW6_ACX00
	tristate "Machine for A83 ACX00"
	depends on ARCH_SUN8IW6 && MFD_ACX00 && SND_SOC_ACX00DAPM_CODEC
	default n
	help
	  Say Y or M if you want to add sun8iw6 codec support

config SND_SUNXI_SOC_SUN8IW7_RT3261
	tristate "Machine for h3 rt3261"
	depends on ARCH_SUN8IW7 && SND_SOC_RT3261
	default n
	help
	  Say Y or M if you want to add rt3261 codec support

config SND_VIRBB_DAI
	tristate "virtual bb interface"
	depends on (ARCH_SUN8IW6||ARCH_SUN8IW7)&& MFD_ACX00=y
	default n
	help
	  Say Y or M if you want to add sun8iw1 audiocodec support
```

## sound/soc/sunxi/daudio1/Kconfig
```kconfig
config SND_SUNXI_SOC_DAUDIO1_INTERFACE
	tristate "SoC daudio1 tdm interface for SUNXI chips"
	depends on ARCH_SUN8IW7
	select SND_SOC_DMAENGINE_PCM
	default n
	help
	  Say Y or M if you want to add support for codecs attached to
	  the SUNXI DAUDIO TDM interface. You will also need
	  to select the audio interfaces to support below.
config SND_SUNXI_SOC_DAUDIO1_PUBLIC_MACHINE
	tristate "Daudio1 Public Machine for SUNXI chips"
	depends on ARCH_SUN8IW7 && SND_SOC_RT3261 = n && MFD_ACX00 = n
	default n
	help
	  Say Y or M if you want to add audiocodec support
config SND_SUNXI_SOC_SUN8IW7_RT3261_AIF2
	tristate "Machine for h3 rt3261 aif2"
	depends on ARCH_SUN8IW7 && SND_SOC_RT3261
	default n
	help
	  Say Y or M if you want to add rt3261 codec support
```

## sound/soc/sunxi/hdmiaudio/Kconfig
```kconfig
config SND_SUNXI_SOC_HDMIAUDIO
	tristate "HDMI Audio for SUNXI chips"
	depends on ARCH_SUN8IW1 || ARCH_SUN8IW6 || ARCH_SUN8IW7 || ARCH_SUN9IW1
	select SND_SOC_DMAENGINE_PCM
	default n
	help
	  Say Y or M if you want to add support for hdmi audio
config SND_SUN9I_8IW6_HDMIPCM
	tristate "HDMIPCM for the SUN9I SUN8IW6 chips"
	depends on ARCH_SUN9I || ARCH_SUN8IW6
	default n
	help
	  Say Y or M if you want to add sun9i hdmipcm support
config SND_SUN8IW7_HDMIPCM
	tristate "HDMIPCM for the SUN8IW7 chips"
	depends on ARCH_SUN8IW7
	default n
	help
	  Say Y or M if you want to add sun8iw7 hdmipcm support
```

## sound/soc/sunxi/i2s0/Kconfig
```kconfig
config SND_SUNXI_SOC_I2S0_INTERFACE
	tristate "SoC i2s0 interface for SUNXI chips"
	depends on ARCH_SUN8IW3 || ARCH_SUN8IW5 || ARCH_SUN8IW1
	select SND_SOC_DMAENGINE_PCM
	default n
	help
	  Say Y or M if you want to add support for codecs attached to
	  the SUNXI AC97, I2S or PCM interface. You will also need
	  to select the audio interfaces to support below.
```

## sound/soc/sunxi/spdif/Kconfig
```kconfig
config SND_SUNXI_SOC_SPDIF
	tristate "sunxi On-Chip spdif"
	depends on ARCH_SUN8IW1 ||ARCH_SUN8IW6 || ARCH_SUN8IW7 || ARCH_SUN9IW1
	select SND_SOC_DMAENGINE_PCM
	default n
```
