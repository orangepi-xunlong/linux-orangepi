/dts-v1/;
/plugin/;
/ {
	fragment@0 {
		target = <&spi0>;
		__overlay__ {
			status = "okay";
			spi_dev0: spi@0 {
				compatible = "rohm,dh2228fv";
				pl022,com-mode = <1>;
				spi-max-frequency = <10000000>;
				reg = <0>;
				status = "okay";
			};
		};
	};
};

 
