/dts-v1/;
/plugin/;

/ {
	fragment@0 {
		target = <&dpu_online2_dsi>;

		__overlay__ {
			status = "okay";
		};
	};

	fragment@1 {
		target = <&dsi2>;

		__overlay__ {
			status = "okay";
		};
	};

	fragment@2 {
		target = <&touchscreen>;

		__overlay__ {
			status = "okay";
		};
	};
};
