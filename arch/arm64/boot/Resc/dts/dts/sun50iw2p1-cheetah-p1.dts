/*
 * Allwinner Technology CO., Ltd. sun50iw2p1 pro1 board.
 *
 * pro1 board support.
 */

/dts-v1/;

#include "sun50iw2p1.dtsi"

/{

	soc@01c00000 {
		twi0: twi@0x01c2ac00{
			status = "okay";
		};

                twi1: twi@0x01c2b000{
                        status = "okay";
               };
	};

};
