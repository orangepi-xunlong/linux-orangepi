/dts-v1/;
/plugin/;

/ {
	fragment@0 {
		target = <&mipi_panel0>;

		__overlay__ {
			status = "okay";
		};
	};

	fragment@1 {
		target = <&mipi_dsi0>;

		__overlay__ {
			status = "okay";
		};
	};

	fragment@2 {
		target = <&gt9xx_0>;

		__overlay__ {
			status = "okay";
		};
	};
};
