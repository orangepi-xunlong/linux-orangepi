/*
 * Copyright (c) 2024, Cix Technology Group Co., Ltd. All rights reserved.
 *
 * SPDX-License-Identifier: BSD-3-Clause
 */

/dts-v1/;

#include "sky1-evb.dts"

&usbss_4 {
	status = "okay";
	dr_mode = "otg";
	usb-role-switch;
};

&usbss_5 {
	status = "okay";
	dr_mode = "otg";
	usb-role-switch;
};
