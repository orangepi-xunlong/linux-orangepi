/dts-v1/;
/plugin/;

#include <dt-bindings/interrupt-controller/irq.h>
#include <dt-bindings/gpio/gpio.h>
#include <dt-bindings/gpio/meson-g12a-gpio.h>

/ {
	fragment@0 {
		target = <&sd_emmc_c>;
		__overlay__ {
			status = "disabled";
		};
	};

	fragment@1 {
		target = <&spifc>;
		__overlay__ {
			status = "okay";
		};
	};
};
