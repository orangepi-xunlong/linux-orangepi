// SPDX-License-Identifier: (GPL-2.0+ OR MIT)

/dts-v1/;

#include "meson-g12b-odroid-n2-plus.dts"

/ {
	model = "Hardkernel ODROID-N2Plus with SPI";
};

#include "meson-g12b-odroid-n2-enable-spi.dtsi"
