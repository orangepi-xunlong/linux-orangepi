/dts-v1/;
/plugin/;

/ {
	fragment@0 {
		target-path = "/aliases";
		__overlay__ {
			i2c3 = "/soc/i2c@5002c00";
		};
	};

	fragment@1 {
		target = <&i2c3>;
		__overlay__ {
			status = "okay";
		};
	};
};
