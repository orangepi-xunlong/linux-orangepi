/dts-v1/;
/plugin/;

/ {
	fragment@0 {
		target-path = "/aliases";
		__overlay__ {
			spi1 = "/soc/spi@5011000";
		};
	};

	fragment@1 {
		target = <&spi1>;
		__overlay__ {
			status = "okay";
			#address-cells = <1>;
			#size-cells = <0>;

                        pinctrl-names = "default";
                        pinctrl-0 = <&spi1_pins>, <&spi1_cs1_pin>;
			spidev@1 {
				compatible = "rohm,dh2228fv";
				status = "okay";
				reg = <1>;
				spi-max-frequency = <1000000>;
			};
		};
	};
};
