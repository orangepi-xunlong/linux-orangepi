// Enable the spidev interface
/dts-v1/;
/plugin/;

/ {

	fragment@0 {
		target-path = "/aliases";
		__overlay__ {
			/* Path to the SPI controller nodes */
			spi1 = "/soc/spi@5011000";
		};
	};

	fragment@1 {
		target = <&spi1>;
		__overlay__ {
			status = "okay";
			#address-cells = <1>;
			#size-cells = <0>;

			spidev@0 {
				compatible = "rohm,dh2228fv";
				reg = <0x0>;
				spi-max-frequency = <1000000>;
				status = "okay";
			};
		};
	};
};
