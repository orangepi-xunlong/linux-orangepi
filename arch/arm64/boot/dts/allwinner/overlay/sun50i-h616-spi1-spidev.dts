/dts-v1/;
/plugin/;

/ {
	fragment@0 {
		target-path = "/aliases";
		__overlay__ {
			spi1 = "/soc/spi@5011000";
		};
	};

	fragment@2 {
		target = <&spi1>;
		__overlay__ {
			status = "okay";
			#address-cells = <1>;
			#size-cells = <0>;
			spidev@1 {
				compatible = "rohm,dh2228fv";
				status = "okay";
				reg = <1>;
				spi-max-frequency = <1000000>;
			};
		};
	};
};
