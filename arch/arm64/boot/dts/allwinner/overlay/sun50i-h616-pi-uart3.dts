/dts-v1/;
/plugin/;

/ {
	fragment@0 {
		target-path = "/aliases";
		__overlay__ {
			serial2 = "/soc/serial@5000c00";
		};
	};

	fragment@1 {
		target = <&uart3>;
		__overlay__ {
			pinctrl-names = "default";
			pinctrl-0 = <&uart3_pi_pins>;
			status = "okay";
		};
	};
};
