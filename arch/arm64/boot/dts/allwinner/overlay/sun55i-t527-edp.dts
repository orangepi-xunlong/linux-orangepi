/dts-v1/;
/plugin/;

/ {
	fragment@0 {
		target = <&drm_edp>;

		__overlay__ {
			status = "okay";
		};
	};
	fragment@1 {
		target = <&tv1>;

		__overlay__ {
			status = "okay";
		};
	};
	fragment@2 {
		target = <&edp_panel>;

		__overlay__ {
			status = "okay";
		};
	};
	fragment@3 {
		target = <&edp_panel_backlight>;

		__overlay__ {
			status = "okay";
		};
	};
};
