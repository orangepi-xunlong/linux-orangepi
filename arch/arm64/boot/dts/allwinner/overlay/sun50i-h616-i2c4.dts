/dts-v1/;
/plugin/;

/ {
	fragment@0 {
		target-path = "/aliases";
		__overlay__ {
			i2c4 = "/soc/i2c@5003000";
		};
	};

	fragment@1 {
		target = <&i2c4>;
		__overlay__ {
			status = "okay";
		};
	};
};
