/dts-v1/;
/plugin/;

/ {
	fragment@0 {
		target-path = "/aliases";
		__overlay__ {
			serial5 = "/soc/serial@5001400";
		};
	};

	fragment@1 {
		target = <&uart5>;
		 __overlay__ {
			pinctrl-names = "default";
			pinctrl-0 = <&uart5_ph_pins>;
			status = "okay";
		};
	};
};
