/dts-v1/;
/plugin/;

/ {
	fragment@0 {
		target = <&pwm>;
		__overlay__ {
			status = "okay";
		};
	};

	fragment@1 {
		target = <&pwm1>;
		__overlay__ {
			pinctrl-names = "default";
			pinctrl-0 = <&pwm1_pi_pin>;
		};
	};
};
