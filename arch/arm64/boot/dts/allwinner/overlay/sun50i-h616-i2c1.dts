/dts-v1/;
/plugin/;

/ {
	fragment@0 {
		target-path = "/aliases";
		__overlay__ {
			i2c1 = "/soc/i2c@5002400";
			serial2 = "/soc/serial@5000800";
		};
	};

	fragment@1 {
		target = <&i2c1>;
		__overlay__ {
			status = "okay";
		};
	};

        fragment@2 {
                target = <&uart0>;
                __overlay__ {
                        status = "disabled";
                };
        };
};
