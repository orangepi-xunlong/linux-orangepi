/*
 * Allwinner Technology CO., Ltd. sun50iw6p1 soc perf1_v1_0 board.
 *
 * soc board support.
 */

/dts-v1/;

#include "sun50iw3p1.dtsi"

/{

	soc@03000000 {

	};

	chosen {
		bootargs = "earlyprintk=sunxi-uart,0x05000000 loglevel=8 initcall_debug=1 console=ttyS0 init=/init";
	};
};
