/dts-v1/;
/plugin/;

/ {
	fragment@0 {
		target = <&spi1>;
		__overlay__ {
			status = "disabled";
			spidev@0 {
				status = "disabled";
			};
		};
	};

	fragment@2 {
		target = <&uart2>;
		__overlay__ {
			status = "okay";
		};
	};
};
