/dts-v1/;
/plugin/;

/ {
	fragment@0 {
		target = <&pwm>;
		__overlay__ {
			status = "okay";
		};
	};

	fragment@1 {
		target = <&pwm1>;
		__overlay__ {
			status = "okay";
		};
	};

	fragment@2 {
		target = <&pwm2>;
		__overlay__ {
			status = "okay";
		};
	};
};
