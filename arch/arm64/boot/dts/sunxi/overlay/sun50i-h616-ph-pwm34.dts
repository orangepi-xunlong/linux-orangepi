/dts-v1/;
/plugin/;

/ {
	fragment@0 {
		target = <&uart0>;
		 __overlay__ {
			status = "disabled";
		};
	};

	fragment@1 {
		target = <&pwm>;
		__overlay__ {
			status = "okay";
		};
	};

	fragment@2 {
		target = <&pwm3>;
		__overlay__ {
			status = "okay";
		};
	};

	fragment@3 {
		target = <&pwm4>;
		__overlay__ {
			status = "okay";
		};
	};
};
