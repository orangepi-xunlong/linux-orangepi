/dts-v1/;
/plugin/;

/ {
	fragment@0 {
		target = <&leds>;

		__overlay__ {
			status = "okay";

			led-red {
				linux,default-trigger = "none";
			};

			led-green {
				linux,default-trigger = "none";
			};
		};
	};
};
