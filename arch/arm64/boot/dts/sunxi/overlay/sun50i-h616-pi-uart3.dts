/dts-v1/;
/plugin/;

/ {
	fragment@0 {
		target = <&uart3>;
		__overlay__ {
			status = "okay";
			pinctrl-names = "default", "sleep";
			pinctrl-0 = <&uart3_pi_pins_a>;
			pinctrl-1 = <&uart3_pi_pins_b>;
		};
	};
};
