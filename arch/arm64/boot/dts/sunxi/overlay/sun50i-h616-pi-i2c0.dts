/dts-v1/;
/plugin/;

/ {
	fragment@0 {
		target = <&twi0>;
		__overlay__ {
			status = "okay";
			pinctrl-0 = <&twi0_pi_pins_a>;
			pinctrl-1 = <&twi0_pi_pins_b>;
			pinctrl-names = "default", "sleep";
		};
	};
};
