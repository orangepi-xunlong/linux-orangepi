/dts-v1/;
/plugin/;

/ {
	fragment@0 {
		target = <&twi3>;
		__overlay__ {
			status = "okay";
			pinctrl-0 = <&twi3_ph_pins_a>;
			pinctrl-1 = <&twi3_ph_pins_b>;
			pinctrl-names = "default", "sleep";
		};
	};
};
