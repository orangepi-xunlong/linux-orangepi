/dts-v1/;
/plugin/;

/ {
	fragment@0 {
		target = <&pwm>;
		__overlay__ {
			status = "okay";
		};
	};

	fragment@1 {
		target = <&pwm3>;
		__overlay__ {
			status = "okay";
                        pinctrl-names = "active", "sleep";
                        pinctrl-0 = <&pwm3_pi_pin_a>;
                        pinctrl-1 = <&pwm3_pi_pin_b>;
		};
	};
};
