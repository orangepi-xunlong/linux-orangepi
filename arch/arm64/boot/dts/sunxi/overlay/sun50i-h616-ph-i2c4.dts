/dts-v1/;
/plugin/;

/ {
	fragment@1 {
		target = <&twi4>;
		__overlay__ {
			status = "okay";
			pinctrl-0 = <&twi4_ph_pins_a>;
			pinctrl-1 = <&twi4_ph_pins_b>;
			pinctrl-names = "default", "sleep";
		};
	};
};
