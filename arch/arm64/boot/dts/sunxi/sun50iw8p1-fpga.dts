/*
 * Allwinner Technology CO., Ltd. sun8iw12p1 fpga board.
 *
 * fpga board support.
 */

/dts-v1/;

/memreserve/ 0x78000000 0x08000000; /* ion carvout heap revserve  : [0x38000000~0x40000000], size = 128M  */

#include "sun50iw8p1.dtsi"

/{
	ion {
		carvout{
			type = <2>;
			name = "carvout";
			base = <0x78000000>;
			size = <0x08000000>;
		};
	};

	soc@03000000 {

	};
};
