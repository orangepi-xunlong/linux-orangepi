/dts-v1/;
/plugin/;

/ {
        compatible = "rockchip,rk3399";

        fragment@0 {
                target = <&mipi_dsi>;
                __overlay__ {
                        status = "okay";
                };
        };

        fragment@1 {
                target = <&gt9xx>;
                __overlay__ {
                        status = "okay";
                };
        };
};
