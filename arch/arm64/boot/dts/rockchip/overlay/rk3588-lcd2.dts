/dts-v1/;
/plugin/;

/ {
	fragment@0 {
		target = <&dsi0>;
		__overlay__ {
			status = "okay";
		};
	};

	fragment@1 {
		target = <&dsi0_panel>;
		__overlay__ {
			status = "okay";
		};
	};

	fragment@2 {
		target = <&dsi0_in_vp2>;
		__overlay__ {
			status = "okay";
		};
	};
};
