/dts-v1/;
/plugin/;

/ {
	fragment@0 {
		target = <&spi1>;

		__overlay__ {
			status = "okay";

			spidev@0 {
				compatible = "rockchip,spidev";
				reg = <0>;
				spi-max-frequency = <10000000>;
				status = "okay";
			};

		};
	};
};
