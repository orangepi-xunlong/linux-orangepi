/dts-v1/;
/plugin/;

/ {
        fragment@0 {
                target = <&gpu>;

                __overlay__ {
			mali-supply = <&vdd_gpu>;
                        status = "okay";
                };
        };
};
