## bsp/configs/linux-5.15/sun55iw3p1_standby_min_defconfig
```kconfig
CONFIG_AW_BSP=y
CONFIG_ARCH_SUN55I=y
CONFIG_AW_IC_BOARD=y
CONFIG_AW_SOC_NAME="A523"
CONFIG_AW_TIMER_SUN50I=y
CONFIG_AW_DMA=y
CONFIG_AW_RTC=y
CONFIG_AW_RTC_REBOOT_FLAG=y
CONFIG_AW_RTC_POWEROFF_ALARM=y
CONFIG_AW_TIMER_ALARM=y
CONFIG_AW_NSI=y
CONFIG_AW_WATCHDOG=y
CONFIG_AW_TWI=y
CONFIG_AW_SPI=y
CONFIG_AW_LEDC=y
CONFIG_AW_PWM=y
CONFIG_AW_IOMMU=y
CONFIG_AW_WAKEUPGEN=y
CONFIG_AW_SUN8I_NMI=y
CONFIG_AW_MFD_AXP2101_I2C=y
CONFIG_AW_MFD_PMU_EXT_I2C=y
CONFIG_AW_REGULATOR_AXP2101=y
CONFIG_AW_REGULATOR_PMU_EXT=y
CONFIG_AW_AXP2202_POWER=y
# CONFIG_AW_INPUT_SENSORINIT is not set
CONFIG_AW_MMC=y
# CONFIG_AW_DISP2 is not set
CONFIG_AW_CRASHDUMP=y
# CONFIG_AW_NNA_VIP is not set
# CONFIG_AW_NNA_GALCORE is not set
# CONFIG_LOCALVERSION_AUTO is not set
CONFIG_NO_HZ=y
CONFIG_HIGH_RES_TIMERS=y
CONFIG_PREEMPT=y
CONFIG_IKCONFIG=y
CONFIG_IKCONFIG_PROC=y
CONFIG_CGROUPS=y
CONFIG_CGROUP_SCHED=y
CONFIG_NAMESPACES=y
# CONFIG_UTS_NS is not set
# CONFIG_PID_NS is not set
CONFIG_BLK_DEV_INITRD=y
CONFIG_INITRAMFS_SOURCE="./bsp/ramfs/ramfs_aarch64.cpio.gz"
# CONFIG_RD_BZIP2 is not set
# CONFIG_RD_LZMA is not set
# CONFIG_RD_XZ is not set
# CONFIG_RD_LZO is not set
# CONFIG_RD_LZ4 is not set
CONFIG_EXPERT=y
# CONFIG_SYSFS_SYSCALL is not set
# CONFIG_FHANDLE is not set
CONFIG_KALLSYMS_ALL=y
# CONFIG_RSEQ is not set
# CONFIG_COMPAT_BRK is not set
# CONFIG_SLAB_MERGE_DEFAULT is not set
CONFIG_PROFILING=y
CONFIG_SCHED_MC=y
CONFIG_NR_CPUS=8
CONFIG_COMPAT=y
# CONFIG_EFI is not set
CONFIG_PM_WAKELOCKS=y
CONFIG_PM_DEBUG=y
CONFIG_PM_ADVANCED_DEBUG=y
CONFIG_JUMP_LABEL=y
CONFIG_MODULES=y
CONFIG_MODULE_UNLOAD=y
# CONFIG_CORE_DUMP_DEFAULT_ELF_HEADERS is not set
CONFIG_CMA=y
CONFIG_CMA_AREAS=16
CONFIG_PCI=y
# CONFIG_PCI_QUIRKS is not set
CONFIG_DEVTMPFS=y
# CONFIG_ALLOW_DEV_COREDUMP is not set
CONFIG_GNSS=y
CONFIG_SCSI=y
CONFIG_BLK_DEV_SD=y
# CONFIG_INPUT_MOUSE is not set
# CONFIG_SERIO_SERPORT is not set
# CONFIG_VT is not set
# CONFIG_LEGACY_PTYS is not set
CONFIG_SERIAL_8250=y
# CONFIG_SERIAL_8250_DEPRECATED_OPTIONS is not set
CONFIG_SERIAL_8250_CONSOLE=y
CONFIG_SERIAL_8250_RUNTIME_UARTS=0
CONFIG_SERIAL_8250_DW=y
CONFIG_SERIAL_OF_PLATFORM=y
# CONFIG_HW_RANDOM is not set
# CONFIG_DEVPORT is not set
# CONFIG_PINCTRL_SUN8I_H3_R is not set
# CONFIG_PINCTRL_SUN50I_A64 is not set
# CONFIG_PINCTRL_SUN50I_A64_R is not set
# CONFIG_PINCTRL_SUN50I_A100 is not set
# CONFIG_PINCTRL_SUN50I_A100_R is not set
# CONFIG_PINCTRL_SUN50I_H5 is not set
# CONFIG_PINCTRL_SUN50I_H6 is not set
# CONFIG_PINCTRL_SUN50I_H6_R is not set
# CONFIG_PINCTRL_SUN50I_H616 is not set
# CONFIG_PINCTRL_SUN50I_H616_R is not set
# CONFIG_HWMON is not set
CONFIG_MFD_SUN6I_PRCM=y
CONFIG_MFD_SYSCON=y
CONFIG_REGULATOR_FIXED_VOLTAGE=y
# CONFIG_VGA_ARB is not set
CONFIG_FB=y
# CONFIG_USB_SUPPORT is not set
CONFIG_MMC=y
CONFIG_MMC_HSQ=y
# CONFIG_CLK_SUNXI is not set
# CONFIG_SUNXI_CCU is not set
# CONFIG_ARM_ARCH_TIMER_EVTSTREAM is not set
# CONFIG_FSL_ERRATUM_A008585 is not set
CONFIG_EXT4_FS=y
# CONFIG_DNOTIFY is not set
CONFIG_MSDOS_FS=y
CONFIG_VFAT_FS=y
CONFIG_TMPFS=y
CONFIG_CONFIGFS_FS=y
# CONFIG_MISC_FILESYSTEMS is not set
CONFIG_NLS_CODEPAGE_437=y
CONFIG_NLS_ISO8859_1=y
CONFIG_XZ_DEC=y
CONFIG_DMA_CMA=y
CONFIG_PRINTK_TIME=y
CONFIG_MESSAGE_LOGLEVEL_DEFAULT=7
CONFIG_DEBUG_INFO=y
# CONFIG_SECTION_MISMATCH_WARN_ONLY is not set
CONFIG_MAGIC_SYSRQ=y
CONFIG_PANIC_ON_OOPS=y
# CONFIG_SCHED_DEBUG is not set
# CONFIG_DEBUG_PREEMPT is not set
CONFIG_STACKTRACE=y
# CONFIG_FTRACE is not set
```

## bsp/configs/linux-5.15/sun60iw2p1_min_defconfig
```kconfig
CONFIG_AW_BSP=y
CONFIG_ARCH_SUN60I=y
CONFIG_ARCH_SUN60IW2=y
CONFIG_AW_IC_BOARD=y
CONFIG_AW_SOC_NAME="A733"
# CONFIG_AW_UART is not set
CONFIG_AW_UART_NG=y
CONFIG_AW_SERIAL_CONSOLE=y
# CONFIG_AW_DUMP_REG is not set
# CONFIG_AW_VIDEO_ENCODER_DECODER is not set
# CONFIG_AW_INPUT_SENSORINIT is not set
CONFIG_AW_EVENT_DDR=y
# CONFIG_LOCALVERSION_AUTO is not set
CONFIG_NO_HZ=y
CONFIG_HIGH_RES_TIMERS=y
CONFIG_PREEMPT=y
CONFIG_IKCONFIG=y
CONFIG_IKCONFIG_PROC=y
CONFIG_CGROUPS=y
CONFIG_CGROUP_SCHED=y
CONFIG_NAMESPACES=y
# CONFIG_UTS_NS is not set
# CONFIG_PID_NS is not set
CONFIG_BLK_DEV_INITRD=y
CONFIG_INITRAMFS_SOURCE="./bsp/ramfs/ramfs_aarch64.cpio.gz"
# CONFIG_RD_BZIP2 is not set
# CONFIG_RD_LZMA is not set
# CONFIG_RD_XZ is not set
# CONFIG_RD_LZO is not set
# CONFIG_RD_LZ4 is not set
CONFIG_EXPERT=y
# CONFIG_SYSFS_SYSCALL is not set
# CONFIG_FHANDLE is not set
CONFIG_KALLSYMS_ALL=y
# CONFIG_RSEQ is not set
# CONFIG_COMPAT_BRK is not set
# CONFIG_SLAB_MERGE_DEFAULT is not set
CONFIG_PROFILING=y
CONFIG_SCHED_MC=y
CONFIG_NR_CPUS=4
CONFIG_COMPAT=y
# CONFIG_EFI is not set
# CONFIG_SUSPEND is not set
CONFIG_MODULES=y
CONFIG_MODULE_UNLOAD=y
# CONFIG_CORE_DUMP_DEFAULT_ELF_HEADERS is not set
CONFIG_CMA=y
CONFIG_DEVTMPFS=y
# CONFIG_ALLOW_DEV_COREDUMP is not set
# CONFIG_BLK_DEV is not set
# CONFIG_INPUT_MOUSE is not set
# CONFIG_SERIO_SERPORT is not set
# CONFIG_VT is not set
# CONFIG_LEGACY_PTYS is not set
# CONFIG_HW_RANDOM is not set
# CONFIG_PINCTRL_SUN8I_H3_R is not set
# CONFIG_PINCTRL_SUN50I_A64 is not set
# CONFIG_PINCTRL_SUN50I_A64_R is not set
# CONFIG_PINCTRL_SUN50I_A100 is not set
# CONFIG_PINCTRL_SUN50I_A100_R is not set
# CONFIG_PINCTRL_SUN50I_H5 is not set
# CONFIG_PINCTRL_SUN50I_H6 is not set
# CONFIG_PINCTRL_SUN50I_H6_R is not set
# CONFIG_PINCTRL_SUN50I_H616 is not set
# CONFIG_PINCTRL_SUN50I_H616_R is not set
# CONFIG_HWMON is not set
# CONFIG_USB_SUPPORT is not set
# CONFIG_SUNXI_CCU is not set
# CONFIG_ARM_ARCH_TIMER_EVTSTREAM is not set
# CONFIG_FSL_ERRATUM_A008585 is not set
# CONFIG_IOMMU_SUPPORT is not set
# CONFIG_DNOTIFY is not set
CONFIG_TMPFS=y
CONFIG_CONFIGFS_FS=y
# CONFIG_MISC_FILESYSTEMS is not set
CONFIG_XZ_DEC=y
CONFIG_DMA_CMA=y
CONFIG_PRINTK_TIME=y
CONFIG_MESSAGE_LOGLEVEL_DEFAULT=7
# CONFIG_SECTION_MISMATCH_WARN_ONLY is not set
CONFIG_MAGIC_SYSRQ=y
# CONFIG_DEBUG_MISC is not set
CONFIG_PANIC_ON_OOPS=y
# CONFIG_SCHED_DEBUG is not set
# CONFIG_DEBUG_PREEMPT is not set
# CONFIG_FTRACE is not set
```

## bsp/configs/linux-5.15/sun8iw21p1_min_defconfig
```kconfig
CONFIG_AW_BSP=y
CONFIG_ARCH_SUN8IW21=y
CONFIG_AW_IC_BOARD=y
CONFIG_AW_SOC_NAME="V851S3"
CONFIG_AW_CCU_LEGACY=y
# CONFIG_AW_CCU is not set
CONFIG_AW_TIMER=y
CONFIG_AW_DMA=y
CONFIG_AW_RTC=y
CONFIG_AW_RTC_REBOOT_FLAG=y
CONFIG_AW_WATCHDOG=y
CONFIG_AW_IOMMU=y
CONFIG_AW_MTD=y
CONFIG_AW_MTD_SPINAND=y
CONFIG_AW_DI=y
CONFIG_SUNXI_DI_V1XX=y
CONFIG_AW_SMC=y
CONFIG_AW_GMAC=y
CONFIG_USB_SUNXI_USB=y
CONFIG_USB_SUNXI_USB_DEBUG=y
CONFIG_USB_SUNXI_USB_ADB=y
CONFIG_USB_SUNXI_UDC0=y
CONFIG_AW_SPI=y
CONFIG_AW_PWM=y
CONFIG_AW_RTP=y
# CONFIG_AW_INPUT_SENSORINIT is not set
CONFIG_AW_WAKEUPGEN=y
CONFIG_AW_THERMAL=y
CONFIG_NVMEM_AW_SID=y
CONFIG_AW_REGULATOR_PWM=y
CONFIG_ARM_AW_SUN50I_CPUFREQ_NVMEM=y
# CONFIG_LOCALVERSION_AUTO is not set
CONFIG_SYSVIPC=y
CONFIG_NO_HZ=y
CONFIG_HIGH_RES_TIMERS=y
CONFIG_PREEMPT=y
CONFIG_BSD_PROCESS_ACCT=y
CONFIG_BSD_PROCESS_ACCT_V3=y
CONFIG_IKCONFIG=y
CONFIG_IKCONFIG_PROC=y
CONFIG_LOG_BUF_SHIFT=14
CONFIG_BLK_DEV_INITRD=y
CONFIG_CC_OPTIMIZE_FOR_SIZE=y
# CONFIG_SYSFS_SYSCALL is not set
CONFIG_KALLSYMS_ALL=y
CONFIG_EMBEDDED=y
# CONFIG_SLUB_DEBUG is not set
# CONFIG_COMPAT_BRK is not set
CONFIG_PROFILING=y
# CONFIG_MACH_SUN4I is not set
# CONFIG_MACH_SUN5I is not set
# CONFIG_MACH_SUN6I is not set
# CONFIG_MACH_SUN7I is not set
# CONFIG_MACH_SUN9I is not set
# CONFIG_VDSO is not set
CONFIG_SMP=y
CONFIG_HAVE_ARM_ARCH_TIMER=y
CONFIG_ARM_PSCI=y
CONFIG_OABI_COMPAT=y
CONFIG_HIGHMEM=y
# CONFIG_ARM_MODULE_PLTS is not set
# CONFIG_ATAGS is not set
CONFIG_CMDLINE="earlyprintk=sunxi-uart,0x01c28000 loglevel=8 initcall_debug=1 console=ttyS0 init=/init"
CONFIG_CPU_IDLE=y
CONFIG_ARM_PSCI_CPUIDLE=y
CONFIG_VFP=y
CONFIG_NEON=y
CONFIG_PM_WAKELOCKS=y
CONFIG_PM_DEBUG=y
CONFIG_PM_ADVANCED_DEBUG=y
CONFIG_JUMP_LABEL=y
CONFIG_MODULES=y
CONFIG_MODULE_UNLOAD=y
# CONFIG_CORE_DUMP_DEFAULT_ELF_HEADERS is not set
# CONFIG_COMPACTION is not set
CONFIG_CMA=y
CONFIG_NET=y
CONFIG_PACKET=y
CONFIG_UNIX=y
CONFIG_UNIX_DIAG=y
CONFIG_NET_KEY=y
CONFIG_INET=y
CONFIG_IP_MULTICAST=y
CONFIG_IP_ADVANCED_ROUTER=y
CONFIG_IP_FIB_TRIE_STATS=y
CONFIG_IP_MULTIPLE_TABLES=y
CONFIG_UEVENT_HELPER=y
CONFIG_UEVENT_HELPER_PATH="/sbin/hotplug"
CONFIG_DEVTMPFS=y
# CONFIG_SUNXI_RSB is not set
CONFIG_SCSI=y
CONFIG_BLK_DEV_SD=y
CONFIG_SCSI_DEBUG=y
# CONFIG_INPUT_KEYBOARD is not set
# CONFIG_INPUT_MOUSE is not set
# CONFIG_SERIO is not set
# CONFIG_LEGACY_PTYS is not set
# CONFIG_HW_RANDOM is not set
# CONFIG_DEVMEM is not set
CONFIG_SPI_MEM=y
# CONFIG_PINCTRL_SUN4I_A10 is not set
# CONFIG_PINCTRL_SUN8I_A23 is not set
# CONFIG_PINCTRL_SUN8I_A33 is not set
# CONFIG_PINCTRL_SUN8I_A83T is not set
# CONFIG_PINCTRL_SUN8I_A83T_R is not set
# CONFIG_PINCTRL_SUN8I_A23_R is not set
# CONFIG_PINCTRL_SUN8I_H3 is not set
# CONFIG_PINCTRL_SUN8I_H3_R is not set
# CONFIG_PINCTRL_SUN8I_V3S is not set
CONFIG_POWER_SUPPLY=y
CONFIG_THERMAL_STATISTICS=y
CONFIG_THERMAL_WRITABLE_TRIPS=y
CONFIG_THERMAL_GOV_FAIR_SHARE=y
CONFIG_THERMAL_GOV_BANG_BANG=y
CONFIG_THERMAL_GOV_USER_SPACE=y
CONFIG_CPU_THERMAL=y
CONFIG_THERMAL_EMULATION=y
CONFIG_REGULATOR=y
CONFIG_REGULATOR_FIXED_VOLTAGE=y
CONFIG_SOUND=y
CONFIG_SND=y
CONFIG_SND_SOC=y
CONFIG_USB_GADGET=y
CONFIG_USB_CONFIGFS=y
CONFIG_USB_CONFIGFS_UEVENT=y
CONFIG_USB_CONFIGFS_SERIAL=y
CONFIG_USB_CONFIGFS_RNDIS=y
CONFIG_USB_CONFIGFS_MASS_STORAGE=y
CONFIG_USB_CONFIGFS_F_FS=y
CONFIG_USB_CONFIGFS_F_HID=y
CONFIG_USB_ROLE_SWITCH=y
# CONFIG_RTC_DRV_SUN6I is not set
CONFIG_DMABUF_HEAPS=y
CONFIG_DMABUF_SYSFS_STATS=y
CONFIG_DMABUF_HEAPS_DEFERRED_FREE=y
CONFIG_DMABUF_HEAPS_PAGE_POOL=y
CONFIG_DMABUF_HEAPS_SYSTEM=y
CONFIG_DMABUF_HEAPS_CMA=y
CONFIG_STAGING=y
# CONFIG_CLK_SUNXI is not set
# CONFIG_SUNXI_CCU is not set
CONFIG_ANDROID=y
CONFIG_EXT4_FS=y
CONFIG_EXT4_FS_POSIX_ACL=y
CONFIG_EXT4_FS_SECURITY=y
CONFIG_EXT4_DEBUG=y
# CONFIG_DNOTIFY is not set
# CONFIG_INOTIFY_USER is not set
CONFIG_TMPFS=y
CONFIG_TMPFS_POSIX_ACL=y
CONFIG_UBIFS_FS=y
CONFIG_SQUASHFS=y
CONFIG_NLS_CODEPAGE_437=y
CONFIG_NLS_ISO8859_1=y
CONFIG_DMA_CMA=y
CONFIG_PRINTK_TIME=y
CONFIG_FRAME_WARN=2048
CONFIG_MAGIC_SYSRQ=y
CONFIG_DEBUG_FS=y
# CONFIG_SCHED_DEBUG is not set
CONFIG_DEBUG_MUTEXES=y
CONFIG_STACKTRACE=y
# CONFIG_FTRACE is not set
```

## bsp/configs/linux-5.4/sun20iw5p1_min_defconfig
```kconfig
CONFIG_SYSVIPC=y
CONFIG_POSIX_MQUEUE=y
CONFIG_NO_HZ_IDLE=y
CONFIG_HIGH_RES_TIMERS=y
CONFIG_IKCONFIG=y
CONFIG_IKCONFIG_PROC=y
CONFIG_CGROUPS=y
CONFIG_CGROUP_SCHED=y
CONFIG_CFS_BANDWIDTH=y
CONFIG_CGROUP_BPF=y
CONFIG_NAMESPACES=y
CONFIG_USER_NS=y
CONFIG_CHECKPOINT_RESTORE=y
CONFIG_BLK_DEV_INITRD=y
CONFIG_EXPERT=y
CONFIG_BPF_SYSCALL=y
CONFIG_ARCH_RV32I=y
CONFIG_SMP=y
CONFIG_HIGHMEM=y
CONFIG_CMDLINE="earlyprintk=sunxi-uart,0x42500000 loglevel=8 initcall_debug=1 console=ttyAS0 init=/init"
CONFIG_MODULES=y
CONFIG_MODULE_UNLOAD=y
CONFIG_AW_BSP=y
# CONFIG_AW_DDR_CCU is not set
CONFIG_NET=y
CONFIG_PACKET=y
CONFIG_UNIX=y
CONFIG_INET=y
CONFIG_IP_MULTICAST=y
CONFIG_IP_ADVANCED_ROUTER=y
CONFIG_IP_PNP=y
CONFIG_IP_PNP_DHCP=y
CONFIG_IP_PNP_BOOTP=y
CONFIG_IP_PNP_RARP=y
# CONFIG_INET_DIAG is not set
CONFIG_NETLINK_DIAG=y
CONFIG_NET_9P=y
CONFIG_NET_9P_VIRTIO=y
CONFIG_FAILOVER=y
CONFIG_DEVTMPFS=y
CONFIG_DEVTMPFS_MOUNT=y
CONFIG_BLK_DEV_LOOP=y
CONFIG_VIRTIO_BLK=y
CONFIG_BLK_DEV_SD=y
CONFIG_BLK_DEV_SR=y
CONFIG_SCSI_VIRTIO=y
CONFIG_ATA=y
CONFIG_SATA_AHCI_PLATFORM=y
CONFIG_INPUT_MOUSEDEV=y
CONFIG_SERIAL_EARLYCON_RISCV_SBI=y
CONFIG_HVC_RISCV_SBI=y
CONFIG_VIRTIO_CONSOLE=y
CONFIG_HW_RANDOM=y
CONFIG_HW_RANDOM_VIRTIO=y
CONFIG_POWER_SUPPLY=y
CONFIG_DRM=y
CONFIG_DRM_VIRTIO_GPU=y
CONFIG_BACKLIGHT_CLASS_DEVICE=y
CONFIG_FRAMEBUFFER_CONSOLE=y
CONFIG_USB=y
CONFIG_USB_XHCI_HCD=y
CONFIG_USB_XHCI_PLATFORM=y
CONFIG_USB_EHCI_HCD=y
CONFIG_USB_EHCI_HCD_PLATFORM=y
CONFIG_USB_OHCI_HCD=y
CONFIG_USB_OHCI_HCD_PLATFORM=y
CONFIG_USB_STORAGE=y
CONFIG_USB_UAS=y
CONFIG_VIRTIO_BALLOON=y
CONFIG_VIRTIO_INPUT=y
CONFIG_VIRTIO_MMIO=y
CONFIG_RPMSG_CHAR=y
CONFIG_RPMSG_VIRTIO=y
CONFIG_SIFIVE_PLIC=y
CONFIG_RAS=y
CONFIG_EXT4_FS=y
CONFIG_EXT4_FS_POSIX_ACL=y
CONFIG_AUTOFS4_FS=y
CONFIG_MSDOS_FS=y
CONFIG_VFAT_FS=y
CONFIG_TMPFS=y
CONFIG_TMPFS_POSIX_ACL=y
CONFIG_NFS_FS=y
CONFIG_NFS_V4=y
CONFIG_NFS_V4_1=y
CONFIG_NFS_V4_2=y
CONFIG_ROOT_NFS=y
CONFIG_9P_FS=y
CONFIG_CRYPTO_USER_API_HASH=y
CONFIG_CRYPTO_DEV_VIRTIO=y
CONFIG_PRINTK_TIME=y
CONFIG_DEBUG_FS=y
# CONFIG_RCU_TRACE is not set
```

## bsp/configs/linux-6.1/android_min_ko_defconfig
```kconfig
# V0.1 BSP Min System
CONFIG_AW_BSP=y
CONFIG_ARCH_SUN55I=y
CONFIG_AW_IC_BOARD=y
CONFIG_AW_SOC_NAME="A523"
CONFIG_AW_CCU=m
CONFIG_AW_PINCTRL=m
CONFIG_AW_UART=m
CONFIG_AW_SERIAL_CONSOLE=y
CONFIG_AW_EARLY_PRINTK=y
CONFIG_AW_TIMER_SUN50I=m

# V0.3 BSP Basic System
CONFIG_AW_DMA=m
CONFIG_AW_DUMP_REG=m
CONFIG_AW_RTC=m
CONFIG_AW_RTC_REBOOT_FLAG=y
CONFIG_AW_RTC_POWEROFF_ALARM=y
CONFIG_AW_WATCHDOG=m
CONFIG_AW_NSI=m

# V0.5 BSP Peripheral Module
CONFIG_AW_I2C=m
CONFIG_AW_PWM=m
CONFIG_AW_LRADC=m
CONFIG_AW_LEDC=m
CONFIG_AW_IR_RX=m
CONFIG_AW_IR_TX=m
CONFIG_AW_GPADC=m
CONFIG_AW_SPI=m
CONFIG_AW_PCIE_RC=m
CONFIG_AW_HWSPINLOCK=m
CONFIG_AW_MSGBOX=m
CONFIG_AW_SID=m
CONFIG_AW_SYS_INFO=m
CONFIG_AW_SMC=m
CONFIG_AW_NAND=m
CONFIG_AW_MMC_HSQ=m
CONFIG_AW_MMC=m
#USB
CONFIG_USB_OHCI_HCD=m # only for Linux-6.1
CONFIG_USB_EHCI_HCD_SUNXI=m
CONFIG_USB_OHCI_HCD_SUNXI=m
CONFIG_USB_SUNXI_HCD=m
CONFIG_USB_SUNXI_HCI=m
CONFIG_USB_SUNXI_EHCI0=m
CONFIG_USB_SUNXI_EHCI1=m
CONFIG_USB_SUNXI_OHCI0=m
CONFIG_USB_SUNXI_OHCI1=m
CONFIG_USB_SUNXI_USB=m
CONFIG_USB_SUNXI_UDC0=m
CONFIG_USB_SUNXI_USB_MANAGER=m
CONFIG_USB_SUNXI_USB_DEBUG=m
CONFIG_USB_SUNXI_USB_ADB=m

# V1.0 Complete System & Android min system
# System
CONFIG_AW_IOMMU=m
CONFIG_AW_CRASHDUMP=m
CONFIG_AW_CRASHDUMP_KEY=y
# CTP
CONFIG_AW_INPUT_SENSORINIT=m
CONFIG_AW_INPUT_CTP=y
CONFIG_TOUCHSCREEN_GT9XX=m
CONFIG_AW_INPUT_SENSOR=y
CONFIG_AW_INPUT_MISC=y
CONFIG_AW_HALL_SENSOR=m
# Power
CONFIG_AW_THERMAL=m
CONFIG_AW_PM_DOMAINS=m
CONFIG_AW_PCK600_DOMAINS=m
CONFIG_AW_POWER_DOMAIN_TEST=m
CONFIG_AW_MFD_AXP2101_I2C=m
CONFIG_AW_MFD_PMU_EXT_I2C=m
CONFIG_AW_REGULATOR_AXP2101=m
CONFIG_AW_REGULATOR_PMU_EXT=m
CONFIG_AW_INPUT_AXP2101_PEK=m
CONFIG_AW_AXP2202_POWER=m
CONFIG_AW_CPUFREQ_DT=m
CONFIG_AW_DMC_DEVFREQ=m
CONFIG_AW_EVENT_DDR=m
# DE(Display)
CONFIG_FB=m
CONFIG_AW_DISP2=m
CONFIG_EDP2_AW_DISP2=m
CONFIG_EDP_SUPPORT_VVX10T025J00_2560X1600=m
CONFIG_DISP_PHY_INNO_EDP_1_3=m
CONFIG_AW_DISP2_DEBUG=y
CONFIG_AW_DISP2_COMPOSER=y
# LCD
# GPU
CONFIG_AW_GPU_TYPE="mali-g57"
```
