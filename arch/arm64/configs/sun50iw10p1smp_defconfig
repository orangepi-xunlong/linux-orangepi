## bsp/configs/linux-6.1/sun55iw3p1_min_defconfig
```kconfig
CONFIG_AW_BSP=y
CONFIG_ARCH_SUN55I=y
CONFIG_AW_IC_BOARD=y
CONFIG_AW_SOC_NAME="A523"
# CONFIG_AW_DUMP_REG is not set
# CONFIG_AW_INPUT_SENSORINIT is not set
# CONFIG_AW_DISP2 is not set
# CONFIG_AW_NNA_VIP is not set
# CONFIG_AW_NNA_GALCORE is not set
# CONFIG_LOCALVERSION_AUTO is not set
CONFIG_NO_HZ=y
CONFIG_HIGH_RES_TIMERS=y
CONFIG_PREEMPT=y
CONFIG_IKCONFIG=y
CONFIG_IKCONFIG_PROC=y
CONFIG_CGROUPS=y
CONFIG_CGROUP_SCHED=y
CONFIG_NAMESPACES=y
# CONFIG_UTS_NS is not set
# CONFIG_PID_NS is not set
CONFIG_BLK_DEV_INITRD=y
CONFIG_INITRAMFS_SOURCE="./bsp/ramfs/ramfs_aarch64.cpio.gz"
# CONFIG_RD_BZIP2 is not set
# CONFIG_RD_LZMA is not set
# CONFIG_RD_XZ is not set
# CONFIG_RD_LZO is not set
# CONFIG_RD_LZ4 is not set
CONFIG_EXPERT=y
# CONFIG_SYSFS_SYSCALL is not set
# CONFIG_FHANDLE is not set
CONFIG_KALLSYMS_ALL=y
# CONFIG_RSEQ is not set
CONFIG_PROFILING=y
CONFIG_SCHED_MC=y
CONFIG_NR_CPUS=4
CONFIG_HOTPLUG_CPU=y
CONFIG_COMPAT=y
# CONFIG_EFI is not set
# CONFIG_SUSPEND is not set
CONFIG_JUMP_LABEL=y
CONFIG_MODULES=y
CONFIG_MODULE_UNLOAD=y
# CONFIG_CORE_DUMP_DEFAULT_ELF_HEADERS is not set
# CONFIG_SLAB_MERGE_DEFAULT is not set
# CONFIG_COMPAT_BRK is not set
CONFIG_CMA=y
CONFIG_CMA_AREAS=16
CONFIG_DEVTMPFS=y
# CONFIG_ALLOW_DEV_COREDUMP is not set
# CONFIG_BLK_DEV is not set
CONFIG_SCSI=y
CONFIG_BLK_DEV_SD=y
# CONFIG_INPUT_MOUSE is not set
# CONFIG_SERIO_SERPORT is not set
# CONFIG_VT is not set
# CONFIG_LEGACY_PTYS is not set
CONFIG_SERIAL_8250=y
# CONFIG_SERIAL_8250_DEPRECATED_OPTIONS is not set
CONFIG_SERIAL_8250_CONSOLE=y
CONFIG_SERIAL_8250_RUNTIME_UARTS=0
CONFIG_SERIAL_8250_DW=y
CONFIG_SERIAL_OF_PLATFORM=y
# CONFIG_HW_RANDOM is not set
# CONFIG_PINCTRL_SUN8I_H3_R is not set
# CONFIG_PINCTRL_SUN50I_A64 is not set
# CONFIG_PINCTRL_SUN50I_A64_R is not set
# CONFIG_PINCTRL_SUN50I_A100 is not set
# CONFIG_PINCTRL_SUN50I_A100_R is not set
# CONFIG_PINCTRL_SUN50I_H5 is not set
# CONFIG_PINCTRL_SUN50I_H6 is not set
# CONFIG_PINCTRL_SUN50I_H6_R is not set
# CONFIG_PINCTRL_SUN50I_H616 is not set
# CONFIG_PINCTRL_SUN50I_H616_R is not set
# CONFIG_HWMON is not set
CONFIG_MFD_SUN6I_PRCM=y
CONFIG_MFD_SYSCON=y
CONFIG_FB=y
# CONFIG_USB_SUPPORT is not set
# CONFIG_VIRTIO_MENU is not set
# CONFIG_VHOST_MENU is not set
# CONFIG_SURFACE_PLATFORMS is not set
# CONFIG_SUNXI_CCU is not set
# CONFIG_ARM_ARCH_TIMER_EVTSTREAM is not set
# CONFIG_FSL_ERRATUM_A008585 is not set
# CONFIG_IOMMU_SUPPORT is not set
# CONFIG_DNOTIFY is not set
# CONFIG_INOTIFY_USER is not set
CONFIG_MSDOS_FS=y
CONFIG_VFAT_FS=y
CONFIG_TMPFS=y
CONFIG_CONFIGFS_FS=y
# CONFIG_MISC_FILESYSTEMS is not set
CONFIG_NLS_CODEPAGE_437=y
CONFIG_NLS_ISO8859_1=y
CONFIG_CRC16=y
CONFIG_XZ_DEC=y
CONFIG_DMA_CMA=y
CONFIG_PRINTK_TIME=y
CONFIG_MESSAGE_LOGLEVEL_DEFAULT=7
# CONFIG_DEBUG_MISC is not set
# CONFIG_SECTION_MISMATCH_WARN_ONLY is not set
CONFIG_MAGIC_SYSRQ=y
CONFIG_PANIC_ON_OOPS=y
# CONFIG_SCHED_DEBUG is not set
# CONFIG_DEBUG_PREEMPT is not set
# CONFIG_FTRACE is not set
# CONFIG_STRICT_DEVMEM is not set
# CONFIG_RUNTIME_TESTING_MENU is not set
```

## bsp/drivers/andes_adaptor/Kconfig
```kconfig
# SPDX-License-Identifier: GPL-2.0-only
# Generic Trusted Execution Environment Configuration

menu "AW andes adaption"

config AW_ANDES_DMA_ADAPT
	bool "andes dma adapter"

if AW_ANDES_DMA_ADAPT

choice
	prompt "adapter type"
	default AW_ANDES_DMA_OPS

config AW_ANDES_NO_DIRECT_DMA
	bool "direct dma api"
	#prohibit default non-cache alloc
	select ARCH_HAS_UNCACHED_SEGMENT
	select ARCH_HAS_DMA_COHERENT_TO_PFN

config AW_ANDES_DMA_OPS
	bool "overwrite dma ops"
	depends on DMA_CMA
	help
	 "overwrite default andes dummy dma ops for drivers"


endchoice
endif

config AW_ANDES_CMA_NON_CACHE
	depends on AW_BSP
	depends on PMA
	depends on DMA_CMA
	bool "set cma memory non_cache for devices"
	default n
	help
	  This help non-cache memory using with andes platform

endmenu
```

## bsp/drivers/ata/Kconfig
```kconfig
# SPDX-License-Identifier: GPL-2.0-only

menu "ATA Drivers"
	depends on AW_BSP

config AW_AHCI
	tristate "AHCI SATA Support for Allwinner SoCs"
	depends on AW_BSP && OF
	select ATA
	select SATA_AHCI_PLATFORM
	help
	  Enable SATA controllers on Allwinner SoCs.

endmenu
```

## bsp/drivers/aw_trace/Kconfig
```kconfig
# SPDX-License-Identifier: GPL-2.0-only

menu "Aw trace Drivers"
	depends on AW_BSP

config AW_TRACE
	tristate "Allwinner Tracers"
	depends on AW_BSP
	help
	  Support for aw tracers for debug.

config AW_HEALTHD
	tristate "Allwinner healthd"
	depends on AW_BSP
	help
	  Support for aw health domain for debug.
endmenu
```

## bsp/drivers/awlink/Kconfig
```kconfig
# SPDX-License-Identifier: GPL-2.0-only

menu "AWLINK Drivers"
	depends on AW_BSP

config AW_AWLINK_SUN55I
	depends on AW_BSP && CAN
	tristate "Allwinner SUN55I AWLINK controller"
	help
	  if say Y here, you can use AWLINK controller found on Allwinner SoCs.

if AW_AWLINK_SUN55I
choice
	prompt "select awlink support kernel version"
	default AWLINK_SUPPORT_KERNEL_5_15

 config AWLINK_SUPPORT_KERNEL_5_15
	bool "select awlink support with linux 5.15"
	help
		Support awlink with linux 5.15

 config AWLINK_SUPPORT_KERNEL_6_6
	bool "select awlink support with linux 6.6"
	help
		Support awlink with linux 6.6

endchoice
endif

endmenu
```

## bsp/drivers/bluetooth/Kconfig
```kconfig
menu "Networking Drivers"

menu "Bluetooth Subsystem Support"

menu "Bluetooth Device Drivers"
	depends on AW_BSP
	depends on BT

config BCM_BT_LPM
	tristate "Broadcom Bluetooth Low Power Manager Support"
	help
	  Bluetooth Low Power Manager Driver.
	  This driver provides the dynamic active power saving mechanism for
	  bluetooth radio devices special for android4.2.

	  Say Y here to compile support for bt lmp support into the kernel
	  or say M to compile it as module (btlmp).

config RTL_BT_LPM
	tristate "Realtek Bluesleep driver support"
	help
	  Bluetooth Bluesleep Driver.
	  This driver provides the dynamic active power saving mechanism for
	  bluetooth radio devices.

	  Say Y here to compile support for bluesleep support into the kernel
	  or say M to compile it as module (bluesleep).

config XR_BT_LPM
	tristate "Xradio Bluetooth sleep driver support"
	help
	  Bluetooth Bluetooth sleep Driver.
	  This driver provides the dynamic active power saving mechanism for
	  bluetooth radio devices.

	  Say Y here to compile support for bluesleep support into the kernel
	  or say M to compile it as module (bluesleep).

config BT_RTKBTUSB
	tristate "RTK HCI USB driver"
	depends on USB
	help
	  RTK Bluetooth HCI USB driver

config BT_RTKH5
	bool "RTK HCI UART H5 driver"
	depends on BT_HCIUART
	help
	  RTK Bluetooth HCI UART H5 Driver.
	  The Realtek protocol support enables Bluetooth HCI over 3-Wire
	  serial port interface for Realtek Bluetooth controllers.

	  Say Y here to compile support for Realtek H5 into the kernel.

endmenu

endmenu

endmenu
```

## bsp/drivers/bus/Kconfig
```kconfig
# SPDX-License-Identifier: GPL-2.0-only
menu "Bus Drivers"
	depends on AW_BSP

config AW_NSI
	tristate "NSI Bus Support for Allwinner SoCs"
	depends on AW_BSP
	help
	  Support the NSI bus driver for Allwinner platforms.

if AW_NSI
config AW_NSI_DISTRIBUTE
	bool "NSI is distrubute"
	default n
endif

config AW_NPD
	tristate "NPD Support for Allwinner SoCs"
	depends on AW_BSP
	help
	  Support the NPD(NSI PMU module's register data write to DDR module)
	  driver for Allwinner platforms.

config AW_NSI_CPU_CHANNEL
	bool "NSI have direct cpu channel"
	default n

endmenu
```

## bsp/drivers/car_reverse/car_reverse_2_0/Kconfig
```kconfig
#
# SPDX-License-Identifier: GPL-2.0-only
#
# SUNXI FAST CAR REVERSE DRIVER
#
menu "Sunxi Fast Car Reverse Drivers"
	depends on AW_BSP

config VIDEO_SUNXI_CAR_REVERSE2
	depends on AW_DISP2
	tristate "sunxi fast car reverse driver 2.0"
	default n

config SUPPORT_AUXILIARY_LINE
	tristate "support auxiliary line display"
	depends on VIDEO_SUNXI_CAR_REVERSE2
	default n

config SUPPORT_PREVIEW_ROTATOR
	tristate "support g2d to rotate preview output"
	depends on VIDEO_SUNXI_CAR_REVERSE2 && (G2D_LEGACY || G2D_RCQ)
	default n

config SUPPORT_PREVIEW_ENHANCER
	tristate "support di to enhance preview output"
	depends on VIDEO_SUNXI_CAR_REVERSE2 && (SUNXI_DI_V1XX || SUNXI_DI_V2X || SUNXI_DI_V3X)
	default n

config CAR_REVERSE_SUPPORT_TVD
	bool "support tvd input source for car reverse"
	depends on VIDEO_SUNXI_CAR_REVERSE2 && AW_VIDEO_SUNXI_TVD
	default n

config CAR_REVERSE_SUPPORT_VIN
	bool "support vin input source for car reverse"
	depends on VIDEO_SUNXI_CAR_REVERSE2 && CSI_VIN && VIDEO_SUNXI_VIN_SPECIAL
	default n

config CAR_REVERSE_SUPPORT_VIRTUAL_SOURCE
	tristate "support virtual input source for car reverse"
	depends on VIDEO_SUNXI_CAR_REVERSE2
	default n


endmenu
```

## bsp/drivers/car_reverse/car_reverse_amp/Kconfig
```kconfig
#
# SPDX-License-Identifier: GPL-2.0-only
#
# SUNXI FAST CAR REVERSE DRIVER FOR AMP
#
menu "Sunxi Fast Car Reverse Drivers For Amp"
	depends on AW_BSP

config VIDEO_SUNXI_CAR_REVERSE_AMP
	depends on AW_DISP2
	tristate "sunxi fast car reverse driver for amp"
	default n

config SUNXI_CAR_REVERSE_GPIO_DETECT
	depends on VIDEO_SUNXI_CAR_REVERSE_AMP
	tristate "sunxi fast car reverse gpio detect"
	default n

endmenu
```

## bsp/drivers/ce/Kconfig
```kconfig
# SPDX-License-Identifier: GPL-2.0-only

comment"Choose one according to the actual usage"

menu "CE Drivers"
	depends on AW_BSP

config AW_CE_SOCKET
	tristate "Support socket AF_ALG API for CE"
	help
	  Allwinner Sunxi SoC provides the CryptoEngine encryption accelerator
	  with socket AF_ALG API. Select this if you want to use it.

config AW_CE_IOCTL
	tristate "CE support the systemcall interface for user api"
	help
	  Allwinner Sunxi SoC provides the CryptoEngine encryption accelerator
	  in IOCTL mode. Select this if you want to use it.

config AW_HWRNG_DRIVER
	tristate "Support for sunxi hwrng driver"
	depends on HW_RANDOM
	help
	 Support for Sunxi hwrng driver, which can Supports hardware random number generation.

config AW_CE_SOCKET_SECURE_KEY
	tristate "Support socket AF_ALG API for CE secure key(HUK, SSK, ...) crypt/decrypt"
	help
	  Allwinner Sunxi SoC provides the AF_ALG API with socket, CryptoEngine crypto
	  accelerator using the secure key. Select this if you want to use it.

config AW_TRNG
	tristate "Support for sunxi trng"
	help
	  Support for the TRNG Controller for Allwinner SoCs.

endmenu
```
